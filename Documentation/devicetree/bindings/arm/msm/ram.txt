## drivers/iommu/Kconfig
```kconfig
# SPDX-License-Identifier: GPL-2.0-only
# The IOVA library may also be used by non-IOMMU_API users
# IOMMU_API always gets selected by whoever wants it.
if IOMMU_SUPPORT

menu "Generic IOMMU Pagetable Support"

# Selected by the actual pagetable implementations
config IOMMU_IO_PGTABLE
	bool

config IOMMU_IO_PGTABLE_LPAE
	bool "ARMv7/v8 Long Descriptor Format"
	select IOMMU_IO_PGTABLE
	depends on ARM || ARM64 || COMPILE_TEST
	depends on !GENERIC_ATOMIC64	# for cmpxchg64()
	help
	  Enable support for the ARM long descriptor pagetable format.
	  This allocator supports 4K/2M/1G, 16K/32M and 64K/512M page
	  sizes at both stage-1 and stage-2, as well as address spaces
	  up to 48-bits in size.

config IOMMU_IO_PGTABLE_LPAE_SELFTEST
	bool "LPAE selftests"
	depends on IOMMU_IO_PGTABLE_LPAE
	help
	  Enable self-tests for LPAE page table allocator. This performs
	  a series of page-table consistency checks during boot.

	  If unsure, say N here.

config IOMMU_IO_PGTABLE_CONTIG_HINT
	bool "Enable contig hint"
	depends on IOMMU_IO_PGTABLE_LPAE
	help
	  Enable config hint for LPAE page table allocator. This would
	  allow multiple TLB entries to be combined into a single entry
	  which optimizes TLB lookups.

	  If unsure, say N here.

config IOMMU_IO_PGTABLE_FAST
	bool "Fast ARMv7/v8 Long Descriptor Format"
	depends on (ARM || ARM64) && IOMMU_DMA
	help
          Enable support for a subset of the ARM long descriptor pagetable
	  format.  This allocator achieves fast performance by
	  pre-allocating and pre-populating page table memory up front.
	  only supports a 32 bit virtual address space.

          This implementation is mainly optimized for use cases where the
          buffers are small (<= 64K) since it only supports 4K page sizes.

endmenu

# ARM IOMMU support
config ARM_SMMU
	tristate "ARM Ltd. System MMU (SMMU) Support"
	depends on ARM64 || ARM || COMPILE_TEST
	depends on !GENERIC_ATOMIC64	# for IOMMU_IO_PGTABLE_LPAE
	select IOMMU_API
	select IOMMU_IO_PGTABLE_LPAE
	select ARM_DMA_USE_IOMMU if ARM
	help
	  Support for implementations of the ARM System MMU architecture
	  versions 1 and 2.

	  Say Y here if your SoC includes an IOMMU device implementing
	  the ARM SMMU architecture.

config ARM_SMMU_LEGACY_DT_BINDINGS
	bool "Support the legacy \"mmu-masters\" devicetree bindings"
	depends on ARM_SMMU=y && OF
	help
	  Support for the badly designed and deprecated "mmu-masters"
	  devicetree bindings. This allows some DMA masters to attach
	  to the SMMU but does not provide any support via the DMA API.
	  If you're lucky, you might be able to get VFIO up and running.

	  If you say Y here then you'll make me very sad. Instead, say N
	  and move your firmware to the utopian future that was 2016.

config ARM_SMMU_DISABLE_BYPASS_BY_DEFAULT
	bool "Default to disabling bypass on ARM SMMU v1 and v2"
	depends on ARM_SMMU
	default y
	help
	  Say Y here to (by default) disable bypass streams such that
	  incoming transactions from devices that are not attached to
	  an iommu domain will report an abort back to the device and
	  will not be allowed to pass through the SMMU.

	  Any old kernels that existed before this KConfig was
	  introduced would default to _allowing_ bypass (AKA the
	  equivalent of NO for this config).  However the default for
	  this option is YES because the old behavior is insecure.

	  There are few reasons to allow unmatched stream bypass, and
	  even fewer good ones.  If saying YES here breaks your board
	  you should work on fixing your board.  This KConfig option
	  is expected to be removed in the future and we'll simply
	  hardcode the bypass disable in the code.

	  NOTE: the kernel command line parameter
	  'arm-smmu.disable_bypass' will continue to override this
	  config.

config ARM_SMMU_QCOM
	def_tristate y
	depends on ARM_SMMU && ARCH_QCOM
	select QCOM_SCM
	help
	  When running on a Qualcomm platform that has the custom variant
	  of the ARM SMMU, this needs to be built into the SMMU driver.

config ARM_SMMU_QCOM_DEBUG
	bool "ARM SMMU QCOM implementation defined debug support"
	depends on ARM_SMMU_QCOM=y
	help
	  Support for implementation specific debug features in ARM SMMU
	  hardware found in QTI platforms. This include support for
	  the Translation Buffer Units (TBU) that can be used to obtain
	  additional information when debugging memory management issues
	  like context faults.

	  Say Y here to enable debug for issues such as context faults
	  or TLB sync timeouts which requires implementation defined
	  register dumps.

config QTI_IOMMU_SUPPORT
	tristate "Support for QTI iommu drivers"
	help
	  The QTI GPU device may switch between multiple iommu domains,
	  depending on usecase. This introduces a need to track all such
	  domains in a non-driver specific manner.
	  If in doubt say N.

config QCOM_IOMMU_UTIL
	tristate "Support for qcom additions to the iommu framework"
	help
	  QCOM iommu drivers support a general set of functionality in
	  addition to the functions provided by the iommu framework.
	  This includes devicetree properties for configuring iommu
	  groups and iova ranges.

	  Say N here if unsure.

config QCOM_IOMMU_DEBUG
	tristate "IOMMU debugging and testing"
	depends on QCOM_IOMMU_UTIL
	depends on DEBUG_FS
	help
	  This option is used to enable profiling and debugging in
	  the IOMMU framework code. IOMMU profiling and debugging
	  can be done through the debugfs nodes which this option
	  makes available.

config ARM_SMMU_SELFTEST
	bool "ARM SMMU self test support"
	depends on ARM_SMMU
	help
	  Enables self tests for arm smmu. Tests basic hardware
	  configurations like interrupts. Note that enabling this
	  option can marginally increase the boot time.

	  If unsure, say N.

config QCOM_LAZY_MAPPING
	tristate "Reference counted iommu-mapping support"
	depends on QCOM_DMABUF_HEAPS
	depends on IOMMU_API
	help
	  DMA-BUFs may be shared between several software clients.
	  Reference counting the mapping may simplify coordination between
	  these clients, and decrease latency by preventing multiple
	  map/unmaps of the same region.

	  If unsure, say N here.

endif # IOMMU_SUPPORT
```

## drivers/misc/felica_snfc/Kconfig
```kconfig
#
# Felica and Sony NFC device
#

config FELICA_SNFC
	bool "Enable FeliCa and Sony NFC driver"
	default n
	help
	  This option enables support for FeliCa and Sony NFC.
	  This driver is used for the combination device of FeliCa
	  and Sony NFC, and device of FeliCa.
	  Say Y if you want to able to these devices.

config FELICA_VDEV
	bool "Enable FeliCa virtual serial device"
	depends on FELICA_SNFC
	default n
	help
	  This option enables support for FeliCa virtual serial device.
	  Collision control of FeliCa and SNFC service use this serial
	  device.
	  Say Y if you want to use collision control of FeliCa and SNFC.

config CXD2235AGG
	bool "Sony CXD2235AGG driver for FeliCa and Sony NFC"
	depends on FELICA_SNFC
	default n
	help
	  This option enables support for Sony CXD2235AGG.

config CXD224X_NFC
	bool "CXD224X driver for FeliCa and NFC"
	depends on I2C
	default n
	help
	  This option enables device driver support for Sony CXD224X
	  series. This driver enables the control of CXD224X series
	  device by using I2C. Furthermore, this driver enables the
	  control of PON using device file.

config BD7602_POWER_IC
	bool "BD7602 Power IC control"
	depends on I2C
	default n
	help
	  This option enables device driver support for BD7602 Power IC
          control device.
```

## drivers/misc/hqhardwareinfo/Kconfig
```kconfig
config HQ_HARDWARE_INFO
  bool CONFIG_HQ_HARDWARE_INFO
  default n
  help
    CONFIG_HQ_HARDWARE_INFO
```

## drivers/misc/huaqinhardware_info/Kconfig
```kconfig
#
#  Driver
#

config HQHARDWARE_INFO
	tristate "Huaqin hardwareinfo"
	help
	  Say Y here if you want use it
	  chip in your system.

	  If unsure, say N.

	  choose M here: To compile this driver as a module
```

## drivers/misc/isdb-t/Kconfig
```kconfig
config SOMC_ISDBT_TUNER
	tristate "SOMC ISDBT/Tmm tuner driver for SMT-EJ103"
	default n
	depends on I2C
	help
	  Select this module to enable SOMC ISDB-T Tuner Driver.
```

## drivers/misc/mm_tuner/Kconfig
```kconfig
config MMTUNER_MN8855x
	tristate "Socionext mm_tuner driver support"
	---help---
	  This module adds support for wireless adapters based on
	  Socionext MN8855x chipset.

	  If you choose to build a module, it'll be called mm_tuner. Say Y if
	  unsure.

config MMTUNER_DEBUG
        bool "Socionext MN8855x Debug message mode"
	depends on MMTUNER_MN8855x
	default n
	---help---
	  MN8855x driver debug message mode. Say Y when you want to debug.
```

## drivers/net/Kconfig
```kconfig
# SPDX-License-Identifier: GPL-2.0-only
#
# Network device configuration
#

config VIRTIO_NET
	tristate "Virtio network driver"
	depends on VIRTIO
	select NET_FAILOVER
	select DIMLIB
	help
	  Enable this option to include the VirtIO-based network driver.
	  This driver is essential for supporting VirtIO network devices,
	  commonly used in virtualization environments. It works with
	  QEMU-based virtual machine managers (e.g., KVM or Xen).
	  Say Y or M.

config VIRTIO_NET_DISABLE_F_DEVICE_STATS
	bool "Disable/Enable F_DEVICE_STATS bit in Virtio network driver"
	depends on VIRTIO_NET
	help
	  This config will disable or enable F_DEVICE_STATS bit in the
	  VirtIO-based network driver. Disabling this bit can avoid
	  crashes caused by QNX VirtIO-based network backend driver
	  using F_DEVICE_STATS bit value for other function.
	  Say Y or N.

menuconfig NETDEVICES
	default y if UML
	depends on NET
	bool "Network device support"
	help
	  You can say N here if you don't intend to connect your Linux box to
	  any other computer at all.

	  You'll have to say Y if your computer contains a network card that
	  you want to use under Linux. If you are going to run SLIP or PPP over
	  telephone line or null modem cable you need say Y here. Connecting
	  two machines with parallel ports using PLIP needs this, as well as
	  AX.25/KISS for sending Internet traffic over amateur radio links.

	  See also "The Linux Network Administrator's Guide" by Olaf Kirch and
	  Terry Dawson. Available at <http://www.tldp.org/guides.html>.

	  If unsure, say Y.

if NETDEVICES

source "$(KCONFIG_EXT_PREFIX)drivers/net/pcs/Kconfig"
source "$(KCONFIG_EXT_PREFIX)drivers/net/ethernet/Kconfig"
source "$(KCONFIG_EXT_PREFIX)drivers/net/phy/Kconfig"

endif # NETDEVICES
```

## drivers/nfc/drivers/cloned_spi_geni_qcom_controller/Kconfig
```kconfig
#
# Clone QCOM SPI geni controller
#

config SPI_QCOM_GENI_CLONED
        tristate "Qualcomm Technologies Inc.'s GENI based SPI controller"
        depends on ARCH_QCOM
        help
          SPI driver for Qualcomm Technologies Inc's GENI based controller.
          The controller can run upto 50 Mhz, support upto 4 CS lines,
          programmable bits per word from 4 to 32 and supports the various
          SPI modes. It can operate in FIFO mode (SW driven IO) and DMA mode.

          This driver can also be built as a module.  If so, the module
          will be called spi-geni-qcom.
```

## drivers/nfc/nxp-ese/Kconfig
```kconfig
#
# secure element driver configuration
#

config NXP_ESE_P73
	tristate "Nxp P73 secure element protocol driver (SPI) devices"
	depends on SPI && NXP_NFC_I2C
	help
	  This enables the Secure Element driver for SNxxx based devices.

	  If unsure, say N.

	  This selects Secure Element support.

	  If you want NFC support, you should say Y here and
	  also to your specific host controller driver.
```

## drivers/perf/Kconfig
```kconfig
# SPDX-License-Identifier: GPL-2.0-only
#
# Performance Monitor Drivers
#

menu "Performance monitor support"
	depends on PERF_EVENTS

config QCOM_LLCC_PMU
	tristate "Qualcomm Technologies LLCC PMU"
	depends on ARCH_QCOM && ARM64
	help
	   Provides support for the LLCC performance monitor unit (PMU) in
	   Qualcomm Technologies processors.
	   Adds the LLCC PMU into the perf events subsystem for monitoring
	   LLCC miss events.

config ARM_SMMU_PMU
        tristate "ARM SMMU PMU"
        depends on PERF_EVENTS && ARM64 && ARM_SMMU
          help
          Provides support for the SMMU performance monitor unit (PMU)
          on ARM-based systems.
          Adds the SMMU PMU into the perf events subsystem for
          monitoring SMMU performance events.

endmenu
```

## drivers/pinctrl/qcom/Kconfig
```kconfig
# SPDX-License-Identifier: GPL-2.0-only
if (ARCH_QCOM || COMPILE_TEST)

config PINCTRL_MSM
	tristate "Qualcomm core pin controller driver"
	depends on GPIOLIB
	# OF for pinconf_generic_dt_node_to_map_group() from GENERIC_PINCONF
	depends on OF
	select QCOM_SCM
	select PINMUX
	select PINCONF
	select GENERIC_PINCONF
	select GPIOLIB_IRQCHIP
	select IRQ_DOMAIN_HIERARCHY
	select IRQ_FASTEOI_HIERARCHY_HANDLERS

config PINCTRL_DIREWOLF
	tristate "Qualcomm Technologies, Inc. DIREWOLF pin controller driver"
	depends on GPIOLIB && OF
	select PINCTRL_MSM
	help
	  This is the pinctrl, pinmux, pinconf and gpiolib driver for the
	  Qualcomm Technologies, Inc. Top Level Mode Multiplexer block (TLMM)
	  block found on the QTI LEMANS platform.
	  Say Y here to compile statically, or M here to compile it as a module.
	  If unsure, say N.

config PINCTRL_LEMANS
	tristate "Qualcomm Technologies, Inc. LEMANS pin controller driver"
	depends on GPIOLIB && OF
	select PINCTRL_MSM
	help
	  This is the pinctrl, pinmux, pinconf and gpiolib driver for the
	  Qualcomm Technologies, Inc. Top Level Mode Multiplexer block (TLMM)
	  block found on the QTI LEMANS platform.
	  Say Y here to compile statically, or M here to compile it as a module.
	  If unsure, say N.

source "$(KCONFIG_EXT_PREFIX)drivers/pinctrl/qcom/Kconfig.msm"

config PINCTRL_MONACO_AUTO
	tristate "Qualcomm Technologies, Inc. MONACO_AUTO pin controller driver"
	depends on GPIOLIB && OF
	select PINCTRL_MSM
	help
	  This is the pinctrl, pinmux, pinconf and gpiolib driver for the
	  Qualcomm Technologies, Inc. Top Level Mode Multiplexer block (TLMM)
	  block found on the QTI MONACO_AUTO platform.
	  Say Y here to compile statically, or M here to compile it as a module.
	  If unsure, say N.

config PINCTRL_SA8797P
	tristate "Qualcomm Technologies Inc SA8797P pin controller driver"
	depends on ARM64 || COMPILE_TEST
	help
	  This is the pinctrl, pinmux, pinconf and gpiolib driver for the
	  Qualcomm Technologies, Inc. Top Level Mode Multiplexer block (TLMM)
	  block found on the QTI SA8797P platform.
	  Say Y here to compile statically, or M here to compile it as a module.
	  If unsure, say N.

endif
```
