## Documentation/devicetree/bindings/arm/msm/ram.txt
```
RAM Oops/Panic logger

Ramoops is an oops/panic logger that writes its logs to RAM before the system
crashes. It works by logging oopses and panics in a circular buffer.
Ramoops uses a reserved memory area to store the dump. The start and size
of the memory area are set using two variables:

"mem_address" for the start.
"mem_size" for the size.

Ramoops must reserve memory using the msm specific memory reservation
bindings (see Documentation/devicetree/bindings/arm/msm/memory-reserve.txt).

Required properties

-compatible: "pstore-ramoops"
-linux,contiguous-region: phandle reference to a pstore reserve memory

Example:
	ramoops {
		compatible = "pstore-ramoops";
		linux,contiguous-region = <&pstore_reserve_mem>
	};
```

## Documentation/devicetree/bindings/debug_memory/debug_memory.txt
```
Ramdump Debug Memory

Debug memory contains necessary information for ramdump to dump
the memory.This memory is used as a bridge between Android and
ramdump.

This memory is used by the modules mentioned below:
a) Rdtags
b) Ramdump Memory Descriptors


Required Properties:
-compatible: "removed-dma-pool", "qcom,debug_memory"
-reg: Specifies the physical address of the debug memory region and its size

Example:
	debug_region: debug_region@57e00000 {
		compatible = "removed-dma-pool", "qcom,debug_memory";
		no-map;
		reg = <0 0x57e00000 0 0x100000>;
		label = "debug_mem";
	};
```

## Documentation/devicetree/bindings/i2c/i2c-fusb301.txt
```
Fairchild USB Type-C Controller

Required properties:
- compatible: must be "fusb301"
- reg: i2c slave address
- interrupts : the interrupt number
- interrupt-parent : the phandle for the interrupt controller that
  services interrupts for this device.
- fusb301,irq_gpio: the phandle for the gpio that to receive interrupt
  from controller.
- fusb301,cbl_det-gpio: the phandle for the gpio that to detect a
  USB cable.

Example:
	i2c@7af6000 {
		fusb301@25 {
			status = "okay";
			compatible = "fusb301";
			reg = <0x25>;
			interrupt-parent = <&msm_gpio>;
			interrupts = <107 0x3>, <131 0x2>;
			fusb301,irq_gpio = <&msm_gpio 131 0x00>;
			fusb301,cbl_det-gpio = <&msm_gpio 107 0x00>;
		};
	};
```

## Documentation/devicetree/bindings/input/misc/fpc1145.txt
```
fpc1145 series fingerprint sensor driver

Example:


	fpc1145@1 {
		status = "ok";
		reg = <1>;
		compatible = "fpc,fpc1020";
		interrupt-parent = <&msm_gpio>;
		interrupts = <90 0x0>;
		fpc,gpio_cs0    = <&msm_gpio 2 0>;
		fpc,gpio_cs1    = <&msm_gpio 8 0>;
		fpc,gpio_rst    = <&msm_gpio 89 0>;
		fpc,gpio_irq    = <&msm_gpio 90 0>;
		vcc_spi-supply  = <&pm8994_s4>;
		vdd_ana-supply  = <&pm8994_l32>;
		vdd_io-supply   = <&pm8994_l32>;
		fpc,use_fpc2050 = <1>;
		fpc,enable-on-boot;
		/delete-property/ fpc,enable-wakeup;
		/* EV_MSC, MSC_SCAN */
		fpc,event-type = <4>;
		fpc,event-code = <4>;

		spi-max-frequency = <960000>;
		spi-qup-id = <1>;
		clock-names = "iface_clk", "core_clk";
		clocks = <&clock_gcc clk_gcc_blsp1_ahb_clk>,
			<&clock_gcc clk_gcc_blsp1_qup1_spi_apps_clk>;

		pinctrl-names = "fpc1020_spi_active",
				"fpc1020_reset_reset",
				"fpc1020_reset_active",
				"fpc1020_cs_low",
				"fpc1020_cs_high",
				"fpc1020_cs_active",
				"fpc1020_irq_active";

		pinctrl-0 = <&fpc_spi_active>;
		pinctrl-1 = <&fpc_reset_reset>;
		pinctrl-2 = <&fpc_reset_active>;
		pinctrl-3 = <&fpc_cs_low>;
		pinctrl-4 = <&fpc_cs_high>;
		pinctrl-5 = <&fpc_cs_active>;
		pinctrl-6 = <&fpc_irq_active>;
	};
```

## Documentation/devicetree/bindings/regulator/fpf2495-regulator.txt
```
FPF2495 Voltage regulators

Required properties:
- compatible: Must be "fairchild,fpf2495-regulator";

Optional properties:
- gpio_en: gpio to use for enable control
- startup-delay-us: startup time in microseconds
- gpio_en-active_low: Polarity of gpio_en is Active low
If this property is missing, the default assumed is Active high.
- vin-supply: Input supply name.
- gpio_flag: gpio to use for receive a signel of flag pin.
- gpio_flag-active_high: Polarity of gpio_flag is Active high
If this property is missing, the default assumed is Active low.
- flag_pull-supply: Supply name to pull the flag pin.
- oc-delay-ms: dead time for inrush current on Vout.

Any property defined as part of the core regulator
binding, defined in regulator.txt, can also be used.
However a fixed voltage regulator is expected to have the
regulator-min-microvolt and regulator-max-microvolt
to be the same.

These property does not work on this driver below:
  regulator-microvolt-offset
  regulator-boot-on
  regulator-always-on
  regulator-min-microamp
  regulator-max-microamp

Example:

	fpf2495_reg: fpf2495_reg {
		compatible = "fairchild,fpf2495-regulator";
		regulator-name = "fpf2495-reg";
		regulator-min-microvolt = <5000000>;
		regulator-max-microvolt = <5000000>;
		gpio_en = <&gpio1 16 0>;
		vin-supply = <&parent_reg>;
		flag_pull-supply = <&pull_reg>;
		gpio_flag = <&gpio5 3 0>;
		oc-delay-ms = <300>;
	};
```

## drivers/cei/Kconfig
```kconfig
config CEI_HARDWARE_ID
       bool "CEI Hardware ID Module"
       depends on MSM_SMD
       default y
```

## drivers/development-tool/Kconfig
```kconfig
#
# Vibrator device configuration
#

menu "FIH development tool"

config FIH_DEVELOPMENT_TOOL
	bool "use FIH development tool"
	help
	  FIH development tool.

config FIH_UNITED_FILE_NODE
        tristate "FIH united file node"
        default n
        depends on FIH_DEVELOPMENT_TOOL
        help
          This is united file node.

endmenu
```

## drivers/edac/Kconfig
```kconfig
# SPDX-License-Identifier: GPL-2.0-only
#
# For a description of the syntax of this configuration file,
# see Documentation/kbuild/kconfig-language.rst.
#

menu "Qualcomm edac drivers"

config EDAC_KRYO_ARM64
	depends on ARM64
	tristate "ARM KRYO Gold and Silver L1/L2/L3/SCU Caches"
	help
	  Support for error detection and correction on the
	  Kryo3xx Gold and Silver CPUs. Reports errors caught by Kryo3xx
	  ECC mechanism.
	  For debugging issues having to do with stability and overall system
	  health, you should probably say 'Y' here.

config EDAC_KRYO_ARM64_PANIC_ON_CE
	depends on EDAC_KRYO_ARM64
	bool "Panic on correctable errors - Kryo"
	help
	  Forcibly cause a kernel panic on kryo if an correctable error (CE) is
	  detected, even though the error is (by definition) correctable and
	  would otherwise result in no adverse system effects. This can reduce
	  debugging times on hardware which may be operating at voltages or
	  frequencies outside normal specification.
	  For production builds, you should definitely say 'N' here.

config EDAC_KRYO_ARM64_PANIC_ON_UE
	depends on EDAC_KRYO_ARM64
	bool "Panic on uncorrectable errors - kryo"
	help
	  Forcibly cause a kernel panic if an uncorrectable error (UE) is
	  detected. This can reduce debugging times on hardware which may be
	  operating at voltages or frequencies outside normal specification.
	  For production builds, you should probably say 'N' here.

config EDAC_QCOM
	tristate "QCOM EDAC Controller"
	depends on ARCH_QCOM && QCOM_LLCC
	help
	  Support for error detection and correction on the
	  Qualcomm Technologies, Inc. SoCs.

	  This driver reports Single Bit Errors (SBEs) and Double Bit Errors (DBEs).
	  As of now, it supports error reporting for Last Level Cache Controller (LLCC)
	  of Tag RAM and Data RAM.

	  For debugging issues having to do with stability and overall system
	  health, you should probably say 'Y' here.

endmenu
```

## drivers/input/fingerprint/egis/Kconfig
```kconfig
config FP_ET613
	tristate "et613 fingerprint driver support"
	help
	  Say Y here to enable et613 fingerprint driver support!
```

## drivers/input/fingerprint/et6xx/Kconfig
```kconfig
config FP_EC617
	tristate "EC617 fingerprint driver support"
	help
	  Say Y here to enable EC617 fingerprint driver support!
```

## drivers/input/misc/cm36286/Kconfig
```kconfig
if INPUT_MISC

config INPUT_CAPELLA_CM36686
	tristate "CM36686 proximity and light sensor"
	depends on I2C
	help
	  Say Y here to enable the CM36686 Proximity
	  Sensor with Ambient Light Sensor.

endif
```

## drivers/input/misc/vl53L0/Kconfig
```kconfig
#
# vl53L0 driver configuration
#
config SENSORS_STMVL53L0
	tristate "vl53L0 TOF sensor"
	depends on MSMB_CAMERA
	help
	  Say Y here to enable the vl53L0 TOF sensor.

	  To compile this driver as a module, choose M here: the
	  module will be called vl53L0.

config SENSORS_STMVL53L0_USE_CCI
	tristate "vl53L0 use camera cci"
	depends on SENSORS_STMVL53L0
	help
	  Say Y here to enable the camera cci use in the vl53L0 driver.

	  If unsure, say N.
```

## drivers/input/sensors/Kconfig
```kconfig
#
# Makefile for Bosch sensors driver.
#
config SENSORS_BMA2X2
	tristate "BMA255/BMA250E/BMA222E/BMA280 acceleration sensor support"
	depends on I2C
	default y
	help
	  If you say yes here, you get support for Bosch Sensortec's
	  acceleration sensors BMA255/BMA250E/BMA222E/BMA280.

config SENSORS_BMA2X2_ENABLE_INT1
	tristate "BMA2X2 acceleration sensor interrupt INT1 support"
	depends on SENSORS_BMA2X2
	default n
	help
	 If you say yes here, you get INT1 support for Bosch Sensortec
	 acceleration sensors BMA255/BMA250E/BMA222E/BMA280.
	 Select it will disable interrupt INT2 support

config SIG_MOTION
	tristate "support significant motion sensor function"
	depends on SENSORS_BMA2X2  && ( SENSORS_BMA2X2_ENABLE_INT1 || SENSORS_BMA2X2_ENABLE_INT2)
	help
	 If you say yes here, if you want to support Bosch significant motion sensor function

config DOUBLE_TAP
	tristate "support double tap sensor function"
	depends on SENSORS_BMA2X2  && ( SENSORS_BMA2X2_ENABLE_INT1 || SENSORS_BMA2X2_ENABLE_INT2)
	help
	 If you say yes here, you get support Bosch double tap sensor function

config SENSORS_BMI058
	tristate "BMI058 Sensor Support"
	depends on (SENSORS_BMG || SENSORS_BMA2X2)
	help
	 If you say yes here, you get support for Bosch Sensortec's
	 sensor driver of BMI058.

config SENSORS_BMM050
	tristate "BMM050 Magnetic Sensor Driver"
	depends on I2C
	default y
	help
	 If you say yes here, you get support for Bosch Sensortec's
	 sensor BMM050 Magnetic Sensor
```

## drivers/input/touchscreen/cypress-gen4/file_node_control/Kconfig
```kconfig
config FIH_FILE_NODE_CONTROL
        tristate "FIH file node control"
        default n
        depends on TOUCHSCREEN_CYPRESS_CYTTSP4_I2C
        select FIH_DEVELOPMENT_TOOL
	select FIH_UNITED_FILE_NODE
        help
          This is touch tool.
```
