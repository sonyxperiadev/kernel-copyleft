/*
 * NOTE: This file has been modified by Sony Corporation.
 * Modifications are Copyright 2017 Sony Corporation,
 * and licensed under the license of the file.
 */
// SPDX-License-Identifier: GPL-2.0
/dts-v1/;
/plugin/;

#include "overlay_common.dtsi"
