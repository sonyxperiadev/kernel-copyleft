/*
 * Copyright (C) 2018 Sony Mobile Communications Inc.
 *
 * This program is free software; you can redistribute it and/or modify
 * it under the terms of the GNU General Public License version 2, as
 * published by the Free Software Foundation.
 */
// SPDX-License-Identifier: GPL-2.0
/dts-v1/;
/plugin/;

/* overlay_4 - test insertion of a full node */

&unittest_test_bus {

	/* suppress DTC warning */
	#address-cells = <1>;
	#size-cells = <0>;

	test-unittest4 {
		compatible = "unittest";
		status = "okay";
		reg = <4>;
	};
};
