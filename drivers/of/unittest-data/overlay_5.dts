/*
 * Copyright (C) 2018 Sony Mobile Communications Inc.
 *
 * This program is free software; you can redistribute it and/or modify
 * it under the terms of the GNU General Public License version 2, as
 * published by the Free Software Foundation.
 */
// SPDX-License-Identifier: GPL-2.0
/dts-v1/;
/plugin/;

/* overlay_5 - test overlay apply revert */

&unittest5 {
	status = "okay";
};
