## drivers/power/reset/Kconfig
```kconfig
# SPDX-License-Identifier: GPL-2.0-only
if POWER_RESET

config POWER_RESET_QCOM_DOWNLOAD_MODE
        tristate "MSM download mode driver"
        depends on ARCH_QCOM
        help
          MSM boards support booting to special download modes after a restart.
          These modes could be a normal restart, restarting into a
          ramdump collection mode (CrashDump), or restarting into "emergency
          download mode".

config POWER_RESET_QCOM_DOWNLOAD_MODE_DEFAULT
        bool "MSM download mode enabled by default"
        help
          A device with "download mode" enabled will upon an unexpected
          warm-restart enter a special debug mode that allows the user to
          "download" memory content over USB for offline postmortem analysis.
          The feature can be enabled/disabled on the kernel command line.

          Say Y here to enable "download mode" by default.

config POWER_RESET_QCOM_PON
	tristate "Qualcomm power-on driver"
	depends on ARCH_QCOM
	depends on MFD_SPMI_PMIC
	select REBOOT_MODE
	help
	  Power On support for Qualcomm boards.
	  If you have a Qualcomm platform and need support for
	  power-on and reboot reason, Say Y.
	  If unsure, Say N.

config POWER_RESET_QCOM_REBOOT_REASON
        tristate "MSM reboot mode driver"
        depends on ARCH_QCOM
        help
          Support for setting reboot reason on MSM boards.
          This feature supports commands such as "reboot bootloader"
          to boot the MSM board to fastboot mode.
          If unsure, say Y.

config REBOOT_MODE
	tristate

config POWER_RESET_QCOM_VM
        tristate "Qualcomm Technologies, Inc. MSM VM power-off driver"
        depends on OF
        help
         Power off and restart support for Qualcomm Technologies, Inc. virtual
         machine. This driver supports virtual machine power down and restart.
         Say Y here if you have a MSM virtual machine and wish to enable
         restart driver.

endif
```

## drivers/remoteproc/Kconfig
```kconfig
# SPDX-License-Identifier: GPL-2.0-only
menu "Remoteproc drivers"

if REMOTEPROC

config QCOM_PIL_INFO
	tristate

config QCOM_RPROC_COMMON
	tristate "Qualcomm Technologies, Inc. Remote Proc Common Framework"
	select AUXILIARY_BUS

config QCOM_Q6V5_PAS_SOCCP_V1
	bool "SOCCP V1"
	depends on QCOM_Q6V5_PAS
	help
	  Support to enable power state transition control of SoC Control Processor
	  V1 via an API which can be used by clients to vote for the subsystem to
	  be either in active or dormant states.
	  If unsure say N.

config QCOM_Q6V5_COMMON
	tristate
	depends on ARCH_QCOM
	depends on QCOM_SMEM

config QCOM_Q6V5_ADSP
	tristate "Qualcomm Technology Inc ADSP Peripheral Image Loader"
	depends on OF && ARCH_QCOM
	depends on QCOM_SMEM
	depends on RPMSG_QCOM_SMD || RPMSG_QCOM_SMD=n
	depends on RPMSG_QCOM_GLINK_SMEM || RPMSG_QCOM_GLINK_SMEM=n
	depends on QCOM_SYSMON || QCOM_SYSMON=n
	depends on RPMSG_QCOM_GLINK || RPMSG_QCOM_GLINK=n
	depends on QCOM_AOSS_QMP || QCOM_AOSS_QMP=n
	select MFD_SYSCON
	select QCOM_PIL_INFO
	select QCOM_MDT_LOADER
	select QCOM_Q6V5_COMMON
	select QCOM_RPROC_COMMON
	help
	  Say y here to support the Peripheral Image Loader
	  for the non-TrustZone part of Qualcomm Technology Inc. ADSP and CDSP
	  remote processors. The TrustZone part is handled by QCOM_Q6V5_PAS
	  driver.

config QCOM_Q6V5_MSS
	tristate "Qualcomm Hexagon V5 self-authenticating modem subsystem support"
	depends on OF && ARCH_QCOM
	depends on QCOM_SMEM
	depends on RPMSG_QCOM_SMD || RPMSG_QCOM_SMD=n
	depends on RPMSG_QCOM_GLINK_SMEM || RPMSG_QCOM_GLINK_SMEM=n
	depends on QCOM_SYSMON || QCOM_SYSMON=n
	depends on RPMSG_QCOM_GLINK || RPMSG_QCOM_GLINK=n
	depends on QCOM_AOSS_QMP || QCOM_AOSS_QMP=n
	select MFD_SYSCON
	select QCOM_MDT_LOADER
	select QCOM_PIL_INFO
	select QCOM_Q6V5_COMMON
	select QCOM_RPROC_COMMON
	select QCOM_SCM
	help
	  Say y here to support the Qualcomm self-authenticating modem
	  subsystem based on Hexagon V5. The TrustZone based system is
	  handled by QCOM_Q6V5_PAS driver.

config QCOM_Q6V5_PAS
	tristate "Qualcomm Hexagon v5 Peripheral Authentication Service support"
	depends on OF && ARCH_QCOM
	depends on QCOM_SMEM
	depends on RPMSG_QCOM_SMD || RPMSG_QCOM_SMD=n
	depends on RPMSG_QCOM_GLINK_SMEM || RPMSG_QCOM_GLINK_SMEM=n
	depends on QCOM_SYSMON || QCOM_SYSMON=n
	depends on RPMSG_QCOM_GLINK || RPMSG_QCOM_GLINK=n
	depends on QCOM_AOSS_QMP || QCOM_AOSS_QMP=n
	select MFD_SYSCON
	select QCOM_PIL_INFO
	select QCOM_MDT_LOADER
	select QCOM_Q6V5_COMMON
	select QCOM_RPROC_COMMON
	select QCOM_SCM
	help
	  Say y here to support the TrustZone based Peripheral Image Loader
	  for the Qualcomm Hexagon v5 based remote processors. This is commonly
	  used to control subsystems such as ADSP (Audio DSP),
	  CDSP (Compute DSP), MPSS (Modem Peripheral SubSystem), and
	  SLPI (Sensor Low Power Island).

config QCOM_SPSS
	tristate "QTI Secure Subsystem Peripheral loading support"
	depends on OF && ARCH_QCOM
	depends on QCOM_SMEM
	depends on RPMSG_QCOM_SMD || (COMPILE_TEST && RPMSG_QCOM_SMD=n)
	depends on RPMSG_QCOM_GLINK_SMEM || RPMSG_QCOM_GLINK_SMEM=n
	depends on QCOM_SYSMON || QCOM_SYSMON=n
	select MFD_SYSCON
	select QCOM_MDT_LOADER
	select QCOM_Q6V5_COMMON
	select QCOM_RPROC_COMMON
	select QCOM_SCM
	help
	  Say y here to support the TrustZone based Peripheral Image
	  Loader for the Qualcomm Technologies, Inc. Secure Subsystem
	  remote processor. This also supports remote processors that
	  are booted before kernel comes up.

config QCOM_Q6V5_WCSS
	tristate "Qualcomm Hexagon based WCSS Peripheral Image Loader"
	depends on OF && ARCH_QCOM
	depends on QCOM_SMEM
	depends on RPMSG_QCOM_SMD || RPMSG_QCOM_SMD=n
	depends on RPMSG_QCOM_GLINK_SMEM || RPMSG_QCOM_GLINK_SMEM=n
	depends on QCOM_SYSMON || QCOM_SYSMON=n
	depends on RPMSG_QCOM_GLINK || RPMSG_QCOM_GLINK=n
	depends on QCOM_AOSS_QMP || QCOM_AOSS_QMP=n
	select MFD_SYSCON
	select QCOM_MDT_LOADER
	select QCOM_PIL_INFO
	select QCOM_Q6V5_COMMON
	select QCOM_RPROC_COMMON
	select QCOM_SCM
	help
	  Say y here to support the Qualcomm Peripheral Image Loader for the
	  Hexagon V5 based WCSS remote processors on e.g. IPQ8074.  This is
	  a non-TrustZone wireless subsystem.

config QCOM_SYSMON
	tristate "Qualcomm sysmon driver"
	depends on RPMSG
	depends on ARCH_QCOM
	depends on NET
	select QCOM_QMI_HELPERS
	help
	  The sysmon driver implements a sysmon QMI client and a handler for
	  the sys_mon SMD and GLINK channel, which are used for graceful
	  shutdown, retrieving failure information and propagating information
	  about other subsystems being shut down.

	  Say y here if your system runs firmware on any other subsystems, e.g.
	  modem or DSP.

config QCOM_WCNSS_PIL
	tristate "Qualcomm WCNSS Peripheral Image Loader"
	depends on OF && ARCH_QCOM
	depends on RPMSG_QCOM_SMD || RPMSG_QCOM_SMD=n
	depends on RPMSG_QCOM_GLINK_SMEM || RPMSG_QCOM_GLINK_SMEM=n
	depends on QCOM_SMEM
	depends on QCOM_SYSMON || QCOM_SYSMON=n
	depends on RPMSG_QCOM_GLINK || RPMSG_QCOM_GLINK=n
	select QCOM_MDT_LOADER
	select QCOM_PIL_INFO
	select QCOM_RPROC_COMMON
	select QCOM_SCM
	help
	  Say y here to support the Peripheral Image Loader for loading WCNSS
	  firmware and boot the core on e.g. MSM8974, MSM8916. The firmware is
	  verified and booted with the help of the Peripheral Authentication
	  System (PAS) in TrustZone.

config QCOM_PANIC_ON_NOTIF_TIMEOUT
	bool "Trigger kernel panic when notification timeout expires"
	help
	  This is a debug feature where a kernel panic is triggered when
	  communication between subsystems through sysmon is taking too
	  long. This scneario can happen if the peripheral has died and
	  is no longer responsive.
	  Also trigger a kernel panic if invoking the callbacks registered
	  with a particular subsystem's notifications by the subsystem
	  notifier framework is taking too long.

config RPROC_SYSMON_NOTIF_TIMEOUT
	int "Sysmon notifications timeout in ms"
	default 10000
	help
	  The amount of time, in milliseconds, that should elapse between
	  the start and end of sysmon notifications, before a warning
	  is emitted.

config RPROC_SYSMON_SHUTDOWN_NOTIF_TIMEOUT
	int "Sysmon notifications timeout in ms"
	default 10000
	help
	  This is a debug feature where a kernel panic is triggered when
	  there is no acknowledgment there from the subsystem shutdown
	  request.

	  The amount of time, in milliseconds, that should elapse between
	  the start and end of sysmon notifications, before a warning
	  is emitted.


config RPROC_SSR_NOTIF_TIMEOUT
	int "SSR notifier timeout in ms"
	default 10000
	help
	  The amount of time, in milliseconds, that should elapse between
	  the start and end of SSR notifications through the subsystem
	  notifier, before a warning is emitted.

config QCOM_RPROC_BOTH_DUMPS
	bool "Collect both minidump and fulldump for subsystem crash"
	help
	  Say y here to allow dumping both fulldump and minidump for the
	  case where subsystem minidump is enabled by policy and the feature
	  is enabled for a client. The case where minidump is not enabled,
	  and fulldump is collected by default remains unaffected.

endif # REMOTEPROC

endmenu
```

## drivers/rmi4/Kconfig
```kconfig
#
# RMI4 bus configuration
#

menuconfig RMI4_BUS
	tristate "RMI4 bus"
	default n
	help
	  Say yes here if you want to use the RMI4 bus.
	  This will enable support for all Synaptics touch chips that
	  use the RMI4 protocol.

	  This option will build the bus driver andmake all other
	   drivers for this selectble.

	  If unsure, say N

if RMI4_BUS

config RMI4_DEBUG_BUS
	bool "RMI4 bus debug messages"
	help
	  Say Y here if you want or need to debug the RMI4 bus. This
	  will enable a lot of debug information which is useful for
	  debugging

	  If unsure, say N here.

config RMI4_DRIVER
	tristate "rmi4 core driver"
	depends on RMI4_BUS
	default y
	help
	  This is the core driver for RMI4 based devices. It is
	  responsible for core functionality like IRQ handling, PDT
	  scanning etc.
	  Without this, nothing RMI4 related will work.

	  To compile this driver as a module, choose M here. The
	  module will be called rmi4_driver.

	  If unsure, say Y

config RMI4_SPI_ADAPTOR
	tristate "rmi4 spi adaptor"
	depends on (RMI4_BUS && SPI)
	default n
	help
	  This is an RMI4 adaptor that uses the SPI bus. If you have
	  an RMI4 compatible chip on an SPI bus, you will need this.

	  To compile this driver as a module, say M here. The module
	  will be called rmi4_spi_adaptor.

	  If unsure, say N here.

config RMI4_I2C_ADAPTOR
	tristate "rmi4 i2c adaptor"
	depends on (RMI4_BUS && I2C)
	default n
	help
	  This is an RMI4 adaptor that uses the I2C bus. If you have
	  an RMI4 compatible chip on an I2C bus, you will need this.

	  To compile this driver as a module, say M here. The module
	  will be called rmi4_i2c_adaptor.

	  If unsure, say N here.

config RMI4_F01
	tristate "rmi4 function 01 handler"
	depends on RMI4_BUS
	default y
	help
	  This is a function handler for RMI4 function 01. This function
	  is responsible for interrupt handling and other interesting low
	  level features.
	  Without this, none of the other function handler will work.

	  To compile this driver as a module, choose M here. The module
	  will be called rmi4_function_01.

	  If unsure, say Y here.

config RMI4_F11
	tristate "rmi4 function 11 handler"
	depends on RMI4_BUS
	default y
	help
	  This is a function handler for RMI4 function 11. This function
	  is responsible for the 2D area of touch panels.
	  Without this, the touch panel will not work.

	  To compile this driver as a module, choose M here. The module
	  will be called rmi4_function_11.

	  If unsure, say Y here.

config RMI4_F34
	tristate "rmi4 function 34 handler"
	depends on RMI4_BUS
	default y
	help
	  This module does firmware upgrade on the chip. If you are going to
	  update chip FW on running devices via for example system SW update,
	  you will want this.

	  To compile this driver as a module, choose M here. The module
	  will be called rmi4_finction_34.

	  If unsure, say Y here.

config RMI4_F54
	tristate "rmi4 function 54 handler"
	depends on RMI4_BUS
	default n
	help
	  This module is used for in-hw tuning. This is something that normally
	  is not used.

	  To compile this driver as a module, choose M here. The module
	  will be called rmi4_function_54.

	  If unsure, say N here.

config RMI4_F54_DBG_RAW_HEX
	bool "Print data in raw hex"
	depends on RMI4_F54
	help
	  Prints read data as raw hex in kernel log.
	  This is mainly used for debugging.

	  This option will enable debug printouts in F54.

	  If unsure, say N here.

config RMI4_F54_DBG_HUMAN_READABLE
	bool "Print data human readable"
	depends on RMI4_F54
	help
	  Prints read data in human readable form in kernel log.
	  This is mainly of use for debugging.

	  This option will enable some debug functionality in F54.

	  If unsure, say N here.

config RMI4_F54_WATCHDOG
	bool "Enable watchdog to reset F54"
	depends on RMI4_F54
	help
	  If some call fails, the function can get stuck. This
	  watchdog will reset this function in these cases.

	  This option will enable the wathcdog feature in F54,
	  which wil lensure that it can't get stuck in some
	  arbitrary mode.

	  If unsure, say Y here.

config RMI4_CHAR_DEV
	tristate "rmi4 char_dev handler"
	depends on RMI4_BUS
	default n
	help
	  This module is used for in-hw tuning. This is something that normally
	  is not used.

	  To compile this driver as a module, choose M here. The module
	  will be called rmi4_char_dev.

	  If unsure, say N here.

config RMI4_WATCHDOG
	bool "Enable watchdog to reset touch device"
	depends on RMI4_BUS
	help
	  If device gets stuck this triggers HW
	  reset.

	  This option will enable the wathcdog feature,
	  which will ensure device HW reset if device gets stuck
	  by some reason like ESD.

	  If unsure, say Y here.

config RMI4_EARLY_SUSPEND
	tristate "Enable early suspend for the RMI4 driver"
	depends on HAS_EARLYSUSPEND
	default n
	help
	  This module implements early suspend functionality
	  for the Synaptics RMI4 based touch chip.
	  If you are using one of these chips and are running
	  on Android, you will want to say yes here.

	  To compile this driver as a module, choose M here. The module
	  will be called rmi4_early_suspend

	  If unsure, say N here.

endif # RMI4_BUS
```
