## drivers/rpmsg/Kconfig
```kconfig
# SPDX-License-Identifier: GPL-2.0

menu "Rpmsg drivers"

# RPMSG always gets selected by whoever wants it
config RPMSG_QCOM_GLINK
	tristate
	select RPMSG

config RPMSG_QCOM_GLINK_RPM
	tristate "Qualcomm RPM Glink driver"
	select RPMSG_QCOM_GLINK
	depends on HAS_IOMEM
	depends on MAILBOX
	help
	  Say y here to enable support for the GLINK RPM communication driver,
	  which serves as a channel for communication with the RPM in GLINK
	  enabled systems.

config RPMSG_QCOM_GLINK_SMEM
	tristate "Qualcomm SMEM Glink driver"
	select RPMSG_QCOM_GLINK
	depends on MAILBOX
	depends on QCOM_SMEM
	help
	  Say y here to enable support for the GLINK SMEM communication driver,
	  which provides support for using the GLINK communication protocol
	  over SMEM.

config RPMSG_QCOM_GLINK_SPSS
	tristate "QTI SPSS Glink driver"
	select RPMSG_QCOM_GLINK_NATIVE
	depends on MAILBOX
	depends on QCOM_SMEM
	help
	  Say y here to enable support for the GLINK SPSS communication driver,
	  which provides support for using the GLINK communication protocol
	  over SMEM. This protocol maps the smem and then shares the mapped
	  region with the remote proc by writing the smem descriptor location
	  and size into shared registers.

config QCOM_GLINK_PKT
	tristate "Enable device interface for GLINK packet channels"
	depends on RPMSG_QCOM_GLINK_SMEM || RPMSG_QCOM_GLINK_SLATECOM
	help
	  G-link packet driver provides the interface for the userspace
	  clients to communicate over G-Link via device nodes.
	  This enable the userspace clients to read and write to
	  some glink packets channel.

config RPMSG_QCOM_SMD
	tristate "Qualcomm Shared Memory Driver (SMD)"
	depends on MAILBOX
	depends on QCOM_SMEM
	select RPMSG
	help
	  Say y here to enable support for the Qualcomm Shared Memory Driver
	  providing communication channels to remote processors in Qualcomm
	  platforms.

config RPMSG_QCOM_GLINK_CMA
        tristate "Qualcomm Technologies, Inc. CMA Glink driver"
        select RPMSG_QCOM_GLINK
        depends on MAILBOX
        help
          Say y here to enable support for the GLINK CMA communication driver.
          This provides support for using the GLINK communication protocol over
          share CMA region and IPC signaling. Enables communication channels
          to remote processors.

config MSM_RPM_SMD
	tristate "RPM driver using SMD protocol"
	select RPMSG
	help
	  RPM is the dedicated hardware engine for managing shared SoC
	  resources. This config adds driver support for using SMD as a
	  transport layer communication with RPM hardware. It also selects
	  the MSM_MPM config that programs the MPM module to monitor interrupts
	  during sleep modes.

endmenu
```

## drivers/ttsp/Kconfig
```kconfig
menuconfig CYPRESS_CYTTSP4_BUS
	bool "Cypress TTSP core bus"
	default n
	help
	  This option enables support Cypress TTSP core bus.
	  This support is needed for various device and drivers
	  using Cypress TrueTouch(TM) Standard Product
	  protocol.


config TOUCHSCREEN_CYPRESS_CYTTSP4
	tristate "Cypress TrueTouch Gen4 Touchscreen Driver"
	depends on CYPRESS_CYTTSP4_BUS
	default n
	help
	  Say Y here if you have a Cypress Gen4 touchscreen.

	  If unsure, say N.

	  To compile this driver as a module, choose M here.

config TOUCHSCREEN_CYPRESS_CYTTSP4_DEBUG
	bool "Enable debug output"
	depends on TOUCHSCREEN_CYPRESS_CYTTSP4
	default n

config TOUCHSCREEN_CYPRESS_CYTTSP4_VDEBUG
	bool "Enable verbose debug output"
	depends on TOUCHSCREEN_CYPRESS_CYTTSP4_DEBUG
	default n

config TOUCHSCREEN_CYPRESS_CYTTSP4_I2C
	tristate "Cypress TrueTouch Gen4 I2C"
	depends on (TOUCHSCREEN_CYPRESS_CYTTSP4 && I2C)
	default n

config TOUCHSCREEN_CYPRESS_CYTTSP4_SPI
	tristate "Cypress TrueTouch Gen4 SPI"
	depends on (TOUCHSCREEN_CYPRESS_CYTTSP4 && SPI)
	default n

config TOUCHSCREEN_CYPRESS_CYTTSP4_MT_A
	tristate "Cypress TrueTouch Gen4 MultiTouch Protocol A"
	depends on TOUCHSCREEN_CYPRESS_CYTTSP4
	default n

config TOUCHSCREEN_CYPRESS_CYTTSP4_MT_B
	tristate "Cypress TrueTouch Gen4 MultiTouch Protocol B"
	depends on TOUCHSCREEN_CYPRESS_CYTTSP4
	default n

config TOUCHSCREEN_CYPRESS_CYTTSP4_BUTTON
	tristate "Cypress TrueTouch Gen4 MultiTouch CapSense Button"
	depends on TOUCHSCREEN_CYPRESS_CYTTSP4
	default n

config TOUCHSCREEN_CYPRESS_CYTTSP4_DEVICE_ACCESS
	tristate "Cypress TrueTouch Gen4 MultiTouch Device Access"
	depends on TOUCHSCREEN_CYPRESS_CYTTSP4
	default n

config TOUCHSCREEN_CYPRESS_CYTTSP4_LOADER
	tristate "Cypress TrueTouch Gen4 MultiTouch Loader"
	depends on TOUCHSCREEN_CYPRESS_CYTTSP4
	default n

config TOUCHSCREEN_CYPRESS_CYTTSP4_DEBUG_MODULE
	tristate "Cypress TrueTouch Gen4 MultiTouch Debug Module"
	depends on TOUCHSCREEN_CYPRESS_CYTTSP4
	default n
```

## drivers/tty/serial/Kconfig
```kconfig
# SPDX-License-Identifier: GPL-2.0
#
# Serial device configuration
#

menu "Serial drivers"
	depends on HAS_IOMEM

comment "Non-8250 serial port support"

config SERIAL_MSM_GENI
    tristate "MSM on-chip GENI HW based serial port support"
    depends on ARCH_QCOM
    depends on QCOM_GENI_SE

config SERIAL_QCOM_GENI_MSM
	tristate "QCOM on-chip GENI based serial port support with SCMI"
	depends on ARCH_QCOM || COMPILE_TEST
	depends on QCOM_GENI_SE_MSM
	select SERIAL_CORE
	help
	  This driver supports GENI serial engine based Serial controller
	  on the Qualcomm Technologies Inc.'s SoCs. If you say yes to this
	  option, support will be included for the built-in Serial
	  interface on the Qualcomm Technologies Inc.'s SoCs.

	  This driver can also be built as a module.  If so, the module
	  will be called qcom_geni_serial_msm.

endmenu
```

## drivers/usb/Kconfig
```kconfig
# SPDX-License-Identifier: GPL-2.0
#
# USB device configuration
#

if USB_SUPPORT

source "$(KCONFIG_EXT_PREFIX)drivers/usb/dwc3/Kconfig"

comment "USB port drivers"

source "$(KCONFIG_EXT_PREFIX)drivers/usb/phy/Kconfig"

source "$(KCONFIG_EXT_PREFIX)drivers/usb/gadget/Kconfig"

source "$(KCONFIG_EXT_PREFIX)drivers/usb/typec/Kconfig"

source "$(KCONFIG_EXT_PREFIX)drivers/usb/repeater/Kconfig"

source "$(KCONFIG_EXT_PREFIX)drivers/usb/redriver/Kconfig"

endif # USB_SUPPORT
```

## drivers/usb/gadget/Kconfig
```kconfig
# SPDX-License-Identifier: GPL-2.0
#
# USB Gadget support on a system involves
#    (a) a peripheral controller, and
#    (b) the gadget driver using it.
#
# NOTE:  Gadget support ** DOES NOT ** depend on host-side CONFIG_USB !!
#
#  - Host systems (like PCs) need CONFIG_USB (with "A" jacks).
#  - Peripherals (like PDAs) need CONFIG_USB_GADGET (with "B" jacks).
#  - Some systems have both kinds of controllers.
#
# With help from a special transceiver and a "Mini-AB" jack, systems with
# both kinds of controller can also support "USB On-the-Go" (CONFIG_USB_OTG).
#

if USB_GADGET

#
# USB Gadget Drivers
#

# composite based drivers
config USB_F_CDEV
	tristate

config USB_F_CCID
	tristate

config USB_F_QDSS
	tristate

config USB_F_GSI
	tristate

config USB_F_FS_IPC_LOGGING
        tristate "Enable IPC logging for FunctionFS via f_fs_ipc_log"
	depends on IPC_LOGGING
	depends on ARM64
	help
	 Enables additional debug messages for FunctionFS driver with the help
	 of f_fs_ipc_log module and output via IPC Logging mechanism. This can
	 be useful when troubleshooting transfer stalls or other general
	 failures and determine if the issue is in the kernel gadget or the
	 userspace client. Separate IPC log contexts are created for each
	 function instance at mount time.

# this first set of drivers all depend on bulk-capable hardware.

config USB_CONFIGFS_F_CDEV
	tristate "USB Serial Character function"
	select USB_F_CDEV
	depends on USB_CONFIGFS
	help
	  The serial character function is a generic function driver that
	  exposes a pair of bulk IN and OUT endpoints which are backed by
	  a character device and mapped to its read/write routines. The
	  function also supports a single interrupt IN endpoint for
	  asynchronous notification to the host. This driver is typically
	  used to support DUN/NMEA functions.

config USB_CONFIGFS_F_CCID
	tristate "USB CCID function"
	select USB_F_CCID
	depends on USB_CONFIGFS
	help
	  The Chip Card Interface Device (CCID) function implements a USB
	  interface that exposes a standard CSCID class that consists of a
	  pair of bulk IN and OUT endpoints and a single interrupt IN
	  endpoint. This driver provides a character device interface
	  allowing a userspace component to be able to provide the
	  implementation necessary to interface with the smartcard.

config USB_CONFIGFS_F_QDSS
	tristate "USB QDSS function"
	select USB_F_QDSS
	depends on USB_CONFIGFS
	help
	  USB QDSS function driver to get hwtracing related data over
	  USB. USB QDSS function driver which allows communication
	  between USB BAM and QDSS BAM for QDSS debug functionality
	  over USB.

config USB_CONFIGFS_F_GSI
	tristate "USB GSI function"
	select USB_F_GSI
	depends on USB_CONFIGFS
	help
	  Generic function driver to support h/w acceleration to IPA
	  over GSI. This driver provides USB RMNET/RNDIS/ECM/MBIM/DPL
	  related functionalities using GSI hardware accelerated data
	  path and control path.

endif # USB_GADGET
```

## drivers/usb/typec/Kconfig
```kconfig
# SPDX-License-Identifier: GPL-2.0

if TYPEC

source "$(KCONFIG_EXT_PREFIX)drivers/usb/typec/ucsi/Kconfig"

endif # TYPEC
```

## drivers/video/msm/lcd-bias/Kconfig
```kconfig
config FB_SOMC_MDSS_LCD_BIAS
	bool "LCD voltage bias Driver"
	depends on I2C
	default n
	---help---
	The LCD bias driver provides support for setting the LCD bias voltage
	for LCD driver IC
```

## drivers/video/msm/mdss/Kconfig
```kconfig
config FB_MSM_MDSS_WRITEBACK
	bool "MDSS Writeback Panel"
	---help---
	The MDSS Writeback Panel provides support for routing the output of
	MDSS frame buffer driver and MDP processing to memory.

config FB_MSM_MDSS_SPECIFIC_PANEL
	depends on FB_MSM_MDSS
	bool
	prompt "MDSS Specific panel"
	default n
	---help---
	The MDSS Specific Panel provides support for specific panel driver
	file.

config FB_MSM_MDSS_HDMI_PANEL
	depends on FB_MSM_MDSS
	bool "MDSS HDMI Tx Panel"
	default n
	---help---
	The MDSS HDMI Panel provides support for transmitting TMDS signals of
	MDSS frame buffer data to connected hdmi compliant TVs, monitors etc.

config FB_MSM_MDSS_HDMI_MHL_SII8334
	depends on FB_MSM_MDSS_HDMI_PANEL
	bool 'MHL SII8334 support '
	default n
	---help---
	  Support the HDMI to MHL conversion.
	  MHL (Mobile High-Definition Link) technology
	  uses USB connector to output HDMI content

config FB_MSM_MDSS_SUB_AREA_TABLE_51
	bool "MDSS white tuning table"
	default n
```
