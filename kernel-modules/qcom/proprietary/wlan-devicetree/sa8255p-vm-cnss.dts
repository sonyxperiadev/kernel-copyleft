/dts-v1/;
/plugin/;

#include "sa8255p-vm-cnss.dtsi"

/ {
	model = "Qualcomm Technologies, Inc. Lemans IVI ADP AIR";
	compatible = "qcom,lemans-ivi", "qcom,lemans", "qcom,adp-air", "qcom,lemans-ivi-adp-air";
	qcom,msm-id = <532 0x10000>, <532 0x20000>, <534 0x10000>;
	qcom,board-id = <0x10019 0>, <0x1010019 0>, <0x0 0x1000001>, <0x0 0x2000001>;
};
