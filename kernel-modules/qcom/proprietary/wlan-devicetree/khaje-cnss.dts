/dts-v1/;
/plugin/;

#include "khaje-cnss.dtsi"

/ {
	model = "Qualcomm Technologies, Inc. Khaje SoC";
	compatible = "qcom,khaje";
	qcom,msm-id = <518 0x10000>, <585 0x10000>, <586 0x10000>;
	qcom,board-id = <0 0>, <0 0x500>;
};
