/dts-v1/;
/plugin/;

#include "lemans-cnss.dtsi"

/ {
	model = "Qualcomm Technologies, Inc. Lemans SoC";
	compatible = "qcom,lemans-ivi", "qcom,lemans", "qcom,adp-air", "qcom,lemans-ivi-adp-air";
	qcom,msm-id = <532 0x10000>, <534 0x10000>;
	qcom,board-id = <0x10019 0>, <0x1010019 0>, <0x10025 0>;
};
