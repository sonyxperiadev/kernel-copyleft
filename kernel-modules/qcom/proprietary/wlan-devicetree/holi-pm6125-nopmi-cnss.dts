/dts-v1/;
/plugin/;

#include "holi-pm6125-cnss.dtsi"

/ {
	model = "Qualcomm Technologies, Inc. Holi PM6125 NOPMI";
	compatible = "qcom,holi-qrd", "qcom,qrd", "qcom,holi-mtp", "qcom,holi", "qcom,mtp";
	qcom,msm-id = <454 0x10000>, <472 0x10000>;
	qcom,board-id = <0xb 0>, <8 0>;
	qcom,pmic-id-size = <4>;
	qcom,pmic-id = <0x2D 0x0 0x0 0x0>;
};
