/dts-v1/;
/plugin/;
#include "monaco_auto-cnss.dtsi"
/ {
	model = "Qualcomm Technologies, Inc. Monaco AUTO";
	compatible = "qcom,monaco_auto-ivi", "qcom,monaco_auto", "qcom,adp-air", "qcom,monaco_auto-ivi-adp-air";
	qcom,msm-id = <606 0x10000>;
	qcom,board-id = <0x30019 0>, <0x1010019 0>;
};
