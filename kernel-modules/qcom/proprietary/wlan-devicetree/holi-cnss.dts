/dts-v1/;
/plugin/;

#include "holi-cnss.dtsi"

/ {
	model = "Qualcomm Technologies, Inc. Holi";
	compatible = "qcom,holi";
	qcom,msm-id = <454 0x10000>, <472 0x10000>;
	qcom,board-id = <33 0>, <1 0>, <1 1>, <8 0>, <8 1>, <0xb 0>, <0x1000B 0>;
	qcom,pmic-id-size = <4>;
	qcom,pmic-id = <0x36 0x0 0x2E 0x0>;
};
