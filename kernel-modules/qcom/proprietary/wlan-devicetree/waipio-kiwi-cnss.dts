/dts-v1/;
/plugin/;

#include "waipio-kiwi-cnss.dtsi"

/ {
	model = "Qualcomm Technologies, Inc. Waipio SoCs";
	compatible = "qcom,waipio", "qcom,waipiop";
	qcom,msm-id = <457 0x10000>, <482 0x10000>,
		      <457 0x20000>, <482 0x20000>;
	qcom,board-id = <0x02010008 0>, <0x04010008 0x04>;
};
