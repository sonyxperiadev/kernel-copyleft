## kernel/fels/Kconfig
```kconfig
config FELS
	tristate "support kernel logging system for driver"
	help
	  fels(Fatal Error Logging System) provide logging framework to upload
	  kernel logs to IDD/RCA in the case of user variant software in production
	  environment.
```

## security/sony/Kconfig
```kconfig
config SECURITY_SONY_RIC
	bool "Sony RIC support"
	depends on SECURITY
	select SECURITYFS
	default n
	help
	  This selects Sony Runtime Integrity Check security module.
	  This is to validate mount syscalls on configured disk partitions.
	  Various partitions and the permissive mount flags can be configured
	  through device tree.
	  If you are unsure how to answer this question, answer N.
```

## sound/soc/codecs/sdm660_cdc/Kconfig
```kconfig
config SND_SOC_SDM660_CDC
	tristate "MSM Internal PMIC based codec"

config HIGH_VOL_MIC
	tristate "Config 2.7v microphone"
```

## techpack/bt-kernel/btfmcodec/Kconfig
```kconfig
# SPDX-License-Identifier: GPL-2.0-only
config BTFM_CODEC
	tristate "MSM Bluetooth/FM CODEC Driver"
	help
		This will enables BT/FM Codec driver. Hardware endpoint
		drivers will register to this driver to communicates with ALSA codec
		driver.

		Say Y here to compile support for BT/FM Codec driver
		into the kernel or say M to compile as a module.
```

## techpack/bt-kernel/slimbus/Kconfig
```kconfig
# SPDX-License-Identifier: GPL-2.0-only

config BTFM_SLIM
	tristate "MSM Bluetooth/FM Slimbus Device"
	depends on MSM_BT_POWER
	help
		This enables BT/FM slimbus driver to get multiple audio channel.
		This will make use of slimbus platform driver and slimbus
		codec driver to communicate with slimbus machine driver and LPSS which
		is Slimbus master.Slimbus slave initialization and configuration
		will be done through this driver.

		Say Y here to compile support for Bluetooth slimbus driver
		into the kernel or say M to compile as a module.

config SLIM_BTFM_CODEC
	tristate "MSM Bluetooth/FM Slimbus Device using BTFM codec driver"
	depends on MSM_BT_POWER
	depends on BTFM_CODEC
	help
		This enables BT/FM slimbus driver to use btfm codec driver as
		interface to interacts with codec driver.

		Say Y here to compile support for Bluetooth slimbus driver
		into the kernel or say M to compile as a module.
```

## techpack/bt-kernel/soundwire/Kconfig
```kconfig
config BTFM_SWR
	tristate "MSM Bluetooth/FM SoundWire Device"
	depends on MSM_BT_POWER
	help
		This enables BT/FM soundwire driver to open/close ports.
		This will make use of soundwire bus driver and soundwire
		master driver to communicate with soundwire slave.

		Say Y here to compile support for Bluetooth/FM soundwire slave driver
		into the kernel or say M to compile as a module.
```

## techpack/camera-kernel/Kconfig
```kconfig
config SPECTRA_ISP
	bool "enable camera ISP module"
	help
	  This is enabling camera ISP module.
	  IFE camera driver file be included.
	  This will enable camera ISP driver to handle IFE driver.
	  Core camera driver to handle VFE HW.

config SPECTRA_ICP
	bool "enable camera ICP module"
	help
	  This is enabling camera ICP module.
	  Camera ICP driver file be included.
	  This will enable camera ICP driver to interact with,
	  ICP FW. Which can control IPE and BPS HW.

config SPECTRA_JPEG
	bool "enable camera jpeg module"
	help
	  This is enabling camera JPEG module.
	  camera jpeg module will be functional.
	  This module interact with jpeg HW for
	  snapshot processing.
config SPECTRA_CRE
	bool "enable camera jpeg module"
	help
	  This is enabling camera CRE module.
	  camera cre module will be functional.
	  This module interact with cre HW for
	  format conversion.
config SPECTRA_SENSOR
	bool "enable camera sensor module"
	help
	  This is enabling camera sensor module.
	  sensor module files will be included to enable the driver.
	  eeprom, flash, csiphy all other module will be included
	  to make the sensor functional.

config SPECTRA_USE_CLK_CRM_API
	bool "enable camera cesta clk feature"
	help
	  This is enabling camera cesta feature.
	  kernel clk driver api will cache the clk value
	  send by camera hw and apply to CRM hw.
	  CRM hw will consolidate and apply the clk to camera HW.

config SPECTRA_USE_RPMH_DRV_API
	bool "enable camera new ICC BW api"
	help
	  This is helping to set BW through kernel icc driver.
	  Kernel icc driver do caching the bw information.
	  icc driver will update the bw information RPMH,
	  to apply proper bw voting for camera to mmnoc

config SPECTRA_LLCC_STALING
	bool "enable camera new LLCC staling feature"
	help
	  This will enable to call LLCC driver cache notification API
	  and increment count API.
	  Which will enable LLCC staling feature,based on counter
	  invalidate the cache slice.

config TARGET_SYNX_ENABLE
	bool "enable HW synx"
	help
	  This is enabling HW syx feature.
	  synx hw signaling external to camera,
	  like EVA and other.
	  This is to avoid sw signaling latency.

config MSM_MMRM
	bool "enable MSM MMRM"
	help
	  This is enabling mmrm api access.
	  mmrm to cahce the clk voting.
	  mmrm knows about all clients' clock rates.
	  MMRM can decide whether new peak power usage is within allowed value

config INTERCONNECT_QCOM
	bool "enabling icc bus driver"
	help
		This is to access icc driver api.
		To cache AB and IB vote will
		use ICC kernel driver API.
		So that ICC driver can consolidate the vote

config DOMAIN_ID_SECURE_CAMERA
	bool "enable domain ID based secure camera flow"
	help
		This is to enable domain ID based secure
		camera flow on the hardware platforms with
		domain ID based security architecture.
		VC based security can be achieved with this.

config DYNAMIC_FD_PORT_CONFIG
	bool "enable dynamic FD port config feature"
	help
		This config enables dynamic FD port config
		feature that allows the userspace to configure
		the FD port to secure or non-secure based on
		the FD solution in use in secure camera use cases.
```
