/* Copyright (c) 2013, Code Aurora Forum. All rights reserved.
 * Copyright (C) 2013-2014 Sony Mobile Communications AB.
 *
 * This program is free software; you can redistribute it and/or modify
 * it under the terms of the GNU General Public License version 2 and
 * only version 2 as published by the Free Software Foundation.
 *
 * This program is distributed in the hope that it will be useful,
 * but WITHOUT ANY WARRANTY; without even the implied warranty of
 * MERCHANTABILITY or FITNESS FOR A PARTICULAR PURPOSE.  See the
 * GNU General Public License for more details.
 */

&mdss_mdp {
	dsi_renesas_jdi_1080_vid: somc,renesas_jdi_1080p_panel {
		qcom,mdss-dsi-panel-name = "jdi renesas 1080p video";
		qcom,mdss-dsi-panel-controller = <&mdss_dsi0>;
		qcom,mdss-dsi-panel-type = "dsi_video_mode";
		qcom,mdss-dsi-panel-destination = "display_1";
		qcom,mdss-dsi-panel-framerate = <60>;
		qcom,mdss-dsi-virtual-channel-id = <0>;
		qcom,mdss-dsi-stream = <0>;
		qcom,mdss-dsi-panel-width = <1080>;
		qcom,mdss-dsi-panel-height = <1920>;
		qcom,mdss-dsi-h-front-porch = <112>;
		qcom,mdss-dsi-h-back-porch = <76>;
		qcom,mdss-dsi-h-pulse-width = <4>;
		qcom,mdss-dsi-h-sync-skew = <0>;
		qcom,mdss-dsi-v-back-porch = <4>;
		qcom,mdss-dsi-v-front-porch = <31>;
		qcom,mdss-dsi-v-pulse-width = <4>;
		qcom,mdss-dsi-h-left-border = <0>;
		qcom,mdss-dsi-h-right-border = <0>;
		qcom,mdss-dsi-v-top-border = <0>;
		qcom,mdss-dsi-v-bottom-border = <0>;
		qcom,mdss-dsi-bpp = <24>;
		qcom,mdss-dsi-underflow-color = <0x0>;
		qcom,mdss-dsi-border-color = <0>;
		somc,mdss-dsi-init-command = [05 01 00 00 05 00 01 01
			23 01 00 00 00 00 02 B0 00];
		qcom,mdss-dsi-on-command = [15 01 00 00 00 00 02 36 C0
			05 01 00 00 78 00 01 11
			05 01 00 00 00 00 01 29];
		qcom,mdss-dsi-off-command = [05 01 00 00 14 00 01 28
				05 01 00 00 50 00 01 10];
		qcom,mdss-dsi-on-command-state = "dsi_lp_mode";
		qcom,mdss-dsi-off-command-state = "dsi_hs_mode";
		qcom,mdss-dsi-h-sync-pulse = <1>;
		qcom,mdss-dsi-traffic-mode = "non_burst_sync_event";
		qcom,mdss-dsi-bllp-eof-power-mode;
		qcom,mdss-dsi-bllp-power-mode;
		qcom,mdss-dsi-lane-0-state;
		qcom,mdss-dsi-lane-1-state;
		qcom,mdss-dsi-lane-2-state;
		qcom,mdss-dsi-lane-3-state;
		qcom,mdss-dsi-panel-timings = [E6 38 26 00 68 6E 2A 3C 2C 03 04 00];
		qcom,mdss-dsi-t-clk-post = <0x02>;
		qcom,mdss-dsi-t-clk-pre = <0x2B>;
		qcom,mdss-dsi-bl-min-level = <1>;
		qcom,mdss-dsi-bl-max-level = <4095>;
		qcom,mdss-brightness-max-level = <4095>;
		qcom,mdss-dsi-dma-trigger = "trigger_sw";
		qcom,mdss-dsi-mdp-trigger = "none";
		qcom,mdss-dsi-bl-pmic-control-type = "bl_ctrl_wled";
		qcom,mdss-dsi-pan-enable-dynamic-fps;
		qcom,mdss-dsi-pan-fps-update = "dfps_suspend_resume_mode";
		qcom,cont-splash-enabled;

		somc,driver-ic = <0>;
		somc,dric-gpio = <&msmgpio 26 0>;
		somc,mul-channel-scaling = <3>;
		somc,mdss-phy-size-mm = <64 114>;
		somc,mdss-dsi-lane-config = [00 c2 ef 00 00 00 00 01 75
				00 c2 ef 00 00 00 00 01 75
				00 c2 ef 00 00 00 00 01 75
				00 c2 ef 00 00 00 00 01 75
				00 02 45 00 00 00 00 01 97];
		somc,mdss-dsi-disp-on-in-hs = <1>;
		somc,lcd-id = <1>;
		somc,lcd-id-adc = <1705000 1899000>;
		somc,disp-en-on-pre = <5>;
		somc,disp-en-on-post = <15>;
		somc,disp-en-off-post = <70>;
		somc,pw-on-rst-seq = <1 10>;
		somc,pw-off-rst-seq = <0 0>;

		somc,mdss-dsi-pre-uv-command = [23 01 00 00 00 00 02 B0 00];
		somc,mdss-dsi-uv-command = [06 01 00 00 00 00 01 DA
				06 01 00 00 00 00 01 DB];
		somc,mdss-dsi-uv-param-type = <4>;
		somc,mdss-dsi-pcc-table-size = <40>;
		somc,mdss-dsi-pcc-table = <
			0x00 0x01 0x20 0x23 0x28 0x2B 0x7300 0x7800 0x7f00
			0x00 0x02 0x1C 0x1F 0x28 0x2B 0x7700 0x7800 0x8000
			0x00 0x03 0x18 0x1B 0x28 0x2B 0x7880 0x7600 0x7f00
			0x00 0x04 0x14 0x17 0x28 0x2B 0x7d00 0x7700 0x8000
			0x00 0x05 0x20 0x23 0x24 0x27 0x7600 0x7b00 0x8000
			0x00 0x06 0x1C 0x1F 0x24 0x27 0x7880 0x7a00 0x7f80
			0x00 0x07 0x18 0x1B 0x24 0x27 0x7c80 0x7a00 0x8000
			0x00 0x08 0x14 0x17 0x24 0x27 0x7f80 0x7980 0x7f80
			0x00 0x09 0x20 0x23 0x20 0x23 0x7900 0x7e00 0x8000
			0x00 0x0A 0x1C 0x1F 0x20 0x23 0x7c00 0x7d00 0x8000
			0x00 0x0B 0x18 0x1B 0x20 0x23 0x7f80 0x7d00 0x8000
			0x00 0x0C 0x14 0x17 0x20 0x23 0x8000 0x7a00 0x7d00
			0x00 0x0D 0x20 0x23 0x1C 0x1F 0x7c00 0x8000 0x7f80
			0x00 0xFF 0x1C 0x1F 0x1C 0x1F 0x8000 0x8000 0x8000
			0x00 0x0E 0x18 0x1B 0x1C 0x1F 0x8000 0x7c80 0x7b80
			0x00 0x0F 0x14 0x17 0x1C 0x1F 0x7f00 0x7800 0x7780
			0x00 0x10 0x20 0x23 0x18 0x1B 0x7b80 0x7f80 0x7c00
			0x00 0x11 0x1C 0x1F 0x18 0x1B 0x7f80 0x7f80 0x7c80
			0x00 0x12 0x18 0x1B 0x18 0x1B 0x8000 0x7d00 0x7a00
			0x00 0x13 0x14 0x17 0x18 0x1B 0x8000 0x7980 0x7680
			0x00 0x14 0x20 0x23 0x14 0x17 0x7c00 0x8000 0x7980
			0x00 0x15 0x1C 0x1F 0x14 0x17 0x7f80 0x7f80 0x7a00
			0x00 0x16 0x18 0x1B 0x14 0x17 0x8000 0x7c80 0x7780
			0x00 0x17 0x14 0x17 0x14 0x17 0x8000 0x7980 0x7400
			0x00 0x18 0x20 0x23 0x10 0x13 0x7c80 0x8000 0x7800
			0x00 0x19 0x1C 0x1F 0x10 0x13 0x7f80 0x8000 0x7800
			0x00 0x1A 0x18 0x1B 0x10 0x13 0x7f00 0x7c00 0x7580
			0x00 0x1B 0x14 0x17 0x10 0x13 0x7f80 0x7900 0x7200
			0x00 0x1C 0x24 0x27 0x28 0x2B 0x6f80 0x7780 0x8000
			0x00 0x1D 0x24 0x27 0x1E 0x27 0x7780 0x7f00 0x7f80
			0x00 0x1E 0x24 0x27 0x14 0x1D 0x7880 0x8000 0x7900
			0x00 0x1F 0x24 0x27 0x10 0x13 0x7800 0x8000 0x7700
			0x01 0x00 0x00 0x13 0x28 0x3B 0x7f80 0x6e00 0x8000
			0x02 0x00 0x14 0x27 0x2C 0x3B 0x6c00 0x6d80 0x8000
			0x03 0x00 0x28 0x3B 0x28 0x3B 0x6280 0x7000 0x8000
			0x04 0x00 0x00 0x13 0x14 0x27 0x8000 0x6e00 0x6f80
			0x05 0x00 0x28 0x3B 0x14 0x27 0x6f00 0x8000 0x7e80
			0x06 0x00 0x00 0x13 0x00 0x13 0x8000 0x6d80 0x6500
			0x07 0x00 0x14 0x27 0x00 0x0F 0x8000 0x8000 0x7180
			0x08 0x00 0x28 0x3B 0x00 0x13 0x6e00 0x8000 0x7000>;
	};

	dsi_default_gpio_0: somc,default_panel_0 {
		qcom,mdss-dsi-panel-name = "default renesas video";
		qcom,mdss-dsi-panel-controller = <&mdss_dsi0>;
		qcom,mdss-dsi-panel-type = "dsi_video_mode";
		qcom,mdss-dsi-panel-destination = "display_1";
		qcom,mdss-dsi-panel-framerate = <60>;
		qcom,mdss-dsi-virtual-channel-id = <0>;
		qcom,mdss-dsi-stream = <0>;
		qcom,mdss-dsi-panel-width = <1080>;
		qcom,mdss-dsi-panel-height = <1920>;
		qcom,mdss-dsi-h-front-porch = <112>;
		qcom,mdss-dsi-h-back-porch = <76>;
		qcom,mdss-dsi-h-pulse-width = <4>;
		qcom,mdss-dsi-h-sync-skew = <0>;
		qcom,mdss-dsi-v-back-porch = <4>;
		qcom,mdss-dsi-v-front-porch = <31>;
		qcom,mdss-dsi-v-pulse-width = <4>;
		qcom,mdss-dsi-h-left-border = <0>;
		qcom,mdss-dsi-h-right-border = <0>;
		qcom,mdss-dsi-v-top-border = <0>;
		qcom,mdss-dsi-v-bottom-border = <0>;
		qcom,mdss-dsi-bpp = <24>;
		qcom,mdss-dsi-underflow-color = <0x0>;
		qcom,mdss-dsi-border-color = <0>;
		somc,mdss-dsi-init-command = [05 01 00 00 05 00 01 01
			23 01 00 00 00 00 02 B0 00];
		qcom,mdss-dsi-on-command = [15 01 00 00 00 00 02 36 C0
			05 01 00 00 78 00 01 11
			05 01 00 00 00 00 01 29];
		qcom,mdss-dsi-off-command = [05 01 00 00 14 00 01 28
				05 01 00 00 50 00 01 10];
		qcom,mdss-dsi-on-command-state = "dsi_lp_mode";
		qcom,mdss-dsi-off-command-state = "dsi_hs_mode";
		qcom,mdss-dsi-h-sync-pulse = <1>;
		qcom,mdss-dsi-traffic-mode = "non_burst_sync_event";
		qcom,mdss-dsi-bllp-eof-power-mode;
		qcom,mdss-dsi-bllp-power-mode;
		qcom,mdss-dsi-lane-0-state;
		qcom,mdss-dsi-lane-1-state;
		qcom,mdss-dsi-lane-2-state;
		qcom,mdss-dsi-lane-3-state;
		qcom,mdss-dsi-panel-timings = [E6 38 26 00 68 6E 2A 3C 2C 03 04 00];
		qcom,mdss-dsi-t-clk-post = <0x02>;
		qcom,mdss-dsi-t-clk-pre = <0x2B>;
		qcom,mdss-dsi-bl-min-level = <1>;
		qcom,mdss-dsi-bl-max-level = <4095>;
		qcom,mdss-brightness-max-level = <4095>;
		qcom,mdss-dsi-dma-trigger = "trigger_sw";
		qcom,mdss-dsi-mdp-trigger = "none";
		qcom,mdss-dsi-bl-pmic-control-type = "bl_ctrl_wled";
		qcom,mdss-dsi-pan-enable-dynamic-fps;
		qcom,mdss-dsi-pan-fps-update = "dfps_suspend_resume_mode";
		qcom,cont-splash-enabled;

		somc,driver-ic = <0>;
		somc,dric-gpio = <&msmgpio 26 0>;
		somc,mul-channel-scaling = <3>;
		somc,mdss-phy-size-mm = <64 114>;
		somc,mdss-dsi-lane-config = [00 c2 ef 00 00 00 00 01 75
				00 c2 ef 00 00 00 00 01 75
				00 c2 ef 00 00 00 00 01 75
				00 c2 ef 00 00 00 00 01 75
				00 02 45 00 00 00 00 01 97];
		somc,mdss-dsi-disp-on-in-hs = <1>;
		somc,lcd-id = <0>;
		somc,lcd-id-adc = <0 0x7fffffff>;
		somc,disp-en-on-pre = <5>;
		somc,disp-en-on-post = <15>;
		somc,disp-en-off-post = <70>;
		somc,pw-on-rst-seq = <1 10>;
		somc,pw-off-rst-seq = <0 0>;
	};

	dsi_default_gpio_1: somc,default_panel_1 {
		qcom,mdss-dsi-panel-name = "default renesas video";
		qcom,mdss-dsi-panel-controller = <&mdss_dsi0>;
		qcom,mdss-dsi-panel-type = "dsi_video_mode";
		qcom,mdss-dsi-panel-destination = "display_1";
		qcom,mdss-dsi-panel-framerate = <60>;
		qcom,mdss-dsi-virtual-channel-id = <0>;
		qcom,mdss-dsi-stream = <0>;
		qcom,mdss-dsi-panel-width = <1080>;
		qcom,mdss-dsi-panel-height = <1920>;
		qcom,mdss-dsi-h-front-porch = <112>;
		qcom,mdss-dsi-h-back-porch = <76>;
		qcom,mdss-dsi-h-pulse-width = <4>;
		qcom,mdss-dsi-h-sync-skew = <0>;
		qcom,mdss-dsi-v-back-porch = <4>;
		qcom,mdss-dsi-v-front-porch = <31>;
		qcom,mdss-dsi-v-pulse-width = <4>;
		qcom,mdss-dsi-h-left-border = <0>;
		qcom,mdss-dsi-h-right-border = <0>;
		qcom,mdss-dsi-v-top-border = <0>;
		qcom,mdss-dsi-v-bottom-border = <0>;
		qcom,mdss-dsi-bpp = <24>;
		qcom,mdss-dsi-underflow-color = <0x0>;
		qcom,mdss-dsi-border-color = <0>;
		somc,mdss-dsi-init-command = [05 01 00 00 05 00 01 01
			23 01 00 00 00 00 02 B0 00];
		qcom,mdss-dsi-on-command = [15 01 00 00 00 00 02 36 C0
			05 01 00 00 78 00 01 11
			05 01 00 00 00 00 01 29];
		qcom,mdss-dsi-off-command = [05 01 00 00 14 00 01 28
				05 01 00 00 50 00 01 10];
		qcom,mdss-dsi-on-command-state = "dsi_lp_mode";
		qcom,mdss-dsi-off-command-state = "dsi_hs_mode";
		qcom,mdss-dsi-h-sync-pulse = <1>;
		qcom,mdss-dsi-traffic-mode = "non_burst_sync_event";
		qcom,mdss-dsi-bllp-eof-power-mode;
		qcom,mdss-dsi-bllp-power-mode;
		qcom,mdss-dsi-lane-0-state;
		qcom,mdss-dsi-lane-1-state;
		qcom,mdss-dsi-lane-2-state;
		qcom,mdss-dsi-lane-3-state;
		qcom,mdss-dsi-panel-timings = [E6 38 26 00 68 6E 2A 3C 2C 03 04 00];
		qcom,mdss-dsi-t-clk-post = <0x02>;
		qcom,mdss-dsi-t-clk-pre = <0x2B>;
		qcom,mdss-dsi-bl-min-level = <1>;
		qcom,mdss-dsi-bl-max-level = <4095>;
		qcom,mdss-brightness-max-level = <4095>;
		qcom,mdss-dsi-dma-trigger = "trigger_sw";
		qcom,mdss-dsi-mdp-trigger = "none";
		qcom,mdss-dsi-bl-pmic-control-type = "bl_ctrl_wled";
		qcom,mdss-dsi-pan-enable-dynamic-fps;
		qcom,mdss-dsi-pan-fps-update = "dfps_suspend_resume_mode";
		qcom,cont-splash-enabled;

		somc,driver-ic = <0>;
		somc,dric-gpio = <&msmgpio 26 0>;
		somc,mul-channel-scaling = <3>;
		somc,mdss-phy-size-mm = <64 114>;
		somc,mdss-dsi-lane-config = [00 c2 ef 00 00 00 00 01 75
				00 c2 ef 00 00 00 00 01 75
				00 c2 ef 00 00 00 00 01 75
				00 c2 ef 00 00 00 00 01 75
				00 02 45 00 00 00 00 01 97];
		somc,mdss-dsi-disp-on-in-hs = <1>;
		somc,lcd-id = <1>;
		somc,lcd-id-adc = <0 0x7fffffff>;
		somc,disp-en-on-pre = <5>;
		somc,disp-en-on-post = <15>;
		somc,disp-en-off-post = <70>;
		somc,pw-on-rst-seq = <1 10>;
		somc,pw-off-rst-seq = <0 0>;
	};

};
