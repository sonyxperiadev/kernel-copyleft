/* arch/arm/boot/dts/msm8974-v2-rhine_honami_row.dts
 *
 * Copyright (C) 2013 Sony Mobile Communications AB.
 *
 * Author: Yukito Naganuma <Yukito.X.Naganuma@sonymobile.com>
 *
 * This program is free software; you can redistribute it and/or modify
 * it under the terms of the GNU General Public License version 2 and
 * only version 2 as published by the Free Software Foundation.
 *
 * This program is distributed in the hope that it will be useful,
 * but WITHOUT ANY WARRANTY; without even the implied warranty of
 * MERCHANTABILITY or FITNESS FOR A PARTICULAR PURPOSE.  See the
 * GNU General Public License for more details.
 */

/dts-v1/;

/include/ "msm8974-v2.dtsi"
/include/ "msm8974-mtp.dtsi"
/include/ "dsi-panel-honami.dtsi"
/include/ "msm8974-rhine_honami_row.dtsi"

/ {
	model = "SoMC Honami ROW";
	compatible = "somc,honami-row", "qcom,msm8974";
	qcom,msm-id = <126 8 0x20000>,
		      <185 8 0x20000>,
		      <186 8 0x20000>;
};
