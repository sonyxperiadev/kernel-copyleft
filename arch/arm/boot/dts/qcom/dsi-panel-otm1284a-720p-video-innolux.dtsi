/* Copyright (c) 2013-2014, The Linux Foundation. All rights reserved.
 *
 * This program is free software; you can redistribute it and/or modify
 * it under the terms of the GNU General Public License version 2 and
 * only version 2 as published by the Free Software Foundation.
 *
 * This program is distributed in the hope that it will be useful,
 * but WITHOUT ANY WARRANTY; without even the implied warranty of
 * MERCHANTABILITY or FITNESS FOR A PARTICULAR PURPOSE.  See the
 * GNU General Public License for more details.
 */

/*---------------------------------------------------------------------------
 * This file is autogenerated file using gcdb parser. Please do not edit it.
 * Update input XML file to add a new entry or update variable in this file
 * VERSION = "1.0"
 *---------------------------------------------------------------------------*/
&mdss_mdp {
	dsi_otm1284a_720_vid_innolux: qcom,dsi_otm1284a_720_vid_innolux {
		compatible = "qcom,mdss-dsi-panel-innolux_otm";
		qcom,mdss-dsi-panel-name = "otm1284a 720p video mode dsi panel innolux";
		qcom,mdss-dsi-panel-controller = <&mdss_dsi0>;
		qcom,mdss-dsi-panel-type = "dsi_video_mode";
		qcom,mdss-dsi-panel-destination = "display_1";
		qcom,mdss-dsi-panel-framerate = <60>;
		qcom,mdss-dsi-virtual-channel-id = <0>;
		qcom,mdss-dsi-stream = <0>;
		qcom,mdss-pan-physical-width-dimension = <65>;
		qcom,mdss-pan-physical-height-dimension = <116>;
		qcom,mdss-dsi-panel-width = <720>;
		qcom,mdss-dsi-panel-height = <1280>;
		qcom,mdss-dsi-h-front-porch = <44>;
		qcom,mdss-dsi-h-back-porch = <42>;
		qcom,mdss-dsi-h-pulse-width = <2>;
		qcom,mdss-dsi-h-sync-skew = <0>;
		qcom,mdss-dsi-v-back-porch = <14>;
		qcom,mdss-dsi-v-front-porch = <16>;
		qcom,mdss-dsi-v-pulse-width = <2>;

		qcom,mdss-dsi-h-left-border = <0>;
		qcom,mdss-dsi-h-right-border = <0>;
		qcom,mdss-dsi-v-top-border = <0>;
		qcom,mdss-dsi-v-bottom-border = <0>;
		qcom,mdss-dsi-bpp = <24>;
		qcom,mdss-dsi-underflow-color = <0xff>;
		qcom,mdss-dsi-border-color = <0>;
		qcom,mdss-dsi-pixel-packing = "tight";
		qcom,mdss-dsi-on-command-71 = [
			//CMD2
			29 01 00 00 00 00 02 00 00
			29 01 00 00 00 00 04 FF 12 84 01
			//Orise mode enable
			29 01 00 00 00 00 02 00 80
			29 01 00 00 00 00 03 FF 12 84
			//MIPI 4 Lane
			29 01 00 00 00 00 02 00 92
			29 01 00 00 00 00 03 FF 30 02
			//TCON Setting
			29 01 00 00 00 00 02 00 80
			29 01 00 00 00 00 0A C0 00 64 00 10 10 00 64 10 10
			//Panel Timing Setting
			29 01 00 00 00 00 02 00 90
			29 01 00 00 00 00 07 C0 00 5C 00 01 00 04
			//Interval Scan Frame:0 frame,column inversion
			29 01 00 00 00 00 02 00 B3
			29 01 00 00 00 00 03 C0 00 55
			//FRAME RATE : 60Hz
			29 01 00 00 00 00 02 00 81
			29 01 00 00 00 00 02 C1 55
			//Boost VSP control Setting
			29 01 00 00 00 00 02 00 A0
			29 01 00 00 00 00 0F C4 05 10 04 02 05 15 11 05 10 07 02 05 15 11
			//Boost Clamp Setting
			29 01 00 00 00 00 02 00 B0
			29 01 00 00 00 00 03 C4 00 00
			//VGH=18V,VGL=-10V,pump ratio:VGH=8x,VGL=5x
			29 01 00 00 00 00 02 00 91
			29 01 00 00 00 00 03 C5 A6 D2
			//GVDD=5.008V,NGVDD=-5.008V
			29 01 00 00 00 00 02 00 00
			/*MM-GL-DISPLAY-panel-01-*///29 01 00 00 00 00 03 D8 C7 C7
			29 01 00 00 00 00 03 D8 F6 F6/*MM-GL-DISPLAY-panel-01+*/
			//VDD_18V=1.7V,LVDSVDD=1.6V
			29 01 00 00 00 00 02 00 B3
			29 01 00 00 00 00 02 C5 84
			//LVD voltage level setting
			29 01 00 00 00 00 02 00 BB
			29 01 00 00 00 00 02 C5 8A
			//chopper
			29 01 00 00 00 00 02 00 82
			29 01 00 00 00 00 02 C4 0A
			//debounce
			29 01 00 00 00 00 02 00 C6
			29 01 00 00 00 00 02 B0 03
			//precharge disable
			29 01 00 00 00 00 02 00 C2
			29 01 00 00 00 00 02 F5 40
			//sample hold gvdd
			29 01 00 00 00 00 02 00 C3
			29 01 00 00 00 00 02 F5 85
			//en op
			29 01 00 00 00 00 02 00 87
			29 01 00 00 00 00 02 C4 18
			//VGLO1
			29 01 00 00 00 00 02 00 B2
			29 01 00 00 00 00 03 F5 00 00
			//VGLO1_S
			29 01 00 00 00 00 02 00 B4
			29 01 00 00 00 00 03 F5 00 00
			//VGLO2
			29 01 00 00 00 00 02 00 B6
			29 01 00 00 00 00 03 F5 00 00
			//VGLO2_S
			29 01 00 00 00 00 02 00 B8
			29 01 00 00 00 00 03 F5 00 00
			//VCL pump dis
			29 01 00 00 00 00 02 00 94
			29 01 00 00 00 00 03 F5 00 00
			//VCL reg. en
			29 01 00 00 00 00 02 00 D2
			29 01 00 00 00 00 03 F5 06 15
			//VGLO1/2 Pull low setting ;VGLO1 ,VGLO2
			29 01 00 00 00 00 02 00 B4
			29 01 00 00 00 00 02 C5 CC
			//MODE-3
			29 01 00 00 00 00 02 00 90
			29 01 00 00 00 00 05 F5 02 11 02 15
			//VPNL
			29 01 00 00 00 00 02 00 90
			29 01 00 00 00 00 02 C5 50
			//Frequency
			29 01 00 00 00 00 02 00 94
			29 01 00 00 00 00 02 C5 66
			/*MM-GL-DISPLAY-panel-01+[*/
			29 01 00 00 00 00 02 00 95
			29 01 00 00 00 00 02 C5 34
			29 01 00 00 00 00 02 00 96
			29 01 00 00 00 00 02 C5 80
			/*MM-GL-DISPLAY-panel-01+]*/
			//panel timing settinf control
			29 01 00 00 00 00 02 00 80
			29 01 00 00 00 00 0C CB 00 00 00 00 00 00 00 00 00 00 00
			29 01 00 00 00 00 02 00 90
			29 01 00 00 00 00 10 CB 00 00 00 00 00 00 00 00 00 00 00 00 00 00 00
			29 01 00 00 00 00 02 00 A0
			29 01 00 00 00 00 10 CB 00 00 00 00 00 00 00 00 00 00 00 00 00 00 00
			29 01 00 00 00 00 02 00 B0
			29 01 00 00 00 00 10 CB 00 00 00 00 00 00 00 00 00 00 00 00 00 00 00
			29 01 00 00 00 00 02 00 C0
			29 01 00 00 00 00 10 CB 05 05 05 05 05 05 05 05 05 00 05 00 00 00 00
			29 01 00 00 00 00 02 00 D0
			29 01 00 00 00 00 10 CB 00 00 00 00 05 00 00 05 05 05 05 05 05 05 05
			29 01 00 00 00 00 02 00 E0
			29 01 00 00 00 00 0F CB 05 00 05 00 00 00 00 00 00 00 00 05 00 00
			29 01 00 00 00 00 02 00 F0
			29 01 00 00 00 00 0C CB FF FF FF FF FF FF FF FF FF FF FF
			//panel pad mapping control
			29 01 00 00 00 00 02 00 80
			29 01 00 00 00 00 10 CC 29 2A 0A 0C 0E 10 12 14 06 00 08 00 00 00 00
			29 01 00 00 00 00 02 00 90
			29 01 00 00 00 00 10 CC 00 00 00 00 02 00 00 29 2A 09 0B 0D 0F 11 13
			29 01 00 00 00 00 02 00 A0
			29 01 00 00 00 00 0F CC 05 00 07 00 00 00 00 00 00 00 00 01 00 00
			29 01 00 00 00 00 02 00 B0
			29 01 00 00 00 00 10 CC 29 2A 13 11 0F 0D 0B 09 01 00 07 00 00 00 00
			29 01 00 00 00 00 02 00 C0
			29 01 00 00 00 00 10 CC 00 00 00 00 05 00 00 29 2A 14 12 10 0E 0C 0A
			29 01 00 00 00 00 02 00 D0
			29 01 00 00 00 00 0F CC 02 00 08 00 00 00 00 00 00 00 00 06 00 00
			//panel VST setting
			29 01 00 00 00 00 02 00 80
			29 01 00 00 00 00 0D CE 89 05 10 88 05 10 00 00 00 00 00 00
			//panel VEND setting
			29 01 00 00 00 00 02 00 90
			29 01 00 00 00 00 0F CE 54 FC 10 54 FD 10 55 00 10 55 01 10 00 00
			//panel CLKA1/2 setting
			29 01 00 00 00 00 02 00 A0
			/*MM-GL-DISPLAY-panel-01-*///29 01 00 00 00 00 0F CE 58 07 04 FC 00 10 00 58 06 04 FD 00 10 00
			29 01 00 00 00 00 0F CE 58 07 05 08 00 10 00 58 06 05 09 00 10 00/*MM-GL-DISPLAY-panel-01+*/
			//panel CLKA3/4 setting
			29 01 00 00 00 00 02 00 B0
			/*MM-GL-DISPLAY-panel-01-*///29 01 00 00 00 00 0F CE 58 05 04 FE 00 10 00 58 04 04 FF 00 10 00
			29 01 00 00 00 00 0F CE 58 05 05 0A 00 10 00 58 04 05 0B 00 10 00/*MM-GL-DISPLAY-panel-01+*/
			//panel CLKB1/2 setting
			29 01 00 00 00 00 02 00 C0
			/*MM-GL-DISPLAY-panel-01-*///29 01 00 00 00 00 0F CE 58 03 05 00 00 10 00 58 02 05 01 00 10 00
			29 01 00 00 00 00 0F CE 58 03 05 0C 00 10 00 58 02 05 0D 00 10 00/*MM-GL-DISPLAY-panel-01+*/
			//panel CLKB3/4 setting
			29 01 00 00 00 00 02 00 D0
			/*MM-GL-DISPLAY-panel-01-*///29 01 00 00 00 00 0F CE 58 01 05 02 00 10 00 58 00 05 03 00 10 00
			29 01 00 00 00 00 0F CE 58 01 05 0E 00 10 00 58 00 05 0F 00 10 00/*MM-GL-DISPLAY-panel-01+*/
			//panel CLKC1/2 setting
			29 01 00 00 00 00 02 00 80
			/*MM-GL-DISPLAY-panel-01-*///29 01 00 00 00 00 0F CF 50 00 05 04 00 10 00 50 01 05 05 00 10 00
			29 01 00 00 00 00 0F CF 50 00 05 10 00 10 00 50 01 05 11 00 10 00/*MM-GL-DISPLAY-panel-01+*/
			//panel CLKC3/4 setting
			29 01 00 00 00 00 02 00 90
			/*MM-GL-DISPLAY-panel-01-*///29 01 00 00 00 00 0F CF 50 02 05 06 00 10 00 50 03 05 07 00 10 00
			29 01 00 00 00 00 0F CF 50 02 05 12 00 10 00 50 03 05 13 00 10 00/*MM-GL-DISPLAY-panel-01+*/
			//panel CLKDA1/2 setting
			29 01 00 00 00 00 02 00 A0
			29 01 00 00 00 00 0F CF 00 00 00 00 00 00 00 00 00 00 00 00 00 00
			//panel CLKD3/4 setting
			29 01 00 00 00 00 02 00 B0
			29 01 00 00 00 00 0F CF 00 00 00 00 00 00 00 00 00 00 00 00 00 00
			//panel ECLK setting
			29 01 00 00 00 00 02 00 C0
			29 01 00 00 00 00 0C CF 39 39 20 20 00 00 01 01 20 00 00
			//panel ECLK setting
			29 01 00 00 00 00 02 00 B5
			29 01 00 00 00 00 07 C5 0B 95 FF 0B 95 FF
			//Gamma+
			29 01 00 00 00 00 02 00 00
			29 01 00 00 00 00 15 E1 2A 3F 4B 59 65 72 71 96 83 99 6C 59 6D 48 48 3B 2E 21 19 00
			//Gamma-
			29 01 00 00 00 00 02 00 00
			29 01 00 00 00 00 15 E2 2A 3F 4B 59 65 72 71 96 83 99 6C 59 6D 48 48 3B 2E 21 19 00
			/*MM-GL-DISPLAY-panel-03+[*/
			//PWM_PARA3 PWM_freq=68.359KHz
			29 01 00 00 00 00 02 00 B1
			29 01 00 00 00 00 02 C6 01
			/*MM-GL-DISPLAY-panel-03+]*/
			//
			29 01 00 00 00 00 02 00 00
			//Orise mode disable
			29 01 00 00 00 00 02 00 00
			29 01 00 00 00 00 04 FF FF FF FF
			//DCS COMMAND
			29 01 00 00 00 00 02 35 00
			05 01 00 00 78 00 02 11 00
			05 01 00 00 01 00 02 29 00
			29 01 00 00 00 00 02 53 24
		];
		/*MM-GL-DISPLAY-panel-01+[*/
		qcom,mdss-dsi-on-command-72 = [
			//CMD2
			29 01 00 00 00 00 02 00 00
			29 01 00 00 00 00 04 FF 12 84 01
			//Orise mode enable
			29 01 00 00 00 00 02 00 80
			29 01 00 00 00 00 03 FF 12 84
			//PWM_PARA3 PWM_freq=68.359KHz
			29 01 00 00 00 00 02 00 B1
			29 01 00 00 00 00 02 C6 01
			//
			29 01 00 00 00 00 02 00 00
			//Orise mode disable
			29 01 00 00 00 00 02 00 00
			29 01 00 00 00 00 04 FF FF FF FF
			//DCS COMMAND
			29 01 00 00 00 00 02 35 00
			05 01 00 00 78 00 02 11 00
			05 01 00 00 01 00 02 29 00
			29 01 00 00 00 00 02 53 24
		];
		/* MM-GL-DISPLAY-panel-01+] */
		qcom,mdss-dsi-off-command = [05 01 00 00 96 00 02 28 00
					05 01 00 00 96 00 02 10 00];
		qcom,mdss-dsi-on-command-state = "dsi_lp_mode";
		qcom,mdss-dsi-off-command-state = "dsi_hs_mode";
		qcom,mdss-dsi-h-sync-pulse = <1>;
		qcom,mdss-dsi-traffic-mode = "burst_mode";
		qcom,mdss-dsi-bllp-eof-power-mode;
		qcom,mdss-dsi-bllp-power-mode;
		qcom,mdss-dsi-lane-0-state;
		qcom,mdss-dsi-lane-1-state;
		qcom,mdss-dsi-lane-2-state;
		qcom,mdss-dsi-lane-3-state;
		qcom,mdss-dsi-panel-timings =[D5 32 22 00 60 64 26 34 29 03 04 00];
		qcom,mdss-dsi-t-clk-post = <0x20>;
		qcom,mdss-dsi-t-clk-pre = <0x2D>;
		qcom,mdss-dsi-bl-min-level = <1>;
		qcom,mdss-dsi-bl-max-level = <255>;
		qcom,mdss-dsi-dma-trigger = "trigger_sw";
		qcom,mdss-dsi-mdp-trigger = "none";
		qcom,mdss-dsi-bl-pmic-control-type = "bl_ctrl_dcs";
		qcom,mdss-dsi-reset-sequence = <1 1>, <0 10>, <1 150>;
	};
};

