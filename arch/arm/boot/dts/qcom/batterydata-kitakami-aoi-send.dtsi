/* Copyright (c) 2013-2014, The Linux Foundation. All rights reserved.
 *
 * This program is free software; you can redistribute it and/or modify
 * it under the terms of the GNU General Public License version 2 and
 * only version 2 as published by the Free Software Foundation.
 *
 * This program is distributed in the hope that it will be useful,
 * but WITHOUT ANY WARRANTY; without even the implied warranty of
 * MERCHANTABILITY or FITNESS FOR A PARTICULAR PURPOSE.  See the
 * GNU General Public License for more details.
 */
/*
 * Copyright (C) 2015 Sony Mobile Communications Inc.
 *
 * This program is free software; you can redistribute it and/or modify
 * it under the terms of the GNU General Public License version 2, as
 * published by the Free Software Foundation.
 */
qcom,kitakami-aoi-send {
	qcom,max-voltage-uv = <4350000>;
	qcom,v-cutoff-uv = <3400000>;
	qcom,chg-term-ua = <100000>;
	qcom,batt-id-kohm = <222>;
	qcom,battery-type = "1292-1008";
	qcom,fg-profile-data = [
		 F2 83 3A 7D
		 0D 81 22 77
		 38 83 DF 6B
		 43 71 1C 7F
		 02 82 4D 99
		 6E B7 49 C3
		 64 0F 6B 82
		 D3 7B 85 7F
		 33 78 1E 83
		 43 7A 2B 87
		 83 82 38 82
		 A6 98 64 B6
		 F0 C1 82 19
		 20 0C 16 5B
		 CE 6E 29 FC
		 C8 08 8F 44
		 6E 3B 00 00
		 ED 3C 25 2A
		 E5 35 00 00
		 00 00 00 00
		 00 00 00 00
		 A5 70 E6 70
		 5C 7C 1C 7B
		 6C 75 5B 62
		 F6 74 FC 7B
		 E1 75 E1 63
		 6A 86 05 A8
		 1F E0 59 47
		 4E A0 71 0C
		 28 00 FF 36
		 F0 11 30 03
		 00 00 00 00
	];
};
