/* Copyright (c) 2018, The Linux Foundation. All rights reserved.
 *
 * This program is free software; you can redistribute it and/or modify
 * it under the terms of the GNU General Public License version 2 and
 * only version 2 as published by the Free Software Foundation.
 *
 * This program is distributed in the hope that it will be useful,
 * but WITHOUT ANY WARRANTY; without even the implied warranty of
 * MERCHANTABILITY or FITNESS FOR A PARTICULAR PURPOSE.  See the
 * GNU General Public License for more details.
 */
/*
 * Copyright (C) 2018 Sony Mobile Communications Inc.
 *
 * This program is free software; you can redistribute it and/or modify
 * it under the terms of the GNU General Public License version 2, as
 * published by the Free Software Foundation.
 */

qcom,send_2539mah {
	qcom, = <24>;
	qcom,max-voltage-uv = <4297000>;
	qcom,fg-cc-cv-threshold-mv = <4287>;
	qcom,fastchg-current-ma = <2025>;
	qcom,batt-id-kohm = <330>;
	qcom,battery-beta = <4050>;
	qcom,battery-type = "1308-1851-3";
	qcom,checksum = <0x1D5A>;
	qcom,gui-version = "PMI8998GUI - 2.0.0.58";
	qcom,fg-profile-data = [
		 EC 1F 6C 05
		 4A 0A 23 FD
		 6D 1C 6A 02
		 8A 0D 4D 0A
		 10 18 A6 22
		 2A 3C DF 4B
		 86 00 00 00
		 15 00 00 00
		 00 00 2D B3
		 33 CC 8C CB
		 30 00 08 00
		 A8 E5 2D CC
		 C4 05 51 FA
		 D6 05 3A 03
		 DD FD A7 32
		 22 06 09 20
		 27 00 14 00
		 BA 20 BB 04
		 CC 0A 1D FC
		 8C 1C D5 02
		 DB 0C E2 0A
		 85 18 CB 22
		 B8 45 9D 52
		 83 00 00 00
		 12 00 00 00
		 00 00 47 CC
		 C4 C3 02 00
		 28 00 00 00
		 4E E3 2D CC
		 17 FC A3 F3
		 F2 06 5F 03
		 A4 06 A2 12
		 9C 33 CC FF
		 07 10 00 00
		 31 0A C0 44
		 28 00 40 00
		 93 01 0A FA
		 FF 00 00 00
		 00 00 00 00
		 00 00 00 00
		 00 00 00 00
		 00 00 00 00
		 00 00 00 00
		 00 00 00 00
		 00 00 00 00
		 00 00 00 00
		 00 00 00 00
		 00 00 00 00
		 00 00 00 00
		 00 00 00 00
		 00 00 00 00
		 00 00 00 00
		 00 00 00 00
		 00 00 00 00
		 00 00 00 00
		 00 00 00 00
	];
};
