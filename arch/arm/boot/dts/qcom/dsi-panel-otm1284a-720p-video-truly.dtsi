/* Copyright (c) 2013-2014, The Linux Foundation. All rights reserved.
 *
 * This program is free software; you can redistribute it and/or modify
 * it under the terms of the GNU General Public License version 2 and
 * only version 2 as published by the Free Software Foundation.
 *
 * This program is distributed in the hope that it will be useful,
 * but WITHOUT ANY WARRANTY; without even the implied warranty of
 * MERCHANTABILITY or FITNESS FOR A PARTICULAR PURPOSE.  See the
 * GNU General Public License for more details.
 */
/* MM-GL-DISPLAY-panel-01+[ */
/*---------------------------------------------------------------------------
 * This file is autogenerated file using gcdb parser. Please do not edit it.
 * Update input XML file to add a new entry or update variable in this file
 * VERSION = "1.0"
 *---------------------------------------------------------------------------*/
&mdss_mdp {
	dsi_otm1284a_720_vid_truly: qcom,dsi_otm1284a_720_vid_truly {
		compatible = "qcom,mdss-dsi-panel-truly_otm";
		qcom,mdss-dsi-panel-name = "otm1284a 720p video mode dsi panel truly";
		qcom,mdss-dsi-panel-controller = <&mdss_dsi0>;
		qcom,mdss-dsi-panel-type = "dsi_video_mode";
		qcom,mdss-dsi-panel-destination = "display_1";
		qcom,mdss-dsi-panel-framerate = <60>;
		qcom,mdss-dsi-virtual-channel-id = <0>;
		qcom,mdss-dsi-stream = <0>;
		qcom,mdss-pan-physical-width-dimension = <65>;
		qcom,mdss-pan-physical-height-dimension = <116>;
		qcom,mdss-dsi-panel-width = <720>;
		qcom,mdss-dsi-panel-height = <1280>;
		qcom,mdss-dsi-h-front-porch = <44>;
		qcom,mdss-dsi-h-back-porch = <42>;
		qcom,mdss-dsi-h-pulse-width = <2>;
		qcom,mdss-dsi-h-sync-skew = <0>;
		qcom,mdss-dsi-v-back-porch = <14>;
		qcom,mdss-dsi-v-front-porch = <16>;
		qcom,mdss-dsi-v-pulse-width = <2>;

		qcom,mdss-dsi-h-left-border = <0>;
		qcom,mdss-dsi-h-right-border = <0>;
		qcom,mdss-dsi-v-top-border = <0>;
		qcom,mdss-dsi-v-bottom-border = <0>;
		qcom,mdss-dsi-bpp = <24>;
		qcom,mdss-dsi-underflow-color = <0xff>;
		qcom,mdss-dsi-border-color = <0>;
		qcom,mdss-dsi-pixel-packing = "tight";
		qcom,mdss-dsi-on-command-73 = [
			//CMD2
			29 01 00 00 00 00 02 00 00
			29 01 00 00 00 00 04 FF 12 84 01
			//Orise mode enable
			29 01 00 00 00 00 02 00 80
			29 01 00 00 00 00 03 FF 12 84
			//TCON Setting
			29 01 00 00 00 00 02 00 80
			29 01 00 00 00 00 0A C0 00 64 00 10 10 00 64 10 10
			//Panel Timing Setting
			29 01 00 00 00 00 02 00 90
			29 01 00 00 00 00 07 C0 00 5C 00 01 00 04
			//PTSP4 Setting
			29 01 00 00 00 00 02 00 A4
			29 01 00 00 00 00 02 C0 22
			//Interval Scan Frame:0 frame,column inversion
			29 01 00 00 00 00 02 00 B3
			29 01 00 00 00 00 03 C0 00 55
			//FRAME RATE : 60Hz
			29 01 00 00 00 00 02 00 81
			29 01 00 00 00 00 02 C1 55
			//Clock delay
			29 01 00 00 00 00 02 00 90
			29 01 00 00 00 00 02 C4 49
			//DC2DC Setting
			29 01 00 00 00 00 02 00 A0
			29 01 00 00 00 00 0F C4 05 10 06 02 05 15 10 05 10 07 02 05 15 10
			//(BOOSTCLP) : VSP=5.6V/VSN=-5.6 voltage setting
			29 01 00 00 00 00 02 00 B0
			29 01 00 00 00 00 03 C4 00 00
			//VGH=18V,VGL=-10V,pump ratio:VGH=68x,VGL=-5x
			29 01 00 00 00 00 02 00 91
			29 01 00 00 00 00 03 C5 66 42
			//GVDDSET GVDD=4.96V,NGVDD=-4.96V
			29 01 00 00 00 00 02 00 00
			29 01 00 00 00 00 03 D8 C3 C3
			//VCOMDC (D900h): Voltage setting
			29 01 00 00 00 00 02 00 00
			29 01 00 00 00 00 02 D9 86
			//Souirce Bbias 1uA
			29 01 00 00 00 00 02 00 81
			/* MM-GL-DISPLAY-panel-12- *///29 01 00 00 00 00 02 C4 87
			29 01 00 00 00 00 02 C4 84/* MM-GL-DISPLAY-panel-12+ */
			//Forward /Backword
			29 01 00 00 00 00 02 00 00
			29 01 00 00 00 00 02 36 00
			//VDD_18V=1.7V,LVDSVDD=1.6V
			29 01 00 00 00 00 02 00 B3
			29 01 00 00 00 00 02 C5 90
			//LVD voltage level setting
			29 01 00 00 00 00 02 00 BB
			29 01 00 00 00 00 02 C5 8A
			//chopper
			29 01 00 00 00 00 02 00 82
			29 01 00 00 00 00 02 C4 0A
			//debounce
			29 01 00 00 00 00 02 00 C6
			29 01 00 00 00 00 02 B0 03
			//precharge disable
			29 01 00 00 00 00 02 00 C2
			29 01 00 00 00 00 02 F5 40
			//sample hold gvdd
			29 01 00 00 00 00 02 00 C3
			29 01 00 00 00 00 02 F5 85
			//en op
			29 01 00 00 00 00 02 00 87
			29 01 00 00 00 00 02 C4 18
			//ID1
			29 01 00 00 00 00 02 00 00
			29 01 00 00 00 00 02 D0 40
			//ID2/ID3
			29 01 00 00 00 00 02 00 00
			29 01 00 00 00 00 03 D1 00 00
			//Mode3
			29 01 00 00 00 00 02 00 90
			29 01 00 00 00 00 05 F5 02 11 02 15
			//Power IC Setting 2
			29 01 00 00 00 00 02 00 90
			29 01 00 00 00 00 02 C5 50
			//Power IC Setting 3 Pump clock
			29 01 00 00 00 00 02 00 94
			29 01 00 00 00 00 02 C5 66
			//VGLO1
			29 01 00 00 00 00 02 00 B2
			29 01 00 00 00 00 03 F5 00 00
			//VGLO1_S
			29 01 00 00 00 00 02 00 B4
			29 01 00 00 00 00 03 F5 00 00
			//VGLO2
			29 01 00 00 00 00 02 00 B6
			29 01 00 00 00 00 03 F5 00 00
			//VGLO2_S
			29 01 00 00 00 00 02 00 B8
			29 01 00 00 00 00 03 F5 00 00
			/* MM-GL-DISPLAY-panel-05-[ *//*
			//VCL pump dis
			29 01 00 00 00 00 02 00 94
			29 01 00 00 00 00 03 F5 00 00
			//VCL reg. en
			29 01 00 00 00 00 02 00 D2
			29 01 00 00 00 00 03 F5 06 15
			*//* MM-GL-DISPLAY-panel-05-] */
			//VGLO1/2 Pull low setting ;VGLO1 ,VGLO2
			29 01 00 00 00 00 02 00 B4
			29 01 00 00 00 00 02 C5 CC
			//panel timing settinf control
			29 01 00 00 00 00 02 00 80
			29 01 00 00 00 00 0C CB 00 00 00 00 00 00 00 00 00 00 00
			29 01 00 00 00 00 02 00 90
			29 01 00 00 00 00 10 CB 00 00 00 00 00 00 00 00 00 00 00 00 00 00 00
			29 01 00 00 00 00 02 00 A0
			29 01 00 00 00 00 10 CB 00 00 00 00 00 00 00 00 00 00 00 00 00 00 00
			29 01 00 00 00 00 02 00 B0
			29 01 00 00 00 00 10 CB 00 00 00 00 00 00 00 00 00 00 00 00 00 00 00
			29 01 00 00 00 00 02 00 C0
			29 01 00 00 00 00 10 CB 05 05 05 05 05 00 00 00 00 00 00 00 00 00 00
			29 01 00 00 00 00 02 00 D0
			29 01 00 00 00 00 10 CB FF FF FF 00 05 05 05 05 05 05 05 05 00 00 00
			29 01 00 00 00 00 02 00 E0
			29 01 00 00 00 00 0F CB 00 00 00 00 00 00 00 FF FF FF 00 05 05 05
			29 01 00 00 00 00 02 00 F0
			29 01 00 00 00 00 0C CB FF FF FF FF FF FF FF FF FF FF FF
			//panel pad mapping control
			29 01 00 00 00 00 02 00 80
			29 01 00 00 00 00 10 CC 02 0A 0C 0E 10 00 00 00 00 00 00 00 00 00 00
			29 01 00 00 00 00 02 00 90
			29 01 00 00 00 00 10 CC 00 00 00 00 2E 2D 06 01 09 0B 0D 0F 00 00 00
			29 01 00 00 00 00 02 00 A0
			29 01 00 00 00 00 0F CC 00 00 00 00 00 00 00 00 00 00 00 2E 2D 05
			29 01 00 00 00 00 02 00 B0
			29 01 00 00 00 00 10 CC 05 0F 0D 0B 09 00 00 00 00 00 00 00 00 00 00
			29 01 00 00 00 00 02 00 C0
			29 01 00 00 00 00 10 CC 00 00 00 00 2D 2E 01 06 10 0E 0C 0A 00 00 00
			29 01 00 00 00 00 02 00 D0
			29 01 00 00 00 00 0F CC 00 00 00 00 00 00 00 00 00 00 00 2D 2E 02
			//panel VST setting
			29 01 00 00 00 00 02 00 80
			29 01 00 00 00 00 0D CE 87 03 10 86 03 10 00 00 00 00 00 00
			//panel VEND setting
			29 01 00 00 00 00 02 00 90
			29 01 00 00 00 00 0F CE 34 FF 10 35 00 10 00 00 00 00 00 00 00 00
			//panel CLKA1/2 setting
			29 01 00 00 00 00 02 00 A0
			29 01 00 00 00 00 0F CE 38 03 84 F8 89 16 00 38 02 84 F9 89 16 00
			//panel CLKA3/4 setting
			29 01 00 00 00 00 02 00 B0
			29 01 00 00 00 00 0F CE 38 01 84 FA 89 16 00 38 00 84 FB 89 16 00
			//panel CLKB1/2 setting
			29 01 00 00 00 00 02 00 C0
			29 01 00 00 00 00 0F CE 30 00 84 FC 89 16 00 30 01 84 FD 89 16 00
			//panel CLKB3/4 setting
			29 01 00 00 00 00 02 00 D0
			29 01 00 00 00 00 0F CE 30 02 84 FE 89 16 00 30 03 84 FF 89 16 00
			//panel CLKC1/2 setting
			29 01 00 00 00 00 02 00 80
			29 01 00 00 00 00 0F CF 00 00 00 00 00 00 00 00 00 00 00 00 00 00
			//panel CLKC3/4 setting
			29 01 00 00 00 00 02 00 90
			29 01 00 00 00 00 0F CF 00 00 00 00 00 00 00 00 00 00 00 00 00 00
			//panel CLKDA1/2 setting
			29 01 00 00 00 00 02 00 A0
			29 01 00 00 00 00 0F CF 00 00 00 00 00 00 00 00 00 00 00 00 00 00
			//panel CLKD3/4 setting
			29 01 00 00 00 00 02 00 B0
			29 01 00 00 00 00 0F CF 00 00 00 00 00 00 00 00 00 00 00 00 00 00
			//panel ECLK setting
			29 01 00 00 00 00 02 00 C0
			29 01 00 00 00 00 0C CF 01 01 20 20 00 00 01 81 00 00 00
			//panel ECLK setting
			29 01 00 00 00 00 02 00 B5
			29 01 00 00 00 00 07 C5 3F FF FF 3F FF FF
			//Gamma+
			29 01 00 00 00 00 02 00 00
			/* MM-GL-DISPLAY-panel-05- */// 29 01 00 00 00 00 15 E1 00 05 19 27 39 48 4B 7A 6D 8A 75 5C 6A 45 40 33 23 15 06 01
			/* MM-GL-DISPLAY-panel-10- *///29 01 00 00 00 00 15 E1 00 27 34 41 4F 5E 60 8E 80 9A 67 51 52 40 40 33 28 19 0D 00/* MM-GL-DISPLAY-panel-05+ */
			29 01 00 00 00 00 15 E1 1A 2A 35 41 4F 5C 5D 88 7A 93 6E 58 68 45 43 37 29 1A 0E 04/* MM-GL-DISPLAY-panel-10+ */
			//Gamma-
			29 01 00 00 00 00 02 00 00
			/* MM-GL-DISPLAY-panel-05- */// 29 01 00 00 00 00 15 E2 00 04 18 26 38 47 4B 7A 6D 8A 75 5C 6A 45 40 32 22 14 05 00
			/* MM-GL-DISPLAY-panel-10- *///29 01 00 00 00 00 15 E2 00 27 34 41 4F 5E 60 8E 80 9A 67 51 52 40 40 33 28 19 0D 00/* MM-GL-DISPLAY-panel-05+ */
			29 01 00 00 00 00 15 E2 1A 2A 35 41 4F 5C 5D 88 7A 93 6E 58 68 45 43 37 29 1A 0E 04/* MM-GL-DISPLAY-panel-10+ */

			/* MM-GL-DISPLAY-panel-05- */// 29 01 00 00 00 00 02 00 A4
			/* MM-GL-DISPLAY-panel-05- */// 29 01 00 00 00 00 02 C1 F0
			/* MM-GL-DISPLAY-panel-05+[ */
			//CE Parameter
			29 01 00 00 00 00 02 00 A0
			/* MM-GL-DISPLAY-panel-10- *///29 01 00 00 00 00 0D D6 01 00 01 00 09 0D 01 1A 01 1A 79 00
			29 01 00 00 00 00 0D D6 01 00 09 00 09 2D	79 26 79 1a 71 26/* MM-GL-DISPLAY-panel-10+ */

			//CE Parameter
			29 01 00 00 00 00 02 00 B0
			/* MM-GL-DISPLAY-panel-10- *///29 01 00 00 00 00 0D D6 01 4D 75 1A 01 1A 01 00 09 1A 75 33
			29 01 00 00 00 00 0D D6 7D 00 75 00 05 00 05 00 09 0D 01 00/* MM-GL-DISPLAY-panel-10+ */

			//CE Parameter
			29 01 00 00 00 00 02 00 C0
			/* MM-GL-DISPLAY-panel-10- *///29 01 00 00 00 00 0D D6 09 11 00 11 11 11 11 11 00 33 11 11
			29 01 00 00 00 00 0D D6 1A 11 00 3C 11 1A 11 11 1A 00 11 00/* MM-GL-DISPLAY-panel-10+ */

			//CE Parameter
			29 01 00 00 00 00 02 00 D0
			/* MM-GL-DISPLAY-panel-10- *///29 01 00 00 00 00 07 D6 11 11 00 11 11 22
			29 01 00 00 00 00 07 D6 00 11 00 09 11 00/* MM-GL-DISPLAY-panel-10+ */

			//CE Parameter
			29 01 00 00 00 00 02 00 E0
			/* MM-GL-DISPLAY-panel-10- *///29 01 00 00 00 00 0D D6 09 11 11 09 11 09 09 11 00 1A 11 09
			29 01 00 00 00 00 0D D6 1A 11 11 1E 11 0D 09 11 0D 00 11 00/* MM-GL-DISPLAY-panel-10+ */

			//CE Parameter
			29 01 00 00 00 00 02 00 F0
			/* MM-GL-DISPLAY-panel-10- *///29 01 00 00 00 00 07 D6 09 11 00 09 11 11
			29 01 00 00 00 00 07 D6 00 11 00 04 11 00/* MM-GL-DISPLAY-panel-10+ */

			//CE Enable
			29 01 00 00 00 00 02 00 00
			29 01 00 00 00 00 02 81 81

			//SLPOUT OTP Re-Load
			29 01 00 00 00 00 02 00 90
			29 01 00 00 00 00 02 B6 B6

			//Auto disable CMD1 when HS
			29 01 00 00 00 00 02 00 92
			29 01 00 00 00 00 02 B3 06
			/* MM-GL-DISPLAY-panel-05+] */
			//PWM_PARA3 PWM_freq=68.359KHz
			29 01 00 00 00 00 02 00 B1
			29 01 00 00 00 00 02 C6 01
			//
			29 01 00 00 00 00 02 00 00
			//Orise mode disable
			29 01 00 00 00 00 02 00 00
			29 01 00 00 00 00 04 FF FF FF FF
			//DCS COMMAND
			29 01 00 00 00 00 02 35 00
			05 01 00 00 78 00 02 11 00
			05 01 00 00 01 00 02 29 00
			29 01 00 00 00 00 02 53 24
		];
		/* MM-GL-DISPLAY-panel-10+[ */
		qcom,mdss-dsi-on-command-74 = [
			//CMD2
			29 01 00 00 00 00 02 00 00
			29 01 00 00 00 00 04 FF 12 84 01
			//Orise mode enable
			29 01 00 00 00 00 02 00 80
			29 01 00 00 00 00 03 FF 12 84
			//PWM_PARA3 PWM_freq=68.359KHz
			29 01 00 00 00 00 02 00 B1
			29 01 00 00 00 00 02 C6 01
			//
			29 01 00 00 00 00 02 00 00
			//Orise mode disable
			29 01 00 00 00 00 02 00 00
			29 01 00 00 00 00 04 FF FF FF FF
			//CE Enable
			29 01 00 00 00 00 02 00 00
			29 01 00 00 00 00 02 81 81
			//DCS COMMAND
			29 01 00 00 00 00 02 35 00
			05 01 00 00 78 00 02 11 00
			05 01 00 00 01 00 02 29 00
			29 01 00 00 00 00 02 53 24
		];
		/* MM-GL-DISPLAY-panel-10+] */
		qcom,mdss-dsi-off-command = [05 01 00 00 C8 00 02 28 00
					05 01 00 00 64 00 02 10 00];
		qcom,mdss-dsi-on-command-state = "dsi_lp_mode";
		qcom,mdss-dsi-off-command-state = "dsi_hs_mode";
		qcom,mdss-dsi-h-sync-pulse = <1>;
		qcom,mdss-dsi-traffic-mode = "burst_mode";
		qcom,mdss-dsi-bllp-eof-power-mode;
		qcom,mdss-dsi-bllp-power-mode;
		qcom,mdss-dsi-lane-0-state;
		qcom,mdss-dsi-lane-1-state;
		qcom,mdss-dsi-lane-2-state;
		qcom,mdss-dsi-lane-3-state;
		qcom,mdss-dsi-panel-timings =[D5 32 22 00 60 64 26 34 29 03 04 00];
		qcom,mdss-dsi-t-clk-post = <0x20>;
		qcom,mdss-dsi-t-clk-pre = <0x2D>;
		qcom,mdss-dsi-bl-min-level = <1>;
		qcom,mdss-dsi-bl-max-level = <255>;
		qcom,mdss-dsi-dma-trigger = "trigger_sw";
		qcom,mdss-dsi-mdp-trigger = "none";
		qcom,mdss-dsi-bl-pmic-control-type = "bl_ctrl_dcs";
		qcom,mdss-dsi-reset-sequence = <1 1>, <0 10>, <1 150>;
	};
};
/* MM-GL-DISPLAY-panel-01+] */

