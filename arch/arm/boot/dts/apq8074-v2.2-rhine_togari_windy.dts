/* arch/arm/boot/dts/apq8074-v2.2-rhine_togari_windy.dts
 *
 * Copyright (c) 2013, The Linux Foundation. All rights reserved.
 * Copyright (C) 2013 Sony Mobile Communications AB.
 *
 * Author: Shougo Watanabe <Shougo.X.Watanabe@sonymobile.com>
 *
 * This program is free software; you can redistribute it and/or modify
 * it under the terms of the GNU General Public License version 2 and
 * only version 2 as published by the Free Software Foundation.
 *
 * This program is distributed in the hope that it will be useful,
 * but WITHOUT ANY WARRANTY; without even the implied warranty of
 * MERCHANTABILITY or FITNESS FOR A PARTICULAR PURPOSE.  See the
 * GNU General Public License for more details.
 */

/dts-v1/;

/include/ "apq8074-v2.2.dtsi"
/include/ "msm8974-liquid.dtsi"
/include/ "apq8074-rhine_togari_windy.dtsi"

/ {
	model = "SoMC Togari WINDY";
	compatible = "somc,togari-windy", "qcom,apq8074";
	qcom,msm-id = <126 8 0x20002>,
		      <184 9 0x20002>,
		      <185 8 0x20002>,
		      <186 8 0x20002>;
};
