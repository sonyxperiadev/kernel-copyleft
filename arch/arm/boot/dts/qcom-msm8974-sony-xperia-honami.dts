/*
 * Copyright (C) 2014 Sony Mobile Communications Inc.
 *
 * This program is free software; you can redistribute it and/or modify
 * it under the terms of the GNU General Public License version 2, as
 * published by the Free Software Foundation.
 */
#include "qcom-msm8974.dtsi"

/ {
	model = "Sony Xperia Z1";
	compatible = "sony,xperia-honami", "qcom,msm8974";

	memory@0 {
		reg = <0 0x40000000>, <0x40000000 0x40000000>;
		device_type = "memory";
	};
};

&soc {
	serial@f991e000 {
		status = "ok";
	};
};
