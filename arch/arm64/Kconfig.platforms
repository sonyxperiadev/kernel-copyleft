## arch/arm64/Kconfig.platforms
```kconfig
# SPDX-License-Identifier: GPL-2.0-only
menu "Platform selection"

config ARCH_CANOE
	bool "Enable support for Qualcomm Technologies, Inc. Canoe"
	depends on ARCH_QCOM
	help
	  This enables support for Qualcomm Technologies, Inc. Canoe
	  chipset. If you do not wish to build a kernel that runs on this
	  chipset or if you are unsure, say 'N' here.

config ARCH_ALOR
	bool "Enable support for Qualcomm Technologies, Inc. Alor"
	depends on ARCH_QCOM
	help
	  This enables support for Qualcomm Technologies, Inc. Alor
	  chipset. If you do not wish to build a kernel that runs on this
	  chipset or if you are unsure, say 'N' here.

config ARCH_CHORA
	bool "Enable support for Qualcomm Technologies, Inc. Chora"
	depends on ARCH_QCOM
	help
	  This enables support for Qualcomm Technologies, Inc. Chora
	  chipset. It is based on Kryo cores.

	  If you do not wish to build a kernel that runs on this
	  chipset or if you are unsure, say 'N' here.

config ARCH_MALABAR
	bool "Enable support for Qualcomm Technologies, Inc. Malabar"
	depends on ARCH_QCOM
	help
	  This enables support for Qualcomm Technologies, Inc. Malabar
	  chipset.

	  If you do not wish to build a kernel that runs on this
	  chipset or if you are unsure, say 'N' here.

config ARCH_QTI_VM
       bool "Enable Virtual Machines Support for Qualcomm Technologies, Inc."
       depends on ARCH_QCOM
       help
         This enables support for the Qualcomm Technologies, Inc.'s
         Virtual Machines. If you wish to build a kernel that doesn't
         require VM support or if you are unsure,
         say 'N' here.

config ARCH_SUN
	bool "Enable support for Qualcomm Technologies, Inc. Sun"
	depends on ARCH_QCOM
	help
	  This enables support for Qualcomm Technologies, Inc. Sun
	  chipset. If you do not wish to build a kernel that runs on this
	  chipset or if you are unsure, say 'N' here.

config ARCH_PINEAPPLE
	bool "Enable support for Qualcomm Technologies, Inc. Pineapple"
	depends on ARCH_QCOM
	help
	  This enables support for Qualcomm Technologies, Inc. Pineapple
	  chipset. If you do not wish to build a kernel that runs on this
	  chipset or if you are unsure, say 'N' here.

config ARCH_VIENNA
	bool "Enable Support for Qualcomm Technologies, Inc. VIENNA"
	depends on ARCH_QCOM
	help
	  This enables support for the Qualcomm Technologies, Inc.
	  Vienna chipset.
	  If you do not wish to build a kernel that runs on this
	  chipset or if you are unsure, say 'N' here.

config ARCH_X1E80100
	bool "Enable support for Qualcomm Technologies, Inc. X1e80100"
	depends on ARCH_QCOM
	help
	  This enables support for Qualcomm Technologies, Inc. X1e80100
	  chipset.
          If you do not wish to build a kernel that runs on this
	  chipset or if you are unsure, say 'N' here.

config ARCH_X1P42100
	bool "Enable support for Qualcomm Technologies, Inc. X1p42100"
	depends on ARCH_QCOM
	help
	  This enables support for Qualcomm Technologies, Inc. X1p42100
	  chipset.
          If you do not wish to build a kernel that runs on this
	  chipset or if you are unsure, say 'N' here.

config ARCH_YUPIK
	bool "Enable Support for Qualcomm Technologies, Inc. YUPIK"
	depends on ARCH_QCOM
	help
	  This enables support for the Qualcomm Technologies,
	  Inc.'s YUPIK chipset. If you do not wish to build a
	  kernel that runs on this chipset or if you are unsure,
	  say 'N' here.

config ARCH_BENGAL
	bool "Enable Support for Qualcomm Technologies, Inc. BENGAL"
	depends on ARCH_QCOM
	help
	  This enables support for the Qualcomm Technologies,
	  Inc.'s BENGAL chipset. If you do not wish to build a
	  kernel that runs on this chipset or if you are unsure,
	  say 'N' here.

config ARCH_KHAJE
	bool "Enable Support for Qualcomm Technologies, Inc. KHAJE"
	depends on ARCH_QCOM
	help
	  This enables support for the Qualcomm Technologies,
	  Inc.'s KHAJE chipset. If you do not wish to build a
	  kernel that runs on this chipset or if you are unsure,
	  say 'N' here.

config ARCH_MONACO
	bool "Enable Support for Qualcomm Technologies, Inc. MONACO"
	depends on ARCH_QCOM
	help
	  This enables support for the Qualcomm Technologies,
	  Inc.'s monaco chipset. If you do not wish to build a
	  kernel that runs on this chipset or if you are unsure,
	  say 'N' here.

config ARCH_DIREWOLF
	bool "Enable Support for Qualcomm Technologies, Inc. DIREWOLF"
	depends on ARCH_QCOM
	help
	  This enables support for the Qualcomm Technologies, Inc.'s
	  DIREWOLF chipset. If you do not wish to build a kernel that
	  runs on this chipset or if you are unsure, say 'N' here.

config ARCH_LEMANS
	bool "Enable Support for Qualcomm Technologies, Inc. LEMANS"
	depends on ARCH_QCOM
	help
	  This enables support for the Qualcomm Technologies, Inc.'s
	  LEMANS chipset. If you do not wish to build a kernel that
	  runs on this chipset or if you are unsure, say 'N' here.

config ARCH_MONACO_AUTO
	bool "Enable Support for Qualcomm Technologies, Inc. MONACO_AUTO"
	depends on ARCH_QCOM
	help
	  This enables support for the Qualcomm Technologies, Inc.'s
	  MONACO_AUTO chipset. If you do not wish to build a kernel that
	  runs on this chipset or if you are unsure, say 'N' here.

config ARCH_NORD
	bool "Enable Support for Qualcomm Technologies, Inc. NORD"
	depends on ARCH_QCOM
	help
	  This enables support for the Qualcomm Technologies, Inc.'s
	  NORD chipset. If you do not wish to build a kernel that
	  runs on this chipset or if you are unsure, say 'N' here.

config ARM64_PMEM
	bool "Enable support for persistent memory"
	select ARCH_HAS_PMEM_API
	select ARCH_HAS_UACCESS_FLUSHCACHE
	help
	  Say Y to enable support for the persistent memory API based on the
	  ARMv8.2 DCPoP feature.

	  The feature is detected at runtime, and the kernel will use DC CVAC
	  operations if DC CVAP is not supported (following the behaviour of
	  DC CVAP itself if the system does not define a point of persistence).

config ARCH_PIKACHU
        bool "Enable support for Qualcomm Technologies, Inc. Pikachu"
        depends on ARCH_QCOM
        help
          This enables support for Qualcomm Technologies, Inc. Pikachu
          chipset. If you do not wish to build a kernel that runs on this
          chipset or if you are unsure,
          say 'N' here.

config ARCH_SHIKRA
        bool "Enable support for Qualcomm Technologies, Inc. SHIKRA"
        depends on ARCH_QCOM
        help
	  This enables support for Qualcomm Technologies, Inc.'s
	  SHIKRA chipset.
	  If you do not wish to build a kernel that runs on this
	  chipset or if you are unsure, say 'N' here.

config ARCH_SERAPH
	bool "Enable support for Qualcomm Technologies, Inc. Seraph"
	depends on ARCH_QCOM
	help
	  This enables support for Qualcomm Technologies, Inc. Seraph
	  chipset. If you do not wish to build a kernel that runs on this
	  chipset or if you are unsure,
	  say 'N' here.

endmenu # "Platform selection"
```

## arch/arm64/configs/generic_vm_defconfig
```kconfig
CONFIG_LOCALVERSION="-perf"
CONFIG_AUDIT=y
CONFIG_NO_HZ=y
CONFIG_HIGH_RES_TIMERS=y
CONFIG_PREEMPT=y
CONFIG_IRQ_TIME_ACCOUNTING=y
CONFIG_PSI=y
CONFIG_IKCONFIG=y
CONFIG_IKCONFIG_PROC=y
CONFIG_LOG_BUF_SHIFT=16
CONFIG_LOG_CPU_MAX_BUF_SHIFT=10
CONFIG_CGROUPS=y
CONFIG_BLK_CGROUP=y
CONFIG_CGROUP_SCHED=y
# CONFIG_FAIR_GROUP_SCHED is not set
CONFIG_CGROUP_CPUACCT=y
CONFIG_NAMESPACES=y
CONFIG_USER_NS=y
CONFIG_BLK_DEV_INITRD=y
# CONFIG_RD_BZIP2 is not set
# CONFIG_RD_LZMA is not set
# CONFIG_RD_XZ is not set
# CONFIG_RD_LZO is not set
CONFIG_CC_OPTIMIZE_FOR_SIZE=y
CONFIG_EXPERT=y
# CONFIG_SYSFS_SYSCALL is not set
# CONFIG_FHANDLE is not set
CONFIG_BASE_SMALL=y
# CONFIG_IO_URING is not set
CONFIG_KALLSYMS_ALL=y
CONFIG_ARCH_QCOM=y
CONFIG_ARM64_VA_BITS_39=y
CONFIG_SCHED_MC=y
CONFIG_NR_CPUS=4
CONFIG_PARAVIRT=y
CONFIG_ARM64_SW_TTBR0_PAN=y
# CONFIG_ARM64_BTI_KERNEL is not set
CONFIG_RANDOMIZE_BASE=y
# CONFIG_EFI is not set
CONFIG_PM_AUTOSLEEP=y
CONFIG_PM_WAKELOCKS=y
CONFIG_PM_WAKELOCKS_LIMIT=0
# CONFIG_PM_WAKELOCKS_GC is not set
CONFIG_CPU_IDLE=y
CONFIG_ARM_PSCI_CPUIDLE=y
CONFIG_VIRTUALIZATION=y
CONFIG_JUMP_LABEL=y
# CONFIG_RELR is not set
CONFIG_MODULES=y
CONFIG_MODULE_UNLOAD=y
CONFIG_MODVERSIONS=y
CONFIG_MODULE_SIG=y
CONFIG_PARTITION_ADVANCED=y
# CONFIG_MSDOS_PARTITION is not set
CONFIG_GKI_HIDDEN_REGMAP_CONFIGS=y
CONFIG_GKI_HIDDEN_GPIO_CONFIGS=y
CONFIG_GKI_HIDDEN_VIRTUAL_CONFIGS=y
# CONFIG_CORE_DUMP_DEFAULT_ELF_HEADERS is not set
CONFIG_SLAB_FREELIST_RANDOM=y
CONFIG_SLAB_FREELIST_HARDENED=y
CONFIG_SHUFFLE_PAGE_ALLOCATOR=y
# CONFIG_COMPAT_BRK is not set
CONFIG_MEMORY_HOTPLUG=y
CONFIG_MEMORY_HOTREMOVE=y
# CONFIG_ZONE_DMA is not set
# CONFIG_ZONE_DMA32 is not set
CONFIG_ZONE_DEVICE=y
CONFIG_NET=y
CONFIG_UNIX=y
CONFIG_INET=y
CONFIG_INET_TABLE_PERTURB_ORDER=0
# CONFIG_INET_DIAG is not set
CONFIG_TCP_CONG_ADVANCED=y
# CONFIG_TCP_CONG_BIC is not set
# CONFIG_TCP_CONG_CUBIC is not set
# CONFIG_TCP_CONG_WESTWOOD is not set
# CONFIG_TCP_CONG_HTCP is not set
# CONFIG_IPV6 is not set
CONFIG_VSOCKETS=y
# CONFIG_RPS is not set
# CONFIG_BQL is not set
# CONFIG_ETHTOOL_NETLINK is not set
CONFIG_PCI=y
# CONFIG_PCIEASPM is not set
# CONFIG_PCI_QUIRKS is not set
CONFIG_PCI_HOST_GENERIC=y
CONFIG_DEVTMPFS=y
CONFIG_DEVTMPFS_MOUNT=y
# CONFIG_STANDALONE is not set
# CONFIG_PREVENT_FIRMWARE_BUILD is not set
# CONFIG_QCOM_EBI2 is not set
CONFIG_ARM_SCMI_PROTOCOL=y
CONFIG_VIRTIO_BLK=y
CONFIG_SCSI=y
# CONFIG_SCSI_PROC_FS is not set
CONFIG_BLK_DEV_SD=y
# CONFIG_SCSI_LOWLEVEL is not set
CONFIG_MD=y
# CONFIG_MD_BITMAP_FILE is not set
CONFIG_BLK_DEV_DM=y
CONFIG_DM_CRYPT=y
CONFIG_DM_UEVENT=y
CONFIG_DM_VERITY=y
CONFIG_DM_VERITY_VERIFY_ROOTHASH_SIG=y
CONFIG_DM_VERITY_FEC=y
CONFIG_DM_INTEGRITY=y
CONFIG_NETDEVICES=y
# CONFIG_NET_CORE is not set
# CONFIG_ETHERNET is not set
# CONFIG_WLAN is not set
CONFIG_INPUT_EVDEV=y
# CONFIG_KEYBOARD_ATKBD is not set
# CONFIG_INPUT_MOUSE is not set
# CONFIG_SERIO is not set
# CONFIG_LEGACY_PTYS is not set
# CONFIG_HW_RANDOM is not set
# CONFIG_DEVMEM is not set
# CONFIG_DEVPORT is not set
# CONFIG_I2C_HELPER_AUTO is not set
CONFIG_SPI=y
# CONFIG_SPMI_MSM_PMIC_ARB is not set
# CONFIG_HWMON is not set
CONFIG_WATCHDOG=y
CONFIG_WATCHDOG_CORE=y
CONFIG_DRM=y
CONFIG_BACKLIGHT_CLASS_DEVICE=y
# CONFIG_HID_SUPPORT is not set
# CONFIG_USB_SUPPORT is not set
CONFIG_RTC_CLASS=y
CONFIG_RTC_DRV_PL030=y
CONFIG_RTC_DRV_PL031=y
CONFIG_DMABUF_HEAPS=y
CONFIG_UIO=y
CONFIG_VIRT_DRIVERS=y
CONFIG_GUNYAH_GUEST=y
CONFIG_GUNYAH=y
# CONFIG_GUNYAH_QCOM_PLATFORM is not set
CONFIG_VIRTIO_PCI=y
# CONFIG_VIRTIO_PCI_LEGACY is not set
# CONFIG_SURFACE_PLATFORMS is not set
CONFIG_MAILBOX=y
CONFIG_QCOM_GENI_SE=y
CONFIG_QCOM_VM_MEMORY_FEATURES_NONGKI=y
CONFIG_RESET_CONTROLLER=y
CONFIG_ANDROID_DEBUG_KINFO=y
# CONFIG_ANDROID_KABI_RESERVE is not set
# CONFIG_ANDROID_VENDOR_OEM_DATA is not set
CONFIG_INTERCONNECT=y
CONFIG_EXT4_FS=y
CONFIG_EXT4_FS_POSIX_ACL=y
CONFIG_EXT4_FS_SECURITY=y
# CONFIG_DNOTIFY is not set
CONFIG_PROC_CHILDREN=y
CONFIG_TMPFS=y
# CONFIG_MISC_FILESYSTEMS is not set
# CONFIG_NETWORK_FILESYSTEMS is not set
CONFIG_SECURITY=y
CONFIG_SECURITYFS=y
CONFIG_SECURITY_NETWORK=y
CONFIG_HARDENED_USERCOPY=y
CONFIG_SECURITY_SELINUX=y
# CONFIG_SECURITY_SELINUX_DEVELOP is not set
# CONFIG_SECURITY_SELINUX_AVC_STATS is not set
CONFIG_LSM="lockdown,yama,loadpin,safesetid,integrity,selinux,smack,tomoyo,apparmor,bpf"
CONFIG_INIT_ON_ALLOC_DEFAULT_ON=y
CONFIG_BUG_ON_DATA_CORRUPTION=y
CONFIG_CRYPTO_AES=y
CONFIG_CRYPTO_GCM=y
CONFIG_CRYPTO_HMAC=y
CONFIG_CRYPTO_SHA256=y
CONFIG_CRYPTO_LZO=y
CONFIG_DMA_RESTRICTED_POOL=y
CONFIG_PRINTK_TIME=y
CONFIG_PRINTK_CALLER=y
CONFIG_DEBUG_INFO_DWARF5=y
CONFIG_HEADERS_INSTALL=y
# CONFIG_SECTION_MISMATCH_WARN_ONLY is not set
CONFIG_MAGIC_SYSRQ=y
CONFIG_PANIC_ON_OOPS=y
CONFIG_PANIC_TIMEOUT=-1
CONFIG_SOFTLOCKUP_DETECTOR=y
# CONFIG_DETECT_HUNG_TASK is not set
# CONFIG_FTRACE is not set
# CONFIG_RUNTIME_TESTING_MENU is not set
CONFIG_QTVM_HIDDEN_CONFIGS=y
```
