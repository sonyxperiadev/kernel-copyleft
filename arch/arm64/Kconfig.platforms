## drivers/firmware/qcom/Kconfig
```kconfig
# SPDX-License-Identifier: GPL-2.0-only
#
# For a description of the syntax of this configuration file,
# see Documentation/kbuild/kconfig-language.rst.
#

menu "Qualcomm firmware drivers"

config QCOM_SCM
	select QCOM_TZMEM
	tristate

config QCOM_TZMEM_FFA
	bool "QCOM TZMEM FFA support"
	depends on QCOM_TZMEM && ARM_FFA_TRANSPORT
	default n
	help
	  This option enables support for QCOM TZMEM FFA.

	  This feature config enable FFA support in qcom_tzmem driver.
	  Please note, FFA memory sharing is different aspect compared to older
	  older method of plugging feature via scm calls.
	  With this, traditional method of memory sharing will be replaced with
	  FFA based implementation.

config QTEE_SHM_BRIDGE
	bool "QTI TEE shared memory bridge"
	depends on QCOM_SCM && QCOM_TZMEM
	default y if QCOM_SCM
	help
	  QTEE shared memory bridge driver provides kernel APIs to share
	  memory between trustzone & other VMs through shared memory bridge.
	  It allows kernel clients to create bridge, delete bridge, and do
	  memory sub-allocation and free from the default kernel bridge
	  created by bridge driver.

config QCOM_SCM_DOWNLOAD_MODE_DEFAULT
	bool "Qualcomm download mode enabled by default"
	depends on QCOM_SCM
	help
	  A device with "download mode" enabled will upon an unexpected
	  warm-restart enter a special debug mode that allows the user to
	  "download" memory content over USB for offline postmortem analysis.
	  The feature can be enabled/disabled on the kernel command line.

	  Say Y here to enable "download mode" by default.

config QCOM_QSEECOM
	bool "Qualcomm QSEECOM interface driver"
	depends on QCOM_SCM=y
	select AUXILIARY_BUS
	help
	  Various Qualcomm SoCs have a Secure Execution Environment (SEE) running
	  in the Trust Zone. This module provides an interface to that via the
	  QSEECOM mechanism, using SCM calls.

	  The QSEECOM interface allows, among other things, access to applications
	  running in the SEE. An example of such an application is 'uefisecapp',
	  which is required to access UEFI variables on certain systems. If
	  selected, the interface will also attempt to detect and register client
	  devices for supported applications.

	  Select Y here to enable the QSEECOM interface driver.

config QCOM_QSEECOM_UEFISECAPP
	bool "Qualcomm SEE UEFI Secure App client driver"
	depends on QCOM_QSEECOM
	depends on EFI
	help
	  Various Qualcomm SoCs do not allow direct access to EFI variables.
	  Instead, these need to be accessed via the UEFI Secure Application
	  (uefisecapp), residing in the Secure Execution Environment (SEE).

	  This module provides a client driver for uefisecapp, installing efivar
	  operations to allow the kernel accessing EFI variables, and via that also
	  provide user-space with access to EFI variables via efivarfs.

	  Select Y here to provide access to EFI variables on the aforementioned
	  platforms.

source "$(KCONFIG_EXT_PREFIX)drivers/firmware/qcom/si_core/Kconfig"

endmenu
```

## drivers/firmware/qcom/si_core/Kconfig
```kconfig
# SPDX-License-Identifier: GPL-2.0-only

config QCOM_SI_CORE
	tristate "Secure QTEE Communication Support"
	depends on QCOM_SCM
	help
	  Enable SI-CORE driver which supports capability based secure
	  communication between QTEE and VM. Using SI-CORE, kernel can
	  issue	calls to QTEE or TAs to request a service or exposes services
	  to QTEE and TAs. The SI-CORE implements the necessary marshaling of
	  messages with QTEE.

config QCOM_SI_CORE_WQ
	bool "Use direct invocation for RELEASE requests"
	depends on QCOM_SI_CORE
	help
	  Use a kernel thread to issue RELEASE request to QTEE and TAs
	  instead of using asynchronous messages. It may slow down the system
	  and prone to failure as it uses direct invocation which requires
	  extra resources from QTEE.

	  Enable if only QTEE does not support asynchronous message.

config QCOM_SI_CORE_ADCI
	bool "Use ADCI thread to cater service requests from other VMs"
	depends on QCOM_SI_CORE
	help
	  Use a kernel thread to register callback service to QTEE that
	  will cater requests initiated by other VMs requiring services
	  hosted by primary VM.

	  This option should not be enabled on guest virtual machines.
	  The initialization and shutdown of the ADCI thread within the
	  SI Core component are unnecessary in guest VM environments, as
	  the host operating system typically handles ADCI functionality.

	  Enable this option if there are multiple VMs and services are
	  hosted only by primary VM.

	  Disable this option to avoid ADCI thread management in guest VMs.

config QCOM_SI_CORE_MEM_FFA
	bool "Use FFA ABI for memory sharing with QTEE"
	depends on QCOM_SI_CORE && ARM_FFA_TRANSPORT
	help
	 Uses the FFA driver to share memory with QTEE using the FFA ABI.
	 When this option is enabled, memory object as well as direct
	 invocation request and response buffer memory is shared with QTEE
	 via FFA.

	 Enable this option only if QTEE supports FFA memory ABIs.

config QCOM_SI_CORE_DOORBELL
	bool "Enable support for Doorbell interrupts from QTEE"
	depends on QCOM_SI_CORE
	help
	 The doorbell interrupt mechanism allows QTEE to send an asynchronous
	 message to a VM. The message contains one or more invoke calls for
	 the VM to execute on handling the interrupt.

	 Enable this option only if QTEE supports Doorbell interrupts.
```

## drivers/input/touchscreen/lxs_ts/Kconfig
```kconfig
menu "LXS Touch Support"

config TOUCHSCREEN_LXS
	tristate "LX Semicon Touch Driver Core"
	depends on SPI_MASTER || I2C
	default n
	help
	  Say Y here if you have a touchscreen interface using
	  the LX Semicon touch device.

config TOUCHSCREEN_LXS_LX82907A
	bool "LX Semicon Touch Driver for LX82907A"
	depends on TOUCHSCREEN_LXS
	default n
	help
	  If your device is LX82907A, say Y

endmenu
```
