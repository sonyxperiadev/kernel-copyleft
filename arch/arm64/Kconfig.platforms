## drivers/interconnect/qcom/Kconfig
```kconfig
# SPDX-License-Identifier: GPL-2.0-only
config INTERCONNECT_QCOM_ALOR
	tristate "ALOR interconnect driver"
	depends on INTERCONNECT_QCOM
	depends on OF
	select INTERCONNECT_QCOM_BCM_VOTER
	select INTERCONNECT_QCOM_RPMH
	select INTERCONNECT_QCOM_QOS
	help
	  This is a driver for the Qualcomm Technologies, Inc. Network-on-Chip
	  on Alor-based platforms. Interconnect driver provides interfaces
	  for setting bandwidth between two endpoints (path). It also used to
	  configure NOC QoS settings (Quality of Service).

config INTERCONNECT_QCOM_BCM_VOTER
	tristate

config INTERCONNECT_QCOM_CANOE
	tristate "CANOE interconnect driver"
	depends on INTERCONNECT_QCOM
	depends on OF
	select INTERCONNECT_QCOM_BCM_VOTER
	select INTERCONNECT_QCOM_RPMH
	select INTERCONNECT_QCOM_QOS
	help
	  This is a driver for the Qualcomm Technologies, Inc. Network-on-Chip
	  on Canoe-based platforms. Interconnect driver provides interfaces
	  for setting bandwidth between two endpoints (path). It also used to
	  configure NOC QoS settings (Quality of Service).

config INTERCONNECT_QCOM_SERAPH
	tristate "SERAPH interconnect driver"
	depends on INTERCONNECT_QCOM
	depends on OF
	select INTERCONNECT_QCOM_BCM_VOTER
	select INTERCONNECT_QCOM_RPMH
	select INTERCONNECT_QCOM_QOS
	help
	  This is a driver for the Qualcomm Technologies, Inc. Network-on-Chip
	  on Seraph-based platforms. Interconnect driver provides interfaces
	  for setting bandwidth between two endpoints (path). It also used to
	  configure NOC QoS settings (Quality of Service).

config INTERCONNECT_QCOM_CHORA
	tristate "CHORA interconnect driver"
	depends on INTERCONNECT_QCOM
	depends on OF
	select INTERCONNECT_QCOM_BCM_VOTER
	select INTERCONNECT_QCOM_RPMH
	select INTERCONNECT_QCOM_QOS
	help
	  This is a driver for the Qualcomm Technologies, Inc. Network-on-Chip
	  on Chora-based platforms. Interconnect driver provides interfaces
	  for setting bandwidth between two endpoints (path). It also used to
	  configure NOC QoS settings (Quality of Service).

config INTERCONNECT_QCOM_X1P42100
	tristate "X1P42100 interconnect driver"
	depends on INTERCONNECT_QCOM
	depends on OF
	select INTERCONNECT_QCOM_BCM_VOTER
	select INTERCONNECT_QCOM_RPMH
	select INTERCONNECT_QCOM_QOS
	help
	  This is a driver for the Qualcomm Technologies, Inc. Network-on-Chip
	  on X1P42100-based platforms. Interconnect driver provides interfaces
	  for setting bandwidth between two endpoints (path). It also used to
	  configure NOC QoS settings (Quality of Service).

config INTERCONNECT_QCOM_X1E80100
	tristate "X1E80100 interconnect driver"
	depends on INTERCONNECT_QCOM
	depends on OF
	select INTERCONNECT_QCOM_BCM_VOTER
	select INTERCONNECT_QCOM_RPMH
	select INTERCONNECT_QCOM_QOS
	help
	  This is a driver for the Qualcomm Technologies, Inc. Network-on-Chip
	  on X1E80100-based platforms. Interconnect driver provides interfaces
	  for setting bandwidth between two endpoints (path). It also used to
	  configure NOC QoS settings (Quality of Service).

config INTERCONNECT_QCOM_MALABAR
	tristate "MALABAR interconnect driver"
	depends on INTERCONNECT_QCOM
	depends on MSM_RPM_SMD
	select INTERCONNECT_QCOM_RPM
	select INTERCONNECT_QCOM_QOS_RPM
	help
	  This is a driver for the Qualcomm Technologies, Inc. Network-on-Chip
	  on malabar-based platforms. The interconnect provider collects and
	  aggregates the consumer bandwidth requests to satisfy constraints
	  placed on Network-on-Chip performance states.

config INTERCONNECT_QCOM_PIKACHU
	tristate "PIKACHU interconnect driver"
	depends on INTERCONNECT_QCOM
	depends on OF
	select INTERCONNECT_QCOM_BCM_VOTER
	select INTERCONNECT_QCOM_RPMH
	select INTERCONNECT_QCOM_QOS
	help
	  This is a driver for the Qualcomm Technologies, Inc. Network-on-Chip
	  on Pikachu-based platforms. Interconnect driver provides interfaces
	  for setting bandwidth between two endpoints (path). It also used to
	  configure NOC QoS settings (Quality of Service).

config INTERCONNECT_QCOM_RPMH_POSSIBLE
	tristate
	default INTERCONNECT_QCOM
	depends on QCOM_RPMH || (COMPILE_TEST && !QCOM_RPMH)
	depends on QCOM_COMMAND_DB || (COMPILE_TEST && !QCOM_COMMAND_DB)
	depends on OF
	help
	  Compile-testing RPMH drivers is possible on other platforms,
	  but in order to avoid link failures, drivers must not be built-in
	  when QCOM_RPMH or QCOM_COMMAND_DB are loadable modules

config INTERCONNECT_QCOM_RPMH
	tristate

config INTERCONNECT_QCOM_RPM
	tristate

config INTERCONNECT_QCOM_QOS_RPM
	tristate
	help
	  This option enables Quality of Service (QoS) support for RPM-based
	  interconnect drivers. It provides the necessary infrastructure for
	  configuring QoS settings on Network-on-Chip (NoC) for RPM platforms.

config INTERCONNECT_QCOM_SA8775P
	tristate "Qualcomm SA8775P interconnect driver"
	depends on INTERCONNECT_QCOM_RPMH_POSSIBLE
	select INTERCONNECT_QCOM_RPMH
	select INTERCONNECT_QCOM_BCM_VOTER
	help
	  This is a driver for the Qualcomm Network-on-Chip on sa8775p-based
	  platforms.

config INTERCONNECT_QCOM_SC7180
	tristate "Qualcomm SC7180 interconnect driver"
	depends on INTERCONNECT_QCOM_RPMH_POSSIBLE
	select INTERCONNECT_QCOM_RPMH
	select INTERCONNECT_QCOM_BCM_VOTER
	help
	  This is a driver for the Qualcomm Network-on-Chip on sc7180-based
	  platforms.

config INTERCONNECT_QCOM_SC7280
	tristate "Qualcomm SC7280 interconnect driver"
	depends on INTERCONNECT_QCOM_RPMH_POSSIBLE
	select INTERCONNECT_QCOM_RPMH
	select INTERCONNECT_QCOM_BCM_VOTER
	help
	  This is a driver for the Qualcomm Network-on-Chip on sc7280-based
	  platforms.

config INTERCONNECT_QCOM_SC8180X
	tristate "Qualcomm SC8180X interconnect driver"
	depends on INTERCONNECT_QCOM_RPMH_POSSIBLE
	select INTERCONNECT_QCOM_RPMH
	select INTERCONNECT_QCOM_BCM_VOTER
	help
	  This is a driver for the Qualcomm Network-on-Chip on sc8180x-based
	  platforms.

config INTERCONNECT_QCOM_SC8280XP
	tristate "Qualcomm SC8280XP interconnect driver"
	depends on INTERCONNECT_QCOM_RPMH_POSSIBLE
	select INTERCONNECT_QCOM_RPMH
	select INTERCONNECT_QCOM_BCM_VOTER
	help
	  This is a driver for the Qualcomm Network-on-Chip on SC8280XP-based
	  platforms.

config INTERCONNECT_QCOM_SDM660
	tristate "Qualcomm SDM660 interconnect driver"
	depends on INTERCONNECT_QCOM
	depends on QCOM_SMD_RPM
	select INTERCONNECT_QCOM_SMD_RPM
	help
	  This is a driver for the Qualcomm Network-on-Chip on sdm660-based
	  platforms.

config INTERCONNECT_QCOM_SDM670
	tristate "Qualcomm SDM670 interconnect driver"
	depends on INTERCONNECT_QCOM_RPMH_POSSIBLE
	select INTERCONNECT_QCOM_RPMH
	select INTERCONNECT_QCOM_BCM_VOTER
	help
	  This is a driver for the Qualcomm Network-on-Chip on sdm670-based
	  platforms.

config INTERCONNECT_QCOM_SDM845
	tristate "Qualcomm SDM845 interconnect driver"
	depends on INTERCONNECT_QCOM_RPMH_POSSIBLE
	select INTERCONNECT_QCOM_RPMH
	select INTERCONNECT_QCOM_BCM_VOTER
	help
	  This is a driver for the Qualcomm Network-on-Chip on sdm845-based
	  platforms.

config INTERCONNECT_QCOM_SDX55
	tristate "Qualcomm SDX55 interconnect driver"
	depends on INTERCONNECT_QCOM_RPMH_POSSIBLE
	select INTERCONNECT_QCOM_RPMH
	select INTERCONNECT_QCOM_BCM_VOTER
	help
	  This is a driver for the Qualcomm Network-on-Chip on sdx55-based
	  platforms.

config INTERCONNECT_QCOM_SDX65
	tristate "Qualcomm SDX65 interconnect driver"
	depends on INTERCONNECT_QCOM_RPMH_POSSIBLE
	select INTERCONNECT_QCOM_RPMH
	select INTERCONNECT_QCOM_BCM_VOTER
	help
	  This is a driver for the Qualcomm Network-on-Chip on sdx65-based
	  platforms.

config INTERCONNECT_QCOM_SDX75
	tristate "Qualcomm SDX75 interconnect driver"
	depends on INTERCONNECT_QCOM_RPMH_POSSIBLE
	select INTERCONNECT_QCOM_RPMH
	select INTERCONNECT_QCOM_BCM_VOTER
	help
	  This is a driver for the Qualcomm Network-on-Chip on sdx75-based
	  platforms.

config INTERCONNECT_QCOM_SM6115
	tristate "Qualcomm SM6115 interconnect driver"
	depends on INTERCONNECT_QCOM
	depends on QCOM_SMD_RPM
	select INTERCONNECT_QCOM_SMD_RPM
	help
	  This is a driver for the Qualcomm Network-on-Chip on sm6115-based
	  platforms.

config INTERCONNECT_QCOM_SM6350
	tristate "Qualcomm SM6350 interconnect driver"
	depends on INTERCONNECT_QCOM_RPMH_POSSIBLE
	select INTERCONNECT_QCOM_RPMH
	select INTERCONNECT_QCOM_BCM_VOTER
	help
	  This is a driver for the Qualcomm Network-on-Chip on sm6350-based
	  platforms.

config INTERCONNECT_QCOM_SM7150
	tristate "Qualcomm SM7150 interconnect driver"
	depends on INTERCONNECT_QCOM_RPMH_POSSIBLE
	select INTERCONNECT_QCOM_RPMH
	select INTERCONNECT_QCOM_BCM_VOTER
	help
	  This is a driver for the Qualcomm Network-on-Chip on sm7150-based
	  platforms.

config INTERCONNECT_QCOM_SM8150
	tristate "Qualcomm SM8150 interconnect driver"
	depends on INTERCONNECT_QCOM_RPMH_POSSIBLE
	depends on INTERCONNECT_QCOM
	depends on QCOM_RPMH && QCOM_COMMAND_DB && OF
	select INTERCONNECT_QCOM_RPMH
	select INTERCONNECT_QCOM_BCM_VOTER
	select INTERCONNECT_QCOM_QOS
	help
	  This is a driver for the Qualcomm Network-on-Chip on sm8150-based
	  platforms.

config INTERCONNECT_QCOM_SM8250
	tristate "Qualcomm SM8250 interconnect driver"
	depends on INTERCONNECT_QCOM_RPMH_POSSIBLE
	select INTERCONNECT_QCOM_RPMH
	select INTERCONNECT_QCOM_BCM_VOTER
	help
	  This is a driver for the Qualcomm Network-on-Chip on sm8250-based
	  platforms.

config INTERCONNECT_QCOM_SM8350
	tristate "Qualcomm SM8350 interconnect driver"
	depends on INTERCONNECT_QCOM_RPMH_POSSIBLE
	select INTERCONNECT_QCOM_RPMH
	select INTERCONNECT_QCOM_BCM_VOTER
	help
	  This is a driver for the Qualcomm Network-on-Chip on SM8350-based
	  platforms.

config INTERCONNECT_QCOM_SM8450
	tristate "Qualcomm SM8450 interconnect driver"
	depends on INTERCONNECT_QCOM_RPMH_POSSIBLE
	select INTERCONNECT_QCOM_RPMH
	select INTERCONNECT_QCOM_BCM_VOTER
	help
	  This is a driver for the Qualcomm Network-on-Chip on SM8450-based
	  platforms.

config INTERCONNECT_QCOM_SUN
	tristate "SUN interconnect driver"
	depends on INTERCONNECT_QCOM
	depends on OF
	select INTERCONNECT_QCOM_BCM_VOTER
	select INTERCONNECT_QCOM_RPMH
	select INTERCONNECT_QCOM_QOS
	help
	  This is a driver for the Qualcomm Technologies, Inc. Network-on-Chip
	  on Sun-based platforms. Interconnect driver provides interfaces
	  for setting bandwidth between two endpoints (path). It also used to
	  configure NOC QoS settings (Quality of Service).

config INTERCONNECT_QCOM_VIENNA
        tristate "VIENNA interconnect driver"
        depends on INTERCONNECT_QCOM
        depends on OF
        select INTERCONNECT_QCOM_BCM_VOTER
        select INTERCONNECT_QCOM_RPMH
        select INTERCONNECT_QCOM_QOS
        help
          This is a driver for the Qualcomm Technologies, Inc. Network-on-Chip
          on Vienna-based platforms. Interconnect driver provides interfaces
          for setting bandwidth between two endpoints (path). It also used to
          configure NOC QoS settings (Quality of Service).

config INTERCONNECT_QCOM_PINEAPPLE
        tristate "PINEAPPLE interconnect driver"
        depends on INTERCONNECT_QCOM
        depends on OF
        select INTERCONNECT_QCOM_BCM_VOTER
        select INTERCONNECT_QCOM_RPMH
        select INTERCONNECT_QCOM_QOS
        help
          This is a driver for the Qualcomm Technologies, Inc. Network-on-Chip
          on Pineapple-based platforms. Interconnect driver provides interfaces
          for setting bandwidth between two endpoints (path). It also used to
          configure NOC QoS settings (Quality of Service).

config INTERCONNECT_QCOM_YUPIK
	tristate "YUPIK interconnect driver"
	depends on INTERCONNECT_QCOM
        depends on OF
        select INTERCONNECT_QCOM_BCM_VOTER
        select INTERCONNECT_QCOM_RPMH
        select INTERCONNECT_QCOM_QOS
	help
	  This is a driver for the Qualcomm Technologies, Inc. Network-on-Chip
	  on yupik-based platforms. The interconnect provider collects and
	  aggreagates the cosumer bandwidth requests to satisfy constraints
	  placed on Network-on-Chip performance states.

config INTERCONNECT_QCOM_BENGAL
	tristate "BENGAL interconnect driver"
	depends on INTERCONNECT_QCOM
	depends on MSM_RPM_SMD
	select INTERCONNECT_QCOM_RPM
	select INTERCONNECT_QCOM_QOS_RPM
	help
	  This is a driver for the Qualcomm Technologies, Inc. Network-on-Chip
	  on bengal-based platforms. The interconnect provider collects and
	  aggreagates the cosumer bandwidth requests to satisfy constraints
	  placed on Network-on-Chip performance states.

config INTERCONNECT_QCOM_MONACO
	tristate "MONACO interconnect driver"
	depends on INTERCONNECT_QCOM
	depends on MSM_RPM_SMD
	select INTERCONNECT_QCOM_RPM
	select INTERCONNECT_QCOM_QOS_RPM
	help
	  This is a driver for the Qualcomm Technologies, Inc. Network-on-Chip
	  on monaco-based platforms. The interconnect provider collects and
	  aggreagates the consumer bandwidth requests to satisfy constraints
	  placed on Network-on-Chip performance states.

config INTERCONNECT_QCOM_QOS
	tristate

config INTERCONNECT_QCOM_DEBUG
	tristate "QCOM-specific interconnect debug features"
	depends on INTERCONNECT_QCOM
	help
	  This driver provides debug features specific to
	  Qualcomm Technologies, Inc. interconnect drivers. These features
	  include optionally printing all enabled interconnect votes when
	  entering suspend.
```

## drivers/leds/Kconfig
```kconfig
# SPDX-License-Identifier: GPL-2.0-only
# This library does not depend on NEW_LEDS and must be independent so it can be
# selected from other subsystems (specifically backlight).
if NEW_LEDS

comment "LED drivers"

config LEDS_QTI_FLASH
	tristate "Support for QTI Flash LEDs"
	depends on LEDS_CLASS_FLASH
	depends on MFD_SPMI_PMIC
	select LEDS_TRIGGERS
	help
	  This driver supports flash LED peripheral that is present on
	  some Qualcomm Technologies, Inc. PMICs (e.g. PM8350C).  It can
	  configure the flash LED target current for several independent
	  channels. It also supports various over current and over
	  temperature mitigation features.

	  To compile this driver as a module, choose M here: the
	  module will be called leds-qti-flash.

config LEDS_QPNP_VIBRATOR_LDO
        tristate "Vibrator-LDO support for QPNP PMIC"
        depends on LEDS_CLASS && MFD_SPMI_PMIC
        help
          This option enables device driver support for the vibrator-ldo
          peripheral found on Qualcomm Technologies, Inc. QPNP PMICs.
          The vibrator-ldo peripheral is capable of driving ERM vibrators.

          To compile this driver as a module, choose M here: the module
          will be called leds-qpnp-vibrator-ldo.

config LEDS_AW2016
	tristate "LED Support for AW2016"
	depends on LEDS_CLASS && I2C
	help
	  this option enables support for the AW2016 RGB LED connected
	  through I2C. Say Y to enable support for the AW2016 LED.

	  To compile this driver as a module, choose M here: the module
	  will be called leds-aw2016.

endif # NEW_LEDS
```
