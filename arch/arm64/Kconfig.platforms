## drivers/misc/Kconfig
```kconfig
# SPDX-License-Identifier: GPL-2.0-only
#
# Misc strange devices
#
# Copyright 2025 Sony Corporation
# NOTE: This file has been modified by Sony Corporation
# Modifications are licensed under the License.
#

menu "Misc devices"

config QCOM_COINCELL
	tristate "Qualcomm coincell charger support"
	depends on MFD_SPMI_PMIC || COMPILE_TEST
	help
	  This driver supports the coincell block found inside of
	  Qualcomm PMICs.  The coincell charger provides a means to
	  charge a coincell battery or backup capacitor which is used
	  to maintain PMIC register and RTC state in the absence of
	  external power.

config QSEECOM_PROXY
	tristate "To enable qseecom proxy driver for kernel client"
	help
	 qseecom proxy driver serves the kernel clients by providing
	 required ops via call back functions with a minimal framework.
	 These callback functions can be used to start, shutdown and
	 send commands to the trusted apps.

config LKDTM
	tristate "Linux Kernel Dump Test Tool Module"
	depends on DEBUG_FS
	help
	This module enables testing of the different dumping mechanisms by
	inducing system failures at predefined crash points.
	If you don't need it: say N
	Choose M here to compile this code as a module. The module will be
	called lkdtm.

	Documentation on how to use the module can be found in
	Documentation/fault-injection/provoke-crashes.rst

source "$(KCONFIG_EXT_PREFIX)drivers/misc/hardware_info/Kconfig"

endmenu
```

## drivers/misc/hardware_info/Kconfig
```kconfig
# SPDX-License-Identifier: GPL-2.0-only
#
# Misc strange devices
#

menu "Misc devices"

config HARDWAREINFO
    tristate "Hardware info support"
    default m
    help
     test

endmenu
```

## drivers/mmc/core/Kconfig
```kconfig
config MMC_ERROR_LOGGING
	tristate "MMC error logging support"
	depends on MMC_BLOCK
	depends on FELS
	default n
	help
	  This driver collects mmc errors by leveraging some tracepoints and
	  vendor hooks and passes them to fels framework.
```

## drivers/nfc/qti_rest/Kconfig
```kconfig
config GPIO_G7_RESET
    tristate "NXP Reset Driver"
    default y
    help
    This driver for NXP reset test case.
```

## drivers/phy/qualcomm/Kconfig
```kconfig
# SPDX-License-Identifier: GPL-2.0-only
#
# Phy drivers for Qualcomm and Atheros platforms
#

config PHY_QCOM_UFS
	tristate "Qualcomm Technologies, Inc. UFS PHY driver"
	depends on OF && ARCH_QCOM
	select GENERIC_PHY
	help
	  Enables support for UFS PHY on Qualcomm Technologies, Inc.
	  chipsets.
	  This driver together with the UFS PHY controller specific
	  driver enables the UFS PHY support for Qualcomm Technologies, Inc.
	  chips.

if PHY_QCOM_UFS

config PHY_QCOM_UFS_V4
	tristate "Qualcomm Technologies, Inc. UFS V4"
	depends on PHY_QCOM_UFS
	help
	  Support for 7nm UFS QMP phy present on QCOM chipsets.
	  This is required to enable UFS on QCOM chipset.
	  To compile this driver as a module, choose M here.

config PHY_QCOM_UFS_V4_GEN3AUTO
	tristate "Qualcomm Technologies, Inc. UFS gen3auto Phy Driver"
	depends on PHY_QCOM_UFS
	help
	  Support for 7nm UFS QMP phy present on QCOM chipsets.
	  This is required to enable UFS on QCOM chipset.
	  To compile this driver as a module, choose M here.

config PHY_QCOM_UFS_QRBTC_SDM845
	tristate "Qualcomm Technologies, Inc. UFS Presil Phy Driver"
	depends on PHY_QCOM_UFS && REGULATOR_STUB
	help
	  Enable this to support UFS PHY on pre-silicon platforms.
	  The support is restricted to HS-G1 only on both Tx and Rx.
	  No low power mode support is present.
	  Doesn't restrict number of lanes.

config PHY_QCOM_UFS_V4_SUN
	tristate "Qualcomm Technologies, Inc. UFS Sun Phy Driver"
	depends on PHY_QCOM_UFS
	help
	  Support for UFS phy present on QCOM Sun chipsets.
	  This is required to enable UFS on Sun chipset.
	  To compile this driver as a module, choose M here.

config PHY_QCOM_UFS_V4_CANOE
	tristate "Qualcomm Technologies, Inc. UFS Canoe Phy Driver"
	depends on PHY_QCOM_UFS
	help
	  This configuration option adds support for the UFS
	  PHY present on QCOM Canoe chipsets.
	  This is required to enable UFS on Canoe chipset.
	  To compile this driver as a module, choose M here.

config PHY_QCOM_UFS_V4_YUPIK
	tristate "Qualcomm Technologies, Inc. UFS Yupik Phy Driver"
	depends on PHY_QCOM_UFS
	help
	  This configuration option adds support for the UFS
	  PHY present on QCOM Yupik chipsets.
	  This is required to enable UFS on Yupik chipset.
	  To compile this driver as a module, choose M here.

config PHY_QCOM_UFS_V4_WAIPIO
	tristate "Qualcomm Technologies, Inc. UFS Waipio Phy Driver"
	depends on PHY_QCOM_UFS
	help
	  This configuration option adds support for the UFS
	  PHY present on QCOM Waipio chipsets.
	  This is required to enable UFS on Waipio chipset.
	  To compile this driver as a module, choose M here.

config PHY_QCOM_SNPS_EUSB2
	tristate "Qualcomm SNPS eUSB2 PHY Driver"
	depends on OF && (ARCH_QCOM || COMPILE_TEST)
	select GENERIC_PHY
	help
	  Enable support for the USB high-speed SNPS eUSB2 phy on Qualcomm
	  chipsets. The PHY is paired with a Synopsys DWC3 USB controller
	  on Qualcomm SOCs. It is required for proper USB functionality on
	  platforms that integrate this PHY, such as certain Snapdragon
	  SoCs. Enable this option if you are building for a Qualcomm
	  platform that uses the SNPS eUSB2 PHY, or if you are performing
	  compile testing for PHY drivers.

config PHY_QCOM_UFS_V4_KHAJE
	tristate "Qualcomm Technologies, Inc. UFS Khaje Phy Driver"
	depends on PHY_QCOM_UFS
	help
	  This configuration option adds support for the UFS
	  PHY present on QCOM Khaje chipsets.
	  This is required to enable UFS on Khaje chipset.
	  To compile this driver as a module, choose M here.
	  This is good debug.

endif

config PHY_QCOM_EUSB2_REPEATER
	tristate "Qualcomm eUSB2 Repeater Driver"
	depends on OF && (ARCH_QCOM || COMPILE_TEST)
	select GENERIC_PHY
	help
	  Enable support for the USB high-speed eUSB2 repeater on Qualcomm
	  PMICs. The repeater is paired with an eUSB2 Phy on Qualcomm SOCs.
	  This is required for voltage inter-operability between the eUSB2
	  phy and the DP/DM lines connecting the USB host.
	  PMICs. The repeater is paired with a eUSB2 Phy
	  on Qualcomm SOCs.

config PHY_QCOM_M31_EUSB2
	tristate "Qualcomm M31 eUSB2 PHY Driver"
	depends on OF && (ARCH_QCOM || COMPILE_TEST)
	select GENERIC_PHY
	help
	  Enable support for the USB high-speed M31 eUSB2 phy on Qualcomm
	  chipsets. The PHY is paired with a Synopsys DWC3 USB controller
	  on Qualcomm SOCs. This is required for the USB controller to
	  communicate with the USB host in High-Speed mode.

config PHY_QCOM_QMP_COMBO
	tristate "Qualcomm QMP Combo PHY Driver"
	depends on OF && COMMON_CLK && (ARCH_QCOM || COMPILE_TEST)
	depends on TYPEC || TYPEC=n
	depends on DRM || DRM=n
	select GENERIC_PHY
	select MFD_SYSCON
	help
	  Enable this to support the QMP Combo PHY transceiver that is used
	  with USB3 and DisplayPort controllers on Qualcomm chips. This is
	  required for the USB controller to communicate with the USB host
	  in Super-Speed mode.
```

## drivers/pinctrl/qcom/Kconfig.msm
```kconfig
# SPDX-License-Identifier: GPL-2.0-only
if PINCTRL_MSM

config PINCTRL_CANOE
	tristate "Qualcomm Technologies, Inc. CANOE pin controller driver"
	depends on GPIOLIB && OF
	help
	  This is the pinctrl, pinmux, pinconf and gpiolib driver for the
	  Qualcomm Technologies Inc Top Level Mode Multiplexer block (TLMM)
	  block found on the Qualcomm Technologies Inc CANOE platform.
	  Say Y here to compile statically, or M here to compile it as a
	  module. If unsure, say N.

config PINCTRL_ALOR
	tristate "Qualcomm Technologies, Inc. Alor pin controller driver"
	depends on GPIOLIB && OF
	help
	  This is the pinctrl, pinmux, pinconf and gpiolib driver for the
	  Qualcomm Technologies Inc Top Level Mode Multiplexer block (TLMM)
	  block found on the Qualcomm Technologies Inc Alor platform.
	  Say Y here to compile statically, or M here to compile it as a
	  module. If unsure, say N.

config PINCTRL_CHORA
	tristate "Qualcomm Technologies, Inc. Chora pin controller driver"
	depends on GPIOLIB && OF
	help
	  This is the pinctrl, pinmux, pinconf and gpiolib driver for the
	  Qualcomm Technologies Inc Top Level Mode Multiplexer block (TLMM)
	  block found on the Qualcomm Technologies Inc Malabar platform.
	  Say Y here to compile statically, or M here to compile it as a
	  module. If unsure, say N.

config PINCTRL_MALABAR
	tristate "Qualcomm Technologies, Inc. Malabar pin controller driver"
	depends on GPIOLIB && OF
	help
	  This is the pinctrl, pinmux, pinconf and gpiolib driver for the
	  Qualcomm Technologies Inc Top Level Mode Multiplexer block (TLMM)
	  block found on the Qualcomm Technologies Inc Malabar platform.
	  Say Y here to compile statically, or M here to compile it as a
	  module. If unsure, say N.

config PINCTRL_SUN
	tristate "Qualcomm Technologies, Inc. SUN pin controller driver"
	depends on GPIOLIB && OF
	help
	  This is the pinctrl, pinmux, pinconf and gpiolib driver for the
	  Qualcomm Technologies Inc Top Level Mode Multiplexer block (TLMM)
	  block found on the Qualcomm Technologies Inc SUN platform.
	  Say Y here to compile statically, or M here to compile it as a
	  module. If unsure, say N.

config PINCTRL_VIENNA
	tristate "Qualcomm Technologies, Inc. VIENNA pin controller driver"
	depends on GPIOLIB && OF
	help
	  This is the pinctrl, pinmux, pinconf and gpiolib driver for the
	  Qualcomm Technologies Inc Top Level Mode Multiplexer block (TLMM)
	  block found on the Qualcomm Technologies Inc VIENNA platform.
	  Say Y here to compile statically, or M here to compile it as a
	  module. If unsure, say N.

config PINCTRL_PINEAPPLE
	tristate "Qualcomm Technologies, Inc. Pineapple pin controller driver"
	depends on GPIOLIB && OF
	help
	  This is the pinctrl, pinmux, pinconf and gpiolib driver for the
	  Qualcomm Technologies Inc Top Level Mode Multiplexer block (TLMM)
	  block found on the Qualcomm Technologies Inc PINEAPPLE platform.
	  Say Y here to compile statically, or M here to compile it as a
	  module. If unsure, say N.

config PINCTRL_X1E80100
	tristate "Qualcomm Technologies Inc X1E80100 pin controller driver"
	depends on GPIOLIB && OF
	help
	  This is the pinctrl, pinmux, pinconf and gpiolib driver for the
	  Qualcomm Technologies Inc Top Level Mode Multiplexer block (TLMM)
	  block found on the Qualcomm Technologies Inc X1E80100 platform.
	  Say Y here to compile statically, or M here to compile it as a module.
	  If unsure, say N.

config PINCTRL_YUPIK
	tristate "Qualcomm Technologies Inc YUPIK pin controller driver"
	depends on GPIOLIB && OF
	help
	  This is the pinctrl, pinmux, pinconf and gpiolib driver for the
	  Qualcomm Technologies Inc Top Level Mode Multiplexer block (TLMM)
	  block found on the Qualcomm Technologies Inc YUPIK platform.
	  Say Y here to compile statically, or M here to compile it as a module.
	  If unsure, say N.

config PINCTRL_KHAJE
	tristate "Qualcomm Technologies, Inc KHAJE pin controller driver"
	depends on GPIOLIB && OF
	help
	  This is the pinctrl, pinmux, pinconf and gpiolib driver for the
	  Qualcomm Technologies Inc Top Level Mode Multiplexer block (TLMM)
	  block found on the Qualcomm Technologies Inc KHAJE platform.
	  Say Y here to compile statically, or M here to compile it as a module.
	  If unsure, say N.

config PINCTRL_BENGAL
	tristate "Qualcomm Technologies, Inc BENGAL pin controller driver"
	depends on GPIOLIB && OF
	help
	  This is the pinctrl, pinmux, pinconf and gpiolib driver for the
	  Qualcomm Technologies Inc Top Level Mode Multiplexer block (TLMM)
	  block found on the Qualcomm Technologies Inc BENGAL platform.
	  Say Y here to compile statically, or M here to compile it as a module.
	  If unsure, say N.

config PINCTRL_PIKACHU
	tristate "Qualcomm Technologies, Inc. PIKACHU pin controller driver"
	depends on GPIOLIB && OF
	help
	  This is the pinctrl, pinmux, pinconf and gpiolib driver for the
	  Qualcomm Technologies Inc Top Level Mode Multiplexer block (TLMM)
	  block found on the Qualcomm Technologies Inc PIKACHU platform.
	  Say Y here to compile statically, or M here to compile it as a
	  module. If unsure, say N.

config PINCTRL_MONACO
        tristate "Qualcomm Technologies, Inc MONACO pin controller driver"
        depends on GPIOLIB && OF
        help
          This is the pinctrl, pinmux, pinconf and gpiolib driver for the
          Qualcomm Technologies Inc Top Level Mode Multiplexer block (TLMM)
          block found on the Qualcomm Technologies Inc MONACO platform.
          Say Y here to compile statically, or M here to compile it as a
          module. If unsure, say N.

config PINCTRL_SHIKRA
	tristate "Qualcomm Technologies, Inc. SHIKRA pin controller driver"
	depends on GPIOLIB && OF
	help
	  This is the pinctrl, pinmux, pinconf and gpiolib driver for the
	  Qualcomm Technologies Inc Top Level Mode Multiplexer block (TLMM)
	  block found on the Qualcomm Technologies Inc SHIKRA platform.
	  Say Y here to compile statically, or M here to compile it as a module.
	  If unsure, say N.

config PINCTRL_SERAPH
	tristate "Qualcomm Technologies, Inc. SERAPH pin controller driver"
	depends on GPIOLIB && OF
	help
	  This is the pinctrl, pinmux, pinconf and gpiolib driver for the
	  Qualcomm Technologies Inc Top Level Mode Multiplexer block (TLMM)
	  block found on the Qualcomm Technologies Inc SERAPH platform.
	  Say Y here to compile statically, or M here to compile it as a
	  module. If unsure, say N.

endif
```
