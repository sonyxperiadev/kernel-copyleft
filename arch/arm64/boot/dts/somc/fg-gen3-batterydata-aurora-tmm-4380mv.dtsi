/* Copyright (c) 2017, The Linux Foundation. All rights reserved.
 *
 * This program is free software; you can redistribute it and/or modify
 * it under the terms of the GNU General Public License version 2 and
 * only version 2 as published by the Free Software Foundation.
 *
 * This program is distributed in the hope that it will be useful,
 * but WITHOUT ANY WARRANTY; without even the implied warranty of
 * MERCHANTABILITY or FITNESS FOR A PARTICULAR PURPOSE.  See the
 * GNU General Public License for more details.
 */
/*
 * Copyright (C) 2018 Sony Mobile Communications Inc.
 *
 * This program is free software; you can redistribute it and/or modify
 * it under the terms of the GNU General Public License version 2, as
 * published by the Free Software Foundation.
 */

qcom,aurora_tmm_4380mv {
	qcom, = <24>;
	somc,initial-capacity-uah = <3554000>;
	qcom,max-voltage-uv = <4380000>;
	qcom,fg-cc-cv-threshold-mv = <4370>;
	qcom,fastchg-current-ma = <2550>;
	qcom,batt-id-kohm = <330>;
	qcom,battery-beta = <4050>;
	qcom,battery-type = "1310-1690-0";
	qcom,checksum = <0x2DCF>;
	qcom,gui-version = "PMI8998GUI - 2.0.0.58";
	qcom,fg-profile-data = [
		 73 1F B6 05
		 51 0A 79 06
		 A0 1C 7B FB
		 40 06 8A EA
		 90 18 44 22
		 F8 3C CC 4A
		 58 00 00 00
		 13 00 00 00
		 00 00 31 CA
		 13 CC D1 BA
		 28 00 08 00
		 EE DD BC DC
		 BE 05 99 FA
		 98 05 01 0A
		 42 D3 CA 23
		 35 06 09 20
		 27 00 14 00
		 B1 1B DE 01
		 EF FD E3 F3
		 89 1C 12 03
		 6C 0C 64 0B
		 FD 18 64 22
		 7B 3C 96 4B
		 83 00 00 00
		 0D 00 00 00
		 00 00 DC D5
		 00 A4 86 CA
		 21 00 00 00
		 27 EA BC DC
		 17 FC 0E 01
		 83 FC 38 02
		 8C 07 1B 1A
		 AE 33 CC FF
		 07 10 00 00
		 E2 0D 14 46
		 21 00 40 00
		 B5 01 0A FA
		 FF 00 00 00
		 00 00 00 00
		 00 00 00 00
		 00 00 00 00
		 00 00 00 00
		 00 00 00 00
		 00 00 00 00
		 00 00 00 00
		 00 00 00 00
		 00 00 00 00
		 00 00 00 00
		 00 00 00 00
		 00 00 00 00
		 00 00 00 00
		 00 00 00 00
		 00 00 00 00
		 00 00 00 00
		 00 00 00 00
		 00 00 00 00
	];
};
