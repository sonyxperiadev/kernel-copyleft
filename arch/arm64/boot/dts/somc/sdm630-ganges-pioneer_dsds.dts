/* Copyright (c) 2017, The Linux Foundation. All rights reserved.
 *
 * This program is free software; you can redistribute it and/or modify
 * it under the terms of the GNU General Public License version 2 and
 * only version 2 as published by the Free Software Foundation.
 *
 * This program is distributed in the hope that it will be useful,
 * but WITHOUT ANY WARRANTY; without even the implied warranty of
 * MERCHANTABILITY or FITNESS FOR A PARTICULAR PURPOSE.  See the
 * GNU General Public License for more details.
 */


/dts-v1/;

#include "../qcom/sdm630.dtsi"
#include "../qcom/sdm630-mtp.dtsi"
#include "../qcom/sdm660-internal-codec.dtsi"
#include "sdm630-ganges-pioneer_dsds.dtsi"

/ {
	model = "Sony Mobile Communications. Pioneer(sdm630)";
	compatible = "somc,pioneer-row", "qcom,sdm630-mtp", "qcom,sdm630", "qcom,mtp";
	qcom,board-id = <8 1>;
	qcom,pmic-id = <0x0001001b 0x0101011a 0x0 0x0>,
			<0x0001001b 0x0201011a 0x0 0x0>;
};

&int_codec {
	qcom,model = "sdm660-snd-card-mtp";
};
