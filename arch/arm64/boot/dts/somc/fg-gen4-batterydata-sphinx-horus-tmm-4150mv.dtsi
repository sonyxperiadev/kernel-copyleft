/* Copyright (c) 2019, The Linux Foundation. All rights reserved.
 *
 * This program is free software; you can redistribute it and/or modify
 * it under the terms of the GNU General Public License version 2 and
 * only version 2 as published by the Free Software Foundation.
 *
 * This program is distributed in the hope that it will be useful,
 * but WITHOUT ANY WARRANTY; without even the implied warranty of
 * MERCHANTABILITY or FITNESS FOR A PARTICULAR PURPOSE.  See the
 * GNU General Public License for more details.
 */

qcom,sphinx_horus_tmm_4150mv {
	/* Added or Modified by SOMC */
	qcom,battery-type = "1318-8877";
	qcom,fastchg-current-ma = <3000>;
	somc,initial-capacity-uah = <3329000>;
	somc,step-cfg = <
		(-2550) 50    0 4500    0 4150 1
		   50  100    0 4500  950 4150 2
		  100  450    0 4250 3000 4150 3
		  100  450 4250 4300 1600 4150 3
		  100  450 4300 4500  950 4150 3
		  450  550    0 4500  950 4150 4
		  550 2550    0 4500    0 4150 5
	>;
	somc,step-cell-impedance-mohm = <20>;

	/* Prepared by Qualcomm */
	qcom,profile-revision = <24>;
	/* #3836814_SoMC_RenMurata_2594mAh_averaged_MasterSlave_Feb8th2019*/
	qcom,max-voltage-uv = <4150000>;
	qcom,fg-cc-cv-threshold-mv = <4140>;
	qcom,nom-batt-capacity-mah = <2594>;
	qcom,batt-id-kohm = <330>;
	qcom,battery-beta = <4250>;
	qcom,therm-room-temp = <100000>;
	/* qcom,battery-type = "3836814_somc_renmurata_2594mah_averaged_masterslave_feb8th2019"; */
	qcom,therm-coefficients = <0x2318 0xd0c 0xdaf7 0xc556 0x848d>;
	qcom,therm-center-offset = <0x70>;
	qcom,therm-pull-up = <100>;
	qcom,rslow-normal-coeffs = <0xa6 0x06 0xc5 0x03>;
	qcom,rslow-low-coeffs = <0x71 0x05 0xd3 0x02>;
	qcom,checksum = <0xA886>;
	qcom,gui-version = "PM855GUI - 1.0.0.13";
	qcom,fg-profile-data = [
		 09 00 F1 EA
		 3D ED 91 F2
		 26 ED 00 00
		 2C C5 26 9A
		 DB 87 46 AB
		 9E AD 51 87
		 32 00 A6 06
		 C5 03 0B 04
		 CF 02 CE 07
		 32 00 85 F2
		 EF F5 87 D5
		 D1 01 05 D3
		 D8 BD 59 0B
		 3B CD 76 9A
		 60 00 3F 00
		 40 00 41 00
		 42 00 42 00
		 3C 00 3A 00
		 3F 00 3B 00
		 32 00 60 00
		 30 00 37 00
		 3B 00 42 00
		 3A 00 33 00
		 38 64 42 00
		 37 08 2E 08
		 60 F8 5A 00
		 58 00 57 08
		 73 00 5F 00
		 56 20 60 38
		 6F 48 5E 16
		 58 00 D8 00
		 E1 21 E9 0D
		 DD 02 83 04
		 16 1C A3 0A
		 82 05 DD 23
		 80 17 AB 3A
		 53 4C 8A 03
		 A3 17 77 21
		 11 14 E8 12
		 04 0E 6E 1C
		 3E 02 DB 05
		 86 03 70 17
		 B1 22 7F 3C
		 29 4B 9C 18
		 41 28 7C ED
		 49 CB 8E D5
		 88 1C C0 C9
		 43 05 38 C2
		 A6 17 8D 9A
		 BA 84 E6 AA
		 BE 90 09 80
		 7F 02 BC 04
		 A2 02 C3 04
		 00 F8 47 F5
		 1C F2 DB F7
		 88 05 24 C4
		 8A F1 27 E8
		 BD BE 37 02
		 1C 05 05 02
		 CE 07 32 00
		 59 03 7D 02
		 9A 04 B7 03
		 A8 07 FE 03
		 AD 04 B4 03
		 12 04 58 00
		 33 00 43 00
		 49 64 4C 00
		 4D E8 4B E0
		 4B F0 4B 00
		 4F 00 50 08
		 4B 08 34 00
		 40 20 40 38
		 42 48 47 14
		 4B 00 46 08
		 42 08 49 00
		 41 00 35 00
		 30 08 40 08
		 45 00 45 20
		 50 38 5C 48
		 51 15 49 00
		 54 00 53 08
		 D8 00 18 1E
		 1F 02 42 0D
		 2A 0A 67 1C
		 68 23 09 3C
		 79 4B 38 18
		 AA 02 1E 04
		 FE 03 67 17
		 3F 0A 28 22
		 C1 05 51 03
		 96 05 7C 1C
		 C4 02 1F 05
		 51 02 65 18
		 75 02 90 04
		 62 03 96 00
		 6E 20 27 05
		 49 02 73 06
		 80 1C 6E 02
		 90 05 0B 02
		 89 18 2E 02
		 35 05 84 02
		 8F 00 68 01
		 C0 00 FA 00
		 87 0A 00 00
	];
};
