/* Copyright (c) 2017, The Linux Foundation. All rights reserved.
 *
 * This program is free software; you can redistribute it and/or modify
 * it under the terms of the GNU General Public License version 2 and
 * only version 2 as published by the Free Software Foundation.
 *
 * This program is distributed in the hope that it will be useful,
 * but WITHOUT ANY WARRANTY; without even the implied warranty of
 * MERCHANTABILITY or FITNESS FOR A PARTICULAR PURPOSE.  See the
 * GNU General Public License for more details.
 */
/*
 * Copyright (C) 2018 Sony Mobile Communications Inc.
 *
 * This program is free software; you can redistribute it and/or modify
 * it under the terms of the GNU General Public License version 2, as
 * published by the Free Software Foundation.
 */

qcom,aurora_tmm_4300mv {
	qcom, = <24>;
	somc,initial-capacity-uah = <3554000>;
	qcom,max-voltage-uv = <4297500>;
	qcom,fg-cc-cv-threshold-mv = <4287>;
	qcom,fastchg-current-ma = <2550>;
	qcom,batt-id-kohm = <330>;
	qcom,battery-beta = <4050>;
	qcom,battery-type = "1310-1690-2";
	qcom,checksum = <0x8EDC>;
	qcom,gui-version = "PMI8998GUI - 2.0.0.58";
	qcom,fg-profile-data = [
		 40 17 F0 0A
		 EA 0C 08 03
		 6E 1C 4F 02
		 D8 0D B3 03
		 A9 18 32 22
		 27 3D 84 4A
		 8F 00 00 00
		 0F 00 00 00
		 00 00 31 CA
		 94 D5 41 C3
		 28 00 08 00
		 37 DC A4 D4
		 99 05 6E 01
		 F1 04 14 0A
		 00 A4 36 22
		 44 06 09 20
		 27 00 14 00
		 0C 18 B7 0A
		 1B 0D EB 02
		 89 1C DC 02
		 F0 0C AA 0A
		 DA 18 71 22
		 51 3C F8 4B
		 97 00 00 00
		 0E 00 00 00
		 00 00 F5 07
		 E5 AB 1C D2
		 21 00 00 00
		 94 E3 A4 D4
		 05 FC 2B FA
		 CB FC CA 02
		 64 06 8F 12
		 9C 33 CC FF
		 07 10 00 00
		 EF 0C C0 44
		 21 00 40 00
		 BD 01 0A FA
		 FF 00 00 00
		 00 00 00 00
		 00 00 00 00
		 00 00 00 00
		 00 00 00 00
		 00 00 00 00
		 00 00 00 00
		 00 00 00 00
		 00 00 00 00
		 00 00 00 00
		 00 00 00 00
		 00 00 00 00
		 00 00 00 00
		 00 00 00 00
		 00 00 00 00
		 00 00 00 00
		 00 00 00 00
		 00 00 00 00
		 00 00 00 00
	];
};
