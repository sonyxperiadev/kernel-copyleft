/* Copyright (c) 2017-2018, The Linux Foundation. All rights reserved.
 *
 * This program is free software; you can redistribute it and/or modify
 * it under the terms of the GNU General Public License version 2 and
 * only version 2 as published by the Free Software Foundation.
 *
 * This program is distributed in the hope that it will be useful,
 * but WITHOUT ANY WARRANTY; without even the implied warranty of
 * MERCHANTABILITY or FITNESS FOR A PARTICULAR PURPOSE.  See the
 * GNU General Public License for more details.
 */

/dts-v1/;

#include "../qcom/sm8150.dtsi"
#include "../qcom/sm8150-mtp.dtsi"
#include "../qcom/sdx5xm-external-soc.dtsi"
#include "../qcom/sm8150-sdx50m.dtsi"
#include "sm8150-sdx50m-kumano-plus-cdb.dtsi"

/ {
	model = "Sony Mobile Communications Inc., Kumano-PLUS-CDB(SM8150+SDX50M v1)";
	compatible = "somc,kumano-plus-cdb", "qcom,sm8150", "qcom,mtp";
	qcom,board-id = <0x01010008 0x1>;
};
