/* arch/arm64/boot/dts/somc/somc-kumano-nfc_pn553.dtsi
 *
 * This program is free software; you can redistribute it and/or modify
 * it under the terms of the GNU General Public License version 2 and
 * only version 2 as published by the Free Software Foundation.
 *
 * This program is distributed in the hope that it will be useful,
 * but WITHOUT ANY WARRANTY; without even the implied warranty of
 * MERCHANTABILITY or FITNESS FOR A PARTICULAR PURPOSE.  See the
 * GNU General Public License for more details.
 */

&qupv3_se4_i2c {
	nfc@28 {
		compatible = "nxp,pn553";
		reg = <0x28>;
		interrupt-parent = <&tlmm>;
		interrupts = <47 0x1>;
		nxp,irq_gpio = <&tlmm 47 0x00>;
		nxp,dwld_en = <&tlmm 48 0x00>;
		nxp,ven = <&tlmm 41 0x01>;
		nxp,ese-pwr = <&tlmm 42 0x00>;
	};
};

&soc {
	nfc,pm-ops {
		compatible = "sony,pn553-pm-ops";
	};
};
