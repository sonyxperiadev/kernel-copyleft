/* Copyright (c) 2017, The Linux Foundation. All rights reserved.
 *
 * This program is free software; you can redistribute it and/or modify
 * it under the terms of the GNU General Public License version 2 and
 * only version 2 as published by the Free Software Foundation.
 *
 * This program is distributed in the hope that it will be useful,
 * but WITHOUT ANY WARRANTY; without even the implied warranty of
 * MERCHANTABILITY or FITNESS FOR A PARTICULAR PURPOSE.  See the
 * GNU General Public License for more details.
 */

&mdss_mdp {
	dsi_default_panel: somc,default_cmd_panel {
		qcom,mdss-dsi-panel-name =
				"default";
		qcom,mdss-dsi-panel-type = "dsi_cmd_mode";
		qcom,mdss-dsi-panel-width = <1080>;
		qcom,mdss-dsi-panel-height = <1920>;
		qcom,mdss-dsi-bpp = <24>;
		qcom,mdss-dsi-h-back-porch = <56>;
		qcom,mdss-dsi-h-pulse-width = <20>;
		qcom,mdss-dsi-h-front-porch = <104>;
		qcom,mdss-dsi-v-back-porch = <8>;
		qcom,mdss-dsi-v-pulse-width = <2>;
		qcom,mdss-dsi-v-front-porch = <10>;
		qcom,mdss-pan-physical-width-dimension = <64>;
		qcom,mdss-pan-physical-height-dimension = <115>;
		qcom,mdss-dsi-panel-framerate = <60>;
		qcom,mdss-dsi-virtual-channel-id = <0>;
		qcom,mdss-dsi-stream = <0>;
		qcom,mdss-dsi-h-sync-skew = <0>;
		qcom,mdss-dsi-h-left-border = <0>;
		qcom,mdss-dsi-h-right-border = <0>;
		qcom,mdss-dsi-v-top-border = <0>;
		qcom,mdss-dsi-v-bottom-border = <0>;
		qcom,mdss-dsi-underflow-color = <0xff>;
		qcom,mdss-dsi-border-color = <0>;
		qcom,mdss-dsi-h-sync-pulse = <0>;
		qcom,mdss-dsi-traffic-mode = "burst_mode";
		qcom,mdss-dsi-bllp-eof-power-mode;
		qcom,mdss-dsi-bllp-power-mode;
		qcom,mdss-dsi-dma-trigger = "trigger_sw";
		qcom,mdss-dsi-mdp-trigger = "none";
		qcom,mdss-dsi-tx-eot-append;
		qcom,mdss-dsi-on-command = [29 01 00 00 00 00 02 B0 00
				29 01 00 00 00 00 08 D5 03 00 00 02 23 02 23
				05 01 00 00 1E 00 02 29 00
				05 01 00 00 78 00 02 11 00];
		qcom,mdss-dsi-on-command-state = "dsi_lp_mode";
		qcom,mdss-dsi-off-command-state = "dsi_hs_mode";
		qcom,mdss-dsi-te-pin-select = <1>;
/*
		qcom,mdss-dsi-wr-mem-start = <0x2c>;
		qcom,mdss-dsi-wr-mem-continue = <0x3c>;
*/
		qcom,mdss-dsi-te-dcs-command = <1>;
		qcom,mdss-dsi-te-check-enable;
		qcom,mdss-dsi-te-using-te-pin;
		qcom,mdss-dsi-lane-0-state;
		qcom,mdss-dsi-lane-1-state;
		qcom,mdss-dsi-lane-2-state;
		qcom,mdss-dsi-lane-3-state;
		qcom,mdss-dsi-panel-timings-phy-v2 = [23 1E 08 09 05 03 04 A0
		23 1E 08 09 05 03 04 A0
		23 1E 08 09 05 03 04 A0
		23 1E 08 09 05 03 04 A0
		23 1A 08 09 05 03 04 A0];
		qcom,mdss-dsi-t-clk-post = <0x0D>;
		qcom,mdss-dsi-t-clk-pre = <0x2F>;

		qcom,esd-check-enabled;
		qcom,mdss-dsi-panel-status-check-mode = "reg_read";
		qcom,mdss-dsi-panel-status-command = [06 01 00 01 00 00 01 0A];
		qcom,mdss-dsi-panel-status-command-state = "dsi_hs_mode";
		qcom,mdss-dsi-panel-status-value = <0x1C>;
		qcom,mdss-dsi-panel-status-read-length = <1>;
		qcom,panel-supply-entries = <&dsi_panel_pwr_supply_full_incell>;
		qcom,mdss-dsi-lp11-init;
		qcom,mdss-dsi-bl-min-level = <1>;
		qcom,mdss-dsi-bl-max-level = <4095>;
		qcom,mdss-brightness-max-level = <4095>;
		qcom,mdss-dsi-bl-pmic-control-type = "bl_ctrl_wled";
/*  CEI additional  */
		qcom,mdss-dsi-panel-framerate-f = <45>;
		qcom,mdss-dsi-on-command-f = [05 01 00 00 C8 00 02 11 00
				29 01 00 00 00 00 02 B0 00
				29 01 00 00 00 00 02 D6 C1
				29 01 00 00 00 00 08 D5 03 00 00 02 23 02 23
				29 01 00 00 00 00 16 C2 01 F7 80 08 68 08 0C 10 00 08 70 00 00 00 00 00 00 00 05 9F 00
				29 01 00 00 00 00 27 CD 00 00 30 00 75 c0 64 02 D9 1f D1 00 A0 A0 A0 A0 01 00 00 00 31 00 76 00 64 02 0C 48 01 30 00 75 00 65 02 1B 49 AF
				05 01 00 00 32 00 02 29 00];
		qcom,mdss-dsi-off-command = [05 01 00 00 14 00 02 28 00
				05 01 00 00 78 00 02 10 00];
		qcom,mdss-dsi-reset-sequence = <0 30>, <1 150>;
		qcom,mdss-dsi-post-init-delay = <1>;
/* SOMC additional*/
		qcom,mdss-dsi-panel-hdr-enabled;
		qcom,mdss-dsi-panel-hdr-color-primaries = <14940 15790 33800 15700 10950 33800 7450 2300>;
		qcom,mdss-dsi-panel-peak-brightness = <7000000>;
		qcom,mdss-dsi-panel-blackness-level = <4646>;
		qcom,mdss-dsi-panel-clockrate = <899000000>;
		somc,lcd-id-adc = <801000 917000>;
		somc,mdss-dsi-master;
		somc,pw-on-rst-seq = <0 15>, <1 20>;
		somc,pw-off-rst-b-seq = <0 11>;
		somc,pw-wait-after-on-vdd = <0>;
		somc,pw-wait-after-on-vddio = <0>;
		somc,pw-wait-after-on-vsp = <8>;
		somc,pw-wait-after-on-vsn = <0>;
		somc,pw-wait-after-off-vdd = <0>;
		somc,pw-wait-after-off-vddio = <1>;
		somc,pw-wait-after-off-vsp = <8>;
		somc,pw-wait-after-off-vsn = <8>;
		somc,pw-wait-after-on-touch-vddio = <0>;
		somc,pw-wait-after-on-touch-reset = <0>;
		somc,pw-wait-after-on-touch-int-n = <10>;
		somc,pw-wait-after-off-touch-vddio = <0>;
		somc,pw-wait-after-off-touch-reset = <11>;
		somc,pw-wait-after-off-touch-int-n = <0>;
		somc,pw-down-period = <300>;

		somc,lab-output-voltage = <5500000>;
		somc,ibb-output-voltage = <5500000>;
		somc,qpnp-lab-limit-maximum-current = <200>;
		somc,qpnp-ibb-limit-maximum-current = <800>;
		somc,qpnp-lab-max-precharge-time = <500>;
		somc,qpnp-lab-soft-start = <800>;
		somc,qpnp-ibb-discharge-resistor = <300>;
		somc,qpnp-lab-pull-down-enable;
		somc,qpnp-lab-full-pull-down;
		somc,qpnp-ibb-pull-down-enable;
		somc,qpnp-ibb-full-pull-down;

		somc,ewu-rst-seq = <0 2>, <1 5>;
		somc,ewu-wait-after-touch-reset = <0>;

		somc,change-fps-enable;
		somc,change-fps-panel-type = "full_incell_type";
		somc,change-fps-panel-mode = "dynamic_mode";
		somc,change-fps-command =
				[29 01 00 00 00 00 02 B0 04
				 29 01 00 00 00 00 02 D6 01
				 29 01 00 00 00 00 02 C6 59];
		somc,driver-ic-total-porch = <11>;
		somc,driver-ic-vdisp = <1280>;
		somc,driver-ic-rclk = <14000000>;
		somc,driver-ic-vtp = <1330>;
		somc,change-fps-rtn-pos = <2 1>;

		somc,mdss-dsi-disp-on-in-hs = <0>;
		somc,mdss-dsi-wait-time-before-post-on-cmd = <0>;
	};


};
