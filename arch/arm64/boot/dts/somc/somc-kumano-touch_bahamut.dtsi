/* arch/arm64/boot/dts/somc/somc-kumano-touch_bahamut.dtsi
 *
 * This program is free software; you can redistribute it and/or modify
 * it under the terms of the GNU General Public License version 2 and
 * only version 2 as published by the Free Software Foundation.
 *
 * This program is distributed in the hope that it will be useful,
 * but WITHOUT ANY WARRANTY; without even the implied warranty of
 * MERCHANTABILITY or FITNESS FOR A PARTICULAR PURPOSE.  See the
 * GNU General Public License for more details.
 */

&qupv3_se10_i2c {
	touchscreen@48 {
		/* override parameter */
		sec,max_coords = <1080 2520>;
		sec,cover_mode_supported = <0>;
		sec,rejection_area_portrait = <25 150 60 200>;
		sec,rejection_area_landscape = <150 20 200 60>;
	};
};
