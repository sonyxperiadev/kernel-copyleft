/* Copyright (c) 2019, The Linux Foundation. All rights reserved.
 *
 * This program is free software; you can redistribute it and/or modify
 * it under the terms of the GNU General Public License version 2 and
 * only version 2 as published by the Free Software Foundation.
 *
 * This program is distributed in the hope that it will be useful,
 * but WITHOUT ANY WARRANTY; without even the implied warranty of
 * MERCHANTABILITY or FITNESS FOR A PARTICULAR PURPOSE.  See the
 * GNU General Public License for more details.
 */

/dts-v1/;

#include "../qcom/sm8150-v2.dtsi"
#include "../qcom/sm8150-mtp.dtsi"
#include "sm8150-kumano-griffin_generic.dtsi"

/ {
	model = "Sony Mobile Communications Inc., Griffin P(SM8150 v2)";
	compatible = "somc,griffin-p", "qcom,sm8150", "qcom,mtp";
	qcom,board-id = <8 0>;
};
