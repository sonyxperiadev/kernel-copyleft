/* arch/arm64/boot/dts/somc/sm8150-kumano-bahamut_m.dtsi
 *
 * This program is free software; you can redistribute it and/or modify
 * it under the terms of the GNU General Public License version 2 and
 * only version 2 as published by the Free Software Foundation.
 *
 * This program is distributed in the hope that it will be useful,
 * but WITHOUT ANY WARRANTY; without even the implied warranty of
 * MERCHANTABILITY or FITNESS FOR A PARTICULAR PURPOSE.  See the
 * GNU General Public License for more details.
 */

#include "sm8150-kumano-bahamut_common.dtsi"
#include "somc-kumano-nfc_pn81t.dtsi"

&soc {
};

&somc_pinctrl {
	pinctrl-2 = <&sm_gpio_0 &sm_gpio_3>;
};
