/* arch/arm64/boot/dts/somc/sdm630-ganges-pioneer_dsds.dtsi
 *
 * This program is free software; you can redistribute it and/or modify
 * it under the terms of the GNU General Public License version 2 and
 * only version 2 as published by the Free Software Foundation.
 *
 * This program is distributed in the hope that it will be useful,
 * but WITHOUT ANY WARRANTY; without even the implied warranty of
 * MERCHANTABILITY or FITNESS FOR A PARTICULAR PURPOSE.  See the
 * GNU General Public License for more details.
*/

#include "sdm630-ganges-pioneer.dtsi"
#include <dt-bindings/gpio/gpio.h>

&soc {
	sim_detect {
		sim2_det {
			label = "sim2-detection";
			gpios = <&tlmm 86 GPIO_ACTIVE_LOW>;
			debounce-interval = <10>;
		};
	};
};
