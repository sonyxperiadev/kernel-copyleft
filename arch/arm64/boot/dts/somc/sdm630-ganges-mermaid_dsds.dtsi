/* arch/arm64/boot/dts/somc/sdm630-ganges-mermaid_dsds.dtsi
 *
 * This program is free software; you can redistribute it and/or modify
 * it under the terms of the GNU General Public License version 2 and
 * only version 2 as published by the Free Software Foundation.
 *
 * This program is distributed in the hope that it will be useful,
 * but WITHOUT ANY WARRANTY; without even the implied warranty of
 * MERCHANTABILITY or FITNESS FOR A PARTICULAR PURPOSE.  See the
 * GNU General Public License for more details.
*/


#include "sdm630-ganges-mermaid.dtsi"
#include <dt-bindings/gpio/gpio.h>

&soc {
	sim_detect {
		sim2_det {
			label = "sim2-detection";
			gpios = <&tlmm 86 GPIO_ACTIVE_LOW>;
			debounce-interval = <10>;
		};
	};

	qusb_phy0: qusb@c012000 {
		qcom,tune2-efuse-num-bits = <0>;
		qcom,tune2-efuse-correction = <0>;
		qcom,qusb-phy-init-seq = <0xa7 0x80
			0x22 0x84
			0x83 0x88
			0xc7 0x8c
			0x30 0x08
			0x79 0x0c
			0x21 0x10
			0x14 0x9c
			0x9f 0x1c
			0x00 0x18>;
	};
};
