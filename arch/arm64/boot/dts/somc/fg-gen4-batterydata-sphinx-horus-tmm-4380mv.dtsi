/* Copyright (c) 2019, The Linux Foundation. All rights reserved.
 *
 * This program is free software; you can redistribute it and/or modify
 * it under the terms of the GNU General Public License version 2 and
 * only version 2 as published by the Free Software Foundation.
 *
 * This program is distributed in the hope that it will be useful,
 * but WITHOUT ANY WARRANTY; without even the implied warranty of
 * MERCHANTABILITY or FITNESS FOR A PARTICULAR PURPOSE.  See the
 * GNU General Public License for more details.
 */

qcom,sphinx_horus_tmm_4380mv {
	/* Added or Modified by SOMC */
	qcom,battery-type = "1318-8877";
	qcom,fastchg-current-ma = <3000>;
	somc,initial-capacity-uah = <3329000>;
	somc,step-cfg = <
		(-2550) 50    0 4500    0 4380 1
		   50  100    0 4500  950 4380 2
		  100  450    0 4250 3000 4380 3
		  100  450 4250 4300 1600 4380 3
		  100  450 4300 4500  950 4380 3
		  450  550    0 4500  950 4200 4
		  550 2550    0 4500    0 4200 5
	>;
	somc,step-cell-impedance-mohm = <20>;

	/* Prepared by Qualcomm */
	qcom,profile-revision = <24>;
	/* #3836762_SoMC_RenMurata_3233mAh_averaged_MasterSlave_Feb11th2019*/
	qcom,max-voltage-uv = <4380000>;
	qcom,fg-cc-cv-threshold-mv = <4370>;
	qcom,nom-batt-capacity-mah = <3233>;
	qcom,batt-id-kohm = <330>;
	qcom,battery-beta = <4250>;
	qcom,therm-room-temp = <100000>;
	/* qcom,battery-type = "3836762_somc_renmurata_3233mah_averaged_masterslave_feb11th2019"; */
	qcom,therm-coefficients = <0x2318 0xd0c 0xdaf7 0xc556 0x848d>;
	qcom,therm-center-offset = <0x70>;
	qcom,therm-pull-up = <100>;
	qcom,rslow-normal-coeffs = <0x38 0x04 0x2c 0x03>;
	qcom,rslow-low-coeffs = <0xfa 0x05 0xe6 0x0a>;
	qcom,checksum = <0x6597>;
	qcom,gui-version = "PM855GUI - 1.0.0.13";
	qcom,fg-profile-data = [
		 09 00 D4 EA
		 BA ED 27 F2
		 92 ED 00 00
		 67 C5 08 9A
		 DC 87 60 A2
		 12 9C CF 87
		 20 00 38 04
		 2C 03 9D 04
		 5F 02 CE 07
		 32 00 06 EB
		 1C ED 72 DA
		 D8 02 29 DD
		 94 BC 80 0A
		 D5 DD 96 CB
		 60 00 40 00
		 44 00 42 00
		 3E 00 3B 00
		 3B 00 3F 00
		 42 00 3E 00
		 37 00 60 00
		 3E 00 4D 00
		 55 00 4E 00
		 44 00 70 00
		 6C 64 56 00
		 49 F8 44 00
		 60 F0 56 00
		 5D 00 72 10
		 68 10 5F 00
		 BB 28 8C 40
		 72 58 66 11
		 62 00 D8 00
		 E9 1E BB 04
		 5B FB 16 05
		 00 1C BD 0B
		 89 0D 88 22
		 77 16 04 42
		 7E 54 1F 02
		 68 13 1C 1F
		 2E 06 D7 0B
		 D7 FD 70 1C
		 D3 02 8A 04
		 9D 03 BF 17
		 24 23 7B 45
		 CF 52 6E 13
		 28 20 11 ED
		 B5 D2 5D DC
		 8E 1C 10 D2
		 2E 04 DF C3
		 84 17 3B 93
		 71 85 CA 9A
		 8A A0 09 80
		 6A FA B0 04
		 B4 02 09 FD
		 00 00 D7 ED
		 1C F3 E6 F7
		 49 D2 9B C4
		 88 00 20 F0
		 B3 04 BA 02
		 85 05 15 03
		 CE 07 32 00
		 6C 01 44 02
		 F7 05 07 03
		 5D 05 0A 02
		 E2 02 37 03
		 F4 07 54 00
		 31 00 3C 00
		 44 64 47 00
		 4A 00 4A 00
		 4A 00 48 00
		 4B 08 46 10
		 4E 10 36 00
		 42 20 45 40
		 4C 58 54 0E
		 44 00 4A 00
		 4E 08 5C 00
		 52 00 44 00
		 38 08 46 08
		 4A 00 56 20
		 66 40 4E 50
		 53 10 57 00
		 5F 00 53 08
		 D8 00 1A 1F
		 D7 06 68 0A
		 98 0F 15 1C
		 8E 22 45 44
		 E6 53 CC 17
		 DE 03 08 04
		 E3 02 5C 13
		 3F 0A B0 20
		 97 04 10 03
		 D4 05 83 1C
		 38 03 0D 04
		 DC 03 51 18
		 41 03 03 05
		 D6 03 79 00
		 76 1F D4 05
		 49 02 79 06
		 82 1C F7 02
		 56 04 D5 03
		 73 18 C0 02
		 D0 05 6F 02
		 6E 00 7A 01
		 C0 00 FA 00
		 01 0D 00 00
	];
};
